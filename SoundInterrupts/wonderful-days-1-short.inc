sound: db 128,0,0,224,1,48,240,0,28,120,0,12,60,0,6,14,0,131,7,128,193,3,192,224,1,96,224,0,48,120,0,24,56,0,12,30,0,6,15,0,131,7,128,193,3,192,224,1,96,240,0,16,120,0,24,60,0,4,30,0,6,15,0,131,7,128,193,3,0,224,1,0,240,0,0,120,0,0,60,0,0,30,0,0,15,0,128,7,0,128,3,0,224,1,0,240,0,0,112,0,0,60,0,0,30,0,0,15,0,128,7,0,192,3,0,224,1,0,240,0,0,120,0,0,60,16,0,14,0,0,7,0,128,3,2,192,1,1,240,192,0,120,64,0,60,112,0,28,24,0,14,8,128,7,6,192,3,3,192,129,3,224,192,0,120,96,0,60,48,0,14,24,0,15,12,128,3,6,192,1,3,224,192,1,112,224,0,48,112,32,0,24,48,16,14,24,8,7,14,128,3,7,12,0,0,0,120,0,0,64,112,128,99,0,134,3,14,3,28,14,112,12,224,56,192,225,0,195,1,134,3,28,7,48,14,112,56,192,120,128,227,0,199,1,14,7,28,7,56,28,224,56,192,113,128,227,0,199,1,142,3,28,7,112,14,224,56,192,113,128,227,0,199,1,14,3,60,14,120,28,224,56,192,113,128,227,0,199,1,142,3,28,6,56,12,240,24,192,113,128,227,0,199,1,14,3,28,6,120,12,224,56,192,97,128,227,0,143,1,28,7,56,14,112,28,224,48,128,227,128,199,1,142,3,28,7,56,14,112,24,224,56,192,99,0,199,0,14,3,28,7,56,12,224,24,192,33,128,227,0,199,0,142,3,60,6,56,12,240,16,192,113,128,67,0,135,1,30,0,56,6,112,8,224,16,192,1,128,227,0,135,0,14,3,60,6,112,28,224,48,192,99,128,135,0,143,1,28,3,56,0,112,28,192,1,192,225,0,6,7,142,3,60,0,60,140,193,240,224,60,128,7,193,65,56,24,15,198,131,112,16,30,132,131,225,0,60,0,7,225,96,56,0,14,194,3,120,16,30,134,131,224,0,28,128,7,225,97,56,8,14,192,1,120,16,30,128,131,240,48,28,128,7,225,1,56,12,15,195,65,120,16,30,196,195,240,48,28,132,7,225,32,60,12,15,195,65,120,0,14,194,195,112,48,28,134,131,224,32,60,8,7,193,65,120,8,14,194,3,112,16,30,128,135,224,32,28,128,7,224,1,56,0,14,194,1,120,0,30,132,7,224,32,60,128,7,224,65,120,0,14,194,3,112,0,28,128,7,240,32,60,0,7,193,1,56,0,15,194,3,240,0,28,128,3,224,0,60,0,15,192,1,120,0,30,192,3,112,0,30,128,7,240,1,60,0,7,224,1,120,0,14,192,3,240,0,30,128,7,240,0,60,0,15,224,1,120,0,14,226,0,120,0,62,192,129,224,192,15,128,15,192,7,60,24,30,252,0,248,0,124,192,131,193,193,7,128,15,132,15,12,56,24,60,0,248,0,240,1,224,3,195,7,128,31,0,31,16,124,48,248,0,240,129,224,1,193,7,130,15,8,31,24,30,48,124,64,248,128,240,129,225,3,128,15,132,15,24,62,56,124,96,248,64,240,129,227,3,195,15,4,15,8,31,48,60,32,248,192,240,129,225,3,135,7,134,31,8,30,0,126,32,120,0,240,129,224,1,192,7,134,7,0,62,24,62,0,248,192,240,0,224,3,195,7,128,15,0,31,0,124,0,120,128,240,1,224,3,130,7,128,15,24,30,0,62,96,120,0,248,0,225,1,192,3,132,7,0,31,48,30,0,120,64,120,0,241,1,194,1,128,15,0,15,112,60,64,248,128,241,0,224,3,134,7,8,31,24,14,0,124,0,192,193,129,3,227,1,128,25,224,96,56,112,32,60,0,56,0,14,14,6,7,128,3,128,3,192,225,193,224,129,96,224,112,48,56,60,24,28,56,12,28,14,2,135,131,131,7,131,131,195,225,224,112,96,240,112,112,112,24,8,8,12,14,14,14,7,7,3,1,195,193,193,225,225,224,224,96,112,48,56,24,60,28,28,28,12,14,6,7,3,135,3,135,131,193,193,224,64,224,96,240,112,56,120,0,28,24,28,14,14,14,7,7,128,3,195,193,193,193,224,224,97,112,112,56,56,56,56,24,60,12,14,14,6,3,15,131,131,131,193,192,65,224,224,97,112,112,56,28,56,24,28,28,6,7,6,135,3,7,131,129,131,224,192,224,112,240,112,56,112,0,28,24,12,6,30,14,7,15,192,3,131,129,193,193,224,224,1,112,96,48,24,56,24,12,60,0,14,12,6,3,7,128,129,3,199,193,193,112,224,224,33,240,224,15,24,12,30,12,60,24,28,60,224,96,192,1,192,3,131,3,6,60,0,120,16,120,0,240,192,192,7,0,15,6,14,0,62,0,248,0,240,192,192,129,192,3,1,15,0,30,12,60,8,120,48,240,1,224,3,128,7,0,15,6,31,0,124,24,240,1,240,65,224,7,128,7,1,30,0,30,12,124,0,248,33,192,195,192,131,1,15,3,63,12,120,24,248,48,192,65,224,135,1,15,129,31,6,56,4,244,16,240,49,248,195,224,135,192,31,2,63,4,127,24,204,1,248,67,240,135,192,15,195,57,0,127,8,246,16,248,97,56,7,224,15,0,28,0,59,4,231,0,238,1,152,67,112,135,224,28,192,57,0,112,8,230,16,140,3,24,7,0,15,96,28,128,57,0,115,0,224,17,200,3,16,135,32,14,0,60,130,123,8,227,16,204,33,152,195,112,7,96,28,130,56,4,113,8,230,16,140,67,240,3,56,140,131,241,224,60,0,15,192,1,120,48,14,204,3,224,32,56,0,7,199,193,113,32,30,128,7,224,96,56,24,15,192,3,120,0,30,128,7,226,1,60,0,15,192,3,112,0,30,128,7,240,1,56,0,15,192,1,112,0,30,128,7,224,0,60,0,15,192,1,112,0,30,128,3,240,0,60,16,15,192,1,120,48,30,132,7,225,0,28,0,7,226,65,120,0,30,192,131,240,32,28,12,7,224,1,56,24,14,198,131,240,0,28,128,7,225,65,56,16,15,192,3,112,48,30,128,7,224,0,60,0,7,192,1,120,0,30,192,131,240,32,28,128,7,224,1,56,8,14,194,3,120,0,30,128,131,224,32,60,0,15,192,1,120,0,14,130,3,240,0,28,128,7,193,65,56,0,15,192,3,112,0,30,128,3,240,0,56,0,7,224,1,56,0,30,128,7,240,32,56,128,7,225,1,112,0,15,134,3,28,48,60,128,1,224,225,48,128,7,131,7,60,8,62,28,6,120,224,241,192,195,0,135,3,0,7,56,30,112,56,224,112,128,225,128,195,3,142,7,12,14,56,28,112,120,224,240,192,195,129,135,3,12,7,30,14,124,56,112,120,192,225,128,195,1,7,7,14,15,56,28,120,56,224,240,224,225,129,135,3,15,7,30,30,28,28,112,120,240,240,192,225,129,195,3,7,7,14,14,56,60,56,60,224,240,224,224,129,195,3,7,7,14,30,28,60,112,120,96,240,192,225,129,129,7,135,7,12,30,60,60,112,240,224,240,128,195,3,131,7,12,30,28,30,112,120,224,112,128,195,129,195,3,14,7,14,15,56,60,48,56,192,241,192,225,0,135,7,134,3,60,30,24,14,96,120,64,120,128,195,1,131,3,12,7,24,14,112,24,96,24,128,227,0,24,0,14,0,0,30,56,12,0,0,224,1,0,192,129,131,97,0,0,60,0,0,30,112,0,14,8,128,7,0,224,3,14,192,1,3,120,0,0,28,224,32,56,32,0,6,0,192,3,12,4,3,6,224,0,0,224,128,3,240,0,3,24,0,0,62,112,0,30,112,0,0,24,112,3,14,192,1,14,56,0,6,55,192,0,24,192,128,3,96,112,0,48,0,0,24,24,0,12,92,0,0,24,0,3,14,128,129,3,224,0,7,48,224,1,56,56,0,12,112,0,3,14,128,131,3,192,1,15,0,192,1,112,240,0,96,224,0,28,56,0,7,30,0,0,30,128,131,3,224,128,3,192,192,1,48,120,0,14,120,0,8,60,0,6,15,128,3,15,192,129,3,224,224,1,112,224,1,48,112,0,12,60,0,28,60,0,14,30,128,129,7,128,193,3,224,224,1,56,240,0,56,120,0,12,60,0,6,14,0,135,15,8,134,3,240,129,193,49,128,99,48,252,1,112,28,0,63,12,14,96,56,3,224,28,0,63,56,252,64,48,7,192,31,4,7,0,28,3,224,7,128,48,0,198,65,176,7,192,15,14,57,0,124,0,240,1,192,113,0,230,0,156,3,224,15,4,63,0,30,64,56,0,224,12,128,3,0,4,3,56,6,192,25,24,198,32,248,131,224,12,130,15,8,142,0,56,0,224,56,128,103,0,252,131,225,6,128,15,12,30,0,60,0,224,1,192,1,0,14,1,0,7,96,8,12,14,0,216,0,240,3,128,35,0,206,0,184,3,240,24,128,63,0,222,0,120,128,225,12,132,3,0,30,0,56,14,192,33,0,231,32,152,195,224,14,0,63,24,30,0,120,4,192,25,4,227,0,140,3,0,7,128,15,24,30,32,56,128,225,0,134,3,8,206,0,112,2,1,24,4,68,48,152,65,224,1,130,7,0,14,0,56,130,225,28,6,3,16,236,0,24,7,195,3,128,131,192,192,224,112,96,96,56,0,56,28,24,14,4,2,6,0,6,131,195,129,129,1,192,129,192,97,112,16,0,16,0,24,12,28,14,0,7,128,3,192,3,193,192,97,192,16,0,96,48,24,8,24,12,12,0,10,134,15,128,3,131,135,129,193,0,224,192,96,32,96,56,0,28,0,28,0,14,4,6,6,7,131,1,193,193,224,192,224,193,32,48,56,16,60,24,28,8,14,12,7,7,3,3,1,0,131,65,192,224,0,48,96,48,112,48,56,0,12,2,12,7,6,14,6,129,193,129,1,128,193,192,96,112,112,48,48,56,0,28,24,28,3,14,7,4,2,7,128,131,129,65,192,64,96,224,64,56,0,8,24,0,24,8,28,0,6,129,3,7,7,131,193,129,0,224,0,224,0,48,24,56,8,0,0,4,0,14,12,7,128,193,0,3,0,128,225,32,112,0,56,48,56,0,28,12,14,6,6,12,7,2,7,193,3,192,7,0,112,96,112,48,192,2,0,30,0,62,24,240,0,7,7,3,142,1,224,129,225,1,0,14,0,56,16,112,0,0,7,0,12,0,48,0,192,3,128,7,0,60,64,240,0,192,1,0,7,0,60,0,240,0,6,7,0,14,0,120,192,192,1,0,135,0,56,0,112,48,128,1,0,30,0,56,0,224,1,4,7,4,30,0,112,0,192,3,0,7,0,60,0,240,0,128,3,0,28,0,120,0,192,0,0,6,1,30,0,240,32,192,3,0,39,0,120,96,224,1,0,15,0,30,12,120,0,128,131,129,3,0,240,0,128,3,0,1,0,28,12,120,48,0,0,128,15,3,7,0,132,67,0,6,128,48,0,60,48,240,64,96,14,6,30,24,140,1,192,12,131,7,12,198,96,240,195,193,14,0,120,24,252,32,240,6,192,61,4,255,16,152,67,224,15,0,60,0,252,0,24,7,0,14,0,28,128,129,15,128,131,15,224,128,1,96,192,1,0,248,1,120,112,0,12,30,0,3,31,0,3,31,0,192,1,192,192,1,192,0,0,112,248,0,24,60,0,15,28,0,8,7,0,128,7,192,193,3,0,224,0,48,224,0,56,120,0,28,24,0,12,14,0,7,30,128,195,7,128,131,3,112,224,1,112,240,0,24,60,0,4,96,0,12,30,0,0,7,128,193,3,128,193,3,224,224,1,48,112,0,48,112,0,28,60,0,0,30,0,14,14,128,129,7,128,192,3,192,224,1,96,224,0,24,120,0,28,30,0,2,15,128,7,7,0,193,3,192,192,129,192,240,0