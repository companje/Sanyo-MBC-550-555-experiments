sound: db 210,48,19,187,145,63,208,31,240,15,248,151,116,35,63,1,63,192,31,240,15,240,151,116,3,127,1,63,128,63,224,31,240,167,245,2,126,1,127,128,63,224,31,240,47,233,70,126,2,126,0,63,224,63,224,15,233,4,254,2,254,0,127,192,63,224,79,203,141,252,2,254,0,127,128,63,224,159,210,110,228,7,224,7,240,7,240,7,248,11,233,6,236,7,252,7,240,31,192,63,128,175,65,102,118,3,240,31,240,31,192,127,0,215,34,35,251,1,248,15,248,15,224,63,128,82,178,19,249,1,252,5,252,15,240,31,64,107,145,137,253,0,254,7,252,7,240,31,192,165,217,200,254,0,254,2,254,7,240,23,232,149,204,68,110,0,255,1,255,3,248,15,240,90,100,102,55,128,127,1,255,3,248,31,80,107,54,176,191,0,252,7,208,255,1,252,47,37,187,137,108,38,145,237,39,162,245,85,160,150,157,64,254,19,192,254,19,192,255,7,212,218,76,96,191,9,64,254,21,160,255,5,90,201,102,32,251,13,160,255,9,224,255,3,170,101,39,144,221,4,176,255,4,208,255,137,82,179,25,236,126,1,236,127,2,244,255,178,146,221,68,118,147,64,254,11,169,222,87,165,204,4,182,155,0,244,95,0,93,159,146,205,100,183,153,200,255,10,200,182,146,141,100,246,147,208,255,1,65,175,101,34,177,221,4,242,255,0,84,107,50,145,253,37,32,255,23,16,43,217,12,230,31,0,236,63,129,172,101,35,208,239,4,176,191,0,173,181,9,192,254,19,192,255,1,64,107,50,129,253,6,64,255,18,104,37,27,193,252,19,128,253,7,160,150,157,64,254,19,192,255,23,84,218,76,32,251,9,224,255,139,72,237,6,176,255,5,240,255,5,164,100,35,208,255,0,240,191,1,212,50,17,200,111,18,216,255,160,74,187,9,236,55,145,236,95,17,169,217,72,118,155,72,236,63,8,109,27,193,236,22,128,253,7,106,219,9,100,55,1,213,87,85,202,76,32,187,9,164,166,171,148,108,36,219,9,224,239,7,165,106,131,72,14,240,48,127,128,127,128,255,1,236,252,171,138,227,15,248,7,240,63,0,255,158,224,17,254,0,255,0,255,3,20,255,14,30,227,15,240,15,224,63,0,254,13,240,113,254,0,255,1,254,7,224,127,69,21,231,31,240,15,240,15,224,255,128,122,143,31,224,15,248,3,128,63,160,91,138,63,224,7,252,129,195,31,252,80,154,31,248,129,159,7,31,60,62,252,26,15,124,0,63,248,15,62,131,191,30,15,254,128,31,240,7,255,193,103,57,62,248,1,63,192,15,254,131,15,194,227,193,15,240,1,126,240,31,124,46,61,30,252,1,63,224,7,254,193,7,112,138,15,126,192,15,240,131,127,224,3,120,138,15,126,192,15,240,131,255,224,115,240,26,15,252,128,31,224,135,255,192,99,240,165,120,240,15,252,0,31,224,135,247,224,92,142,7,255,192,31,248,3,127,224,31,252,11,207,3,126,224,15,248,1,63,192,7,124,40,199,65,62,192,7,248,0,31,224,3,124,148,227,0,63,224,3,124,128,15,240,3,255,218,113,128,31,240,7,252,192,63,252,1,143,235,56,194,31,240,7,255,128,63,224,113,199,229,60,225,15,248,131,127,192,27,238,143,171,114,156,241,7,120,193,63,224,15,122,20,215,58,206,240,7,124,193,31,240,15,250,195,118,57,79,248,3,126,224,15,240,3,127,168,54,220,192,31,240,31,224,31,192,190,33,252,0,254,3,224,255,3,160,150,117,3,240,255,11,0,255,13,194,176,3,216,255,4,104,249,39,13,59,128,253,27,64,237,119,105,216,3,252,255,2,200,125,75,184,1,252,255,4,208,215,50,108,0,254,127,3,184,95,150,29,192,254,39,1,238,54,236,0,246,95,1,60,107,217,1,252,255,0,112,107,186,1,252,255,0,168,101,220,0,254,15,192,127,9,119,192,255,0,247,95,138,31,224,31,0,254,151,227,15,240,15,160,175,115,252,1,254,3,232,63,199,31,224,63,192,188,119,248,3,252,3,192,127,143,63,192,63,64,252,231,248,3,252,3,212,119,142,63,192,63,0,124,231,248,3,252,3,208,247,142,63,192,63,0,59,235,248,3,252,7,232,179,142,59,184,59,160,186,170,168,170,170,170,2