sound: db 44,1,62,92,120,240,225,193,135,31,15,62,184,248,224,195,131,15,55,30,124,120,241,193,199,135,31,46,60,248,240,226,195,141,7,63,92,124,240,225,198,135,27,15,62,188,248,112,227,197,15,23,31,124,56,241,225,198,131,15,39,30,220,120,240,193,197,7,23,78,60,184,241,224,195,137,7,39,30,124,112,225,193,135,19,15,14,60,248,224,226,129,15,7,30,92,120,240,225,197,131,15,15,62,184,240,224,195,129,7,31,30,124,112,241,193,135,3,15,62,60,248,240,227,193,15,23,31,124,120,240,225,199,131,15,47,62,248,248,224,195,141,7,31,94,124,248,241,224,135,139,15,62,156,248,112,227,193,135,23,31,110,60,248,225,226,131,15,39,62,220,120,240,225,196,7,19,79,62,184,248,224,194,137,7,39,30,124,112,241,192,133,3,15,46,60,248,112,226,193,129,7,31,92,60,240,225,192,131,11,15,62,188,120,240,195,193,7,23,30,124,120,241,224,195,131,15,46,62,248,112,224,193,135,7,31,126,124,248,225,226,131,15,15,62,252,248,240,227,197,7,31,30,124,184,241,224,195,139,15,63,62,252,112,241,193,135,23,31,110,60,248,241,226,131,141,39,62,220,120,112,225,196,135,27,15,62,184,248,96,226,137,7,55,30,92,56,241,224,196,131,15