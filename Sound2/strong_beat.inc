sound: db 220,5,183,37,186,250,191,193,7,159,30,122,99,236,146,243,139,31,94,77,166,56,253,44,127,191,225,79,47,169,54,32,253,255,205,150,251,191,238,172,240,253,231,88,77,28,251,190,219,109,71,228,251,188,218,170,243,232,221,239,155,189,240,99,76,159,111,129,68,95,254,225,221,242,219,159,226,83,105,180,93,237,231,199,244,247,223,236,204,252,52,44,162,227,255,239,180,82,187,110,165,204,0,0,0,0,0,0,0,0,0,0,0,0,0,0,0,0,0,0,0,0,0,0,0,0,0,0,0,0,0,0,0,0,0,0,0,0,0,0,0,0,0,0,0,0,0,0,0,0,0,0,0,0,0,0,0,0,0,0,0,0,0,0,0,0,0,0,0,0,0,0,0,0,0,0,0,0,0,0,0,0,0,0,0,0,0,0,0,0,0,0,0,0,0,0,0,0,0,0,0,0,0,0,0,0,0,0,0,0,0,0,0,0,0,0,0,0,0,0,0,0,0,0,0,0,0,0,0,0,0,0,0,0,0,0,0,0,0,0,0,0,0,0,0,0,0,0,0,0,0,0,183,37,186,250,191,193,7,159,30,122,99,236,146,243,139,31,94,77,166,56,253,44,127,191,225,79,47,169,54,32,253,255,205,150,251,191,238,172,240,253,231,88,77,28,251,190,219,109,71,228,251,188,218,170,243,232,221,239,155,189,240,99,76,159,111,129,68,95,254,225,221,242,219,159,226,83,105,180,93,237,231,199,244,247,223,236,204,252,52,44,162,227,255,239,180,82,187,110,165,204,0,0,0,0,0,0,0,0,0,0,0,0,0,0,0,0,0,0,0,0,0,0,0,0,0,0,0,0,0,0,0,0,0,0,0,0,0,0,0,0,0,0,0,0,0,0,0,0,0,0,0,0,0,0,0,0,0,0,0,0,0,0,0,0,0,0,0,0,0,0,0,0,0,0,0,0,0,0,0,0,0,0,0,0,0,0,0,0,0,0,0,0,0,0,0,0,0,0,0,0,0,0,0,0,0,0,0,0,0,0,0,0,0,0,0,0,0,0,0,0,0,0,0,0,0,0,0,0,0,0,0,0,0,0,0,0,0,0,0,0,0,0,0,0,0,0,0,0,0,0,183,37,186,250,191,193,7,159,30,122,99,236,146,243,139,31,94,77,166,56,253,44,127,191,225,79,47,169,54,32,253,255,205,150,251,191,238,172,240,253,231,88,77,28,251,190,219,109,71,228,251,188,218,170,243,232,221,239,155,189,240,99,76,159,111,129,68,95,254,225,221,242,219,159,226,83,105,180,93,237,231,199,244,247,223,236,204,252,52,44,162,227,255,239,180,82,187,110,165,204,0,0,0,0,0,0,0,0,0,0,0,0,0,0,0,0,0,0,0,0,0,0,0,0,0,0,0,0,0,0,0,0,0,0,0,0,0,0,0,0,0,0,0,0,0,0,0,0,0,0,0,0,0,0,0,0,0,0,0,0,0,0,0,0,0,0,0,0,0,0,0,0,0,0,0,0,0,0,0,0,0,0,0,0,0,0,0,0,0,0,0,0,0,0,0,0,0,0,0,0,0,0,0,0,0,0,0,0,0,0,0,0,0,0,0,0,0,0,0,0,0,0,0,0,0,0,0,0,0,0,0,0,0,0,0,0,0,0,0,0,0,0,0,0,0,0,0,0,0,0,183,37,186,250,191,193,7,159,30,122,99,236,146,243,139,31,94,77,166,56,253,44,127,191,225,79,47,169,54,32,253,255,205,150,251,191,238,172,240,253,231,88,77,28,251,190,219,109,71,228,251,188,218,170,243,232,221,239,155,189,240,99,76,159,111,129,68,95,254,225,221,242,219,159,226,83,105,180,93,237,231,199,244,247,223,236,204,252,52,44,162,227,255,239,180,82,187,110,165,204,0,0,0,0,0,0,0,0,0,0,0,0,0,0,0,0,0,0,0,0,0,0,0,0,0,0,0,0,0,0,0,0,0,0,0,0,0,0,0,0,0,0,0,0,0,0,0,0,0,0,0,0,0,0,0,0,0,0,0,0,0,0,0,0,0,0,0,0,0,0,0,0,0,0,0,0,0,0,0,0,0,0,0,0,0,0,0,0,0,0,0,0,0,0,0,0,0,0,0,0,0,0,0,0,0,0,0,0,0,0,0,0,0,0,0,0,0,0,0,0,0,0,0,0,0,0,0,0,0,0,0,0,0,0,0,0,0,0,0,0,0,0,0,0,0,0,0,0,0,0,183,37,186,250,191,193,7,159,30,122,99,236,146,243,139,31,94,77,166,56,253,44,127,191,225,79,47,169,54,32,253,255,205,150,251,191,238,172,240,253,231,88,77,28,251,190,219,109,71,228,251,188,218,170,243,232,221,239,155,189,240,99,76,159,111,129,68,95,254,225,221,242,219,159,226,83,105,180,93,237,231,199,244,247,223,236,204,252,52,44,162,227,255,239,180,82,187,110,165,204,0,0,0,0,0,0,0,0,0,0,0,0,0,0,0,0,0,0,0,0,0,0,0,0,0,0,0,0,0,0,0,0,0,0,0,0,0,0,0,0,0,0,0,0,0,0,0,0,0,0,0,0,0,0,0,0,0,0,0,0,0,0,0,0,0,0,0,0,0,0,0,0,0,0,0,0,0,0,0,0,0,0,0,0,0,0,0,0,0,0,0,0,0,0,0,0,0,0,0,0,0,0,0,0,0,0,0,0,0,0,0,0,0,0,0,0,0,0,0,0,0,0,0,0,0,0,0,0,0,0,0,0,0,0,0,0,0,0,0,0,0,0,0,0,0,0,0,0,0,0,183,37,186,250,191,193,7,159,30,122,99,236,146,243,139,31,94,77,166,56,253,44,127,191,225,79,47,169,54,32,253,255,205,150,251,191,238,172,240,253,231,88,77,28,251,190,219,109,71,228,251,188,218,170,243,232,221,239,155,189,240,99,76,159,111,129,68,95,254,225,221,242,219,159,226,83,105,180,93,237,231,199,244,247,223,236,204,252,52,44,162,227,255,239,180,82,187,110,165,204,0,0,0,0,0,0,0,0,0,0,0,0,0,0,0,0,0,0,0,0,0,0,0,0,0,0,0,0,0,0,0,0,0,0,0,0,0,0,0,0,0,0,0,0,0,0,0,0,0,0,0,0,0,0,0,0,0,0,0,0,0,0,0,0,0,0,0,0,0,0,0,0,0,0,0,0,0,0,0,0,0,0,0,0,0,0,0,0,0,0,0,0,0,0,0,0,0,0,0,0,0,0,0,0,0,0,0,0,0,0,0,0,0,0,0,0,0,0,0,0,0,0,0,0,0,0,0,0,0,0,0,0,0,0,0,0,0,0,0,0,0,0,0,0,0,0,0,0,0,0