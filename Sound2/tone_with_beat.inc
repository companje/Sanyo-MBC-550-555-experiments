sound: db 144,6,254,3,248,15,224,63,128,255,0,254,3,248,15,192,127,0,255,1,252,7,240,31,192,127,0,255,3,248,15,224,63,128,255,0,254,3,248,31,192,127,0,255,1,252,7,240,31,192,127,0,255,3,248,15,224,63,128,255,0,254,3,248,15,192,127,0,255,1,252,7,240,31,192,127,0,254,3,248,15,224,63,128,255,0,254,3,248,31,192,127,0,255,1,252,7,240,31,192,127,0,255,3,248,15,224,63,128,255,0,254,3,248,15,192,127,0,255,1,252,7,240,31,192,127,0,255,3,248,15,224,63,128,255,0,254,3,248,15,192,127,0,255,1,252,7,240,31,192,127,0,254,3,248,15,224,63,128,255,0,254,3,248,15,192,127,0,255,1,252,7,240,31,192,127,0,254,3,248,15,224,63,128,255,0,254,3,248,15,192,127,0,255,1,252,7,240,31,192,127,0,41,67,230,120,139,68,99,31,204,156,14,100,44,64,122,62,73,24,202,6,196,49,36,254,3,193,124,25,3,74,137,0,4,64,193,136,66,75,8,11,27,103,30,64,215,82,81,147,73,228,1,97,0,143,36,8,128,24,88,11,102,121,19,56,73,17,8,5,149,146,197,145,103,12,61,6,95,231,210,19,254,3,248,15,224,63,128,255,0,254,3,248,15,192,127,0,255,1,252,7,240,31,192,127,0,255,3,248,15,224,63,128,255,0,254,3,248,31,192,127,0,255,1,252,7,240,31,192,127,0,255,3,248,15,224,63,128,255,0,254,3,248,15,192,127,0,255,1,252,7,240,31,192,127,0,254,3,248,15,224,63,128,255,0,254,3,248,31,192,127,0,255,1,252,7,240,31,192,127,0,255,3,248,15,224,63,128,255,0,254,3,248,15,192,127,0,255,1,252,7,240,31,192,127,0,255,3,248,15,224,63,128,255,0,254,3,248,15,192,127,0,255,1,252,7,240,31,192,127,0,254,3,248,15,224,63,128,255,0,254,3,248,15,192,127,0,255,1,252,7,240,31,192,127,0,254,3,248,15,224,63,128,255,0,254,3,248,15,192,127,0,255,1,252,7,240,31,192,127,0,74,18,36,133,16,108,2,125,105,193,2,90,8,97,134,27,77,97,9,13,42,52,33,235,178,2,144,108,208,192,80,224,134,170,145,51,132,2,103,241,232,45,128,6,38,100,164,34,104,192,98,2,8,224,2,69,16,61,215,67,134,29,188,122,61,20,245,252,42,239,34,83,25,129,32,3,1,226,71,92,254,3,248,15,224,63,128,255,0,254,3,248,15,192,127,0,255,1,252,7,240,31,192,127,0,255,3,248,15,224,63,128,255,0,254,3,248,31,192,127,0,255,1,252,7,240,31,192,127,0,255,3,248,15,224,63,128,255,0,254,3,248,15,192,127,0,255,1,252,7,240,31,192,127,0,254,3,248,15,224,63,128,255,0,254,3,248,31,192,127,0,255,1,252,7,240,31,192,127,0,255,3,248,15,224,63,128,255,0,254,3,248,15,192,127,0,255,1,252,7,240,31,192,127,0,255,3,248,15,224,63,128,255,0,254,3,248,15,192,127,0,255,1,252,7,240,31,192,127,0,254,3,248,15,224,63,128,255,0,254,3,248,15,192,127,0,255,1,252,7,240,31,192,127,0,254,3,248,15,224,63,128,255,0,254,3,248,15,192,127,0,255,1,252,7,240,31,192,127,0,198,54,26,188,98,22,86,194,147,80,167,15,181,10,47,20,0,121,36,48,69,9,177,4,8,32,9,80,211,180,118,208,82,67,179,68,32,253,17,176,177,15,169,64,78,21,237,108,97,24,59,47,69,32,3,206,130,121,97,148,104,41,35,112,92,147,149,44,225,9,54,103,129,136,82,7,6,64,211,81,254,3,248,15,224,63,128,255,0,254,3,248,15,192,127,0,255,1,252,7,240,31,192,127,0,255,3,248,15,224,63,128,255,0,254,3,248,31,192,127,0,255,1,252,7,240,31,192,127,0,255,3,248,15,224,63,128,255,0,254,3,248,15,192,127,0,255,1,252,7,240,31,192,127,0,254,3,248,15,224,63,128,255,0,254,3,248,31,192,127,0,255,1,252,7,240,31,192,127,0,255,3,248,15,224,63,128,255,0,254,3,248,15,192,127,0,255,1,252,7,240,31,192,127,0,255,3,248,15,224,63,128,255,0,254,3,248,15,192,127,0,255,1,252,7,240,31,192,127,0,254,3,248,15,224,63,128,255,0,254,3,248,15,192,127,0,255,1,252,7,240,31,192,127,0,254,3,248,15,224,63,128,255,0,254,3,248,15,192,127,0,255,1,252,7,240,31,192,127,0,11,8,155,172,130,140,152,14,14,34,4,111,137,14,82,188,178,173,54,197,29,45,162,70,13,59,5,1,57,170,98,16,192,160,68,194,193,141,129,5,86,154,23,64,84,219,51,43,50,72,186,130,74,104,73,169,14,2,32,241,93,150,141,124,41,250,192,10,69,34,233,98,96,81,233,169,83,80,244,183,254,3,248,15,224,63,128,255,0,254,3,248,15,192,127,0,255,1,252,7,240,31,192,127,0,255,3,248,15,224,63,128,255,0,254,3,248,31,192,127,0,255,1,252,7,240,31,192,127,0,255,3,248,15,224,63,128,255,0,254,3,248,15,192,127,0,255,1,252,7,240,31,192,127,0,254,3,248,15,224,63,128,255,0,254,3,248,31,192,127,0,255,1,252,7,240,31,192,127,0,255,3,248,15,224,63,128,255,0,254,3,248,15,192,127,0,255,1,252,7,240,31,192,127,0,255,3,248,15,224,63,128,255,0,254,3,248,15,192,127,0,255,1,252,7,240,31,192,127,0,254,3,248,15,224,63,128,255,0,254,3,248,15,192,127,0,255,1,252,7,240,31,192,127,0,254,3,248,15,224,63,128,255,0,254,3,248,15,192,127,0,255,1,252,7,240,31,192,127,0,129,149,28,7,113,147,120,106,226,231,63,18,15,49,209,224,22,23,16,16,55,93,205,86,213,0,146,19,130,129,185,72,33,18,64,35,138,173,148,10,13,35,190,252,20,128,46,243,124,170,161,166,67,193,128,154,3,61,201,78,76,126,113,143,8,32,175,53,153,153,194,64,28,164,193,34,149,42,24,16,254,3,248,15,224,63,128,255,0,254,3,248,15,192,127,0,255,1,252,7,240,31,192,127,0,255,3,248,15,224,63,128,255,0,254,3,248,31,192,127,0,255,1,252,7,240,31,192,127,0,255,3,248,15,224,63,128,255,0,254,3,248,15,192,127,0,255,1,252,7,240,31,192,127,0,254,3,248,15,224,63,128,255,0,254,3,248,31,192,127,0,255,1,252,7,240,31,192,127,0,255,3,248,15,224,63,128,255,0,254,3,248,15,192,127,0,255,1,252,7,240,31,192,127,0,255,3,248,15,224,63,128,255,0,254,3,248,15,192,127,0,255,1,252,7,240,31,192,127,0,254,3,248,15,224,63,128,255,0,254,3,248,15,192,127,0,255,1,252,7,240,31,192,127,0,254,3,248,15,224,63,128,255,0,254,3,248,15,192,127,0,255,1,252,7,240,31,192,127,0,21,234,200,66,138,69,220,232,28,194,9,200,34,9,61,74,72,124,13,168,52,201,109,50,9,6,18,20,37,232,235,33,154,83,65,238,104,76,16,35,141,247,139,14,61,3,184,161,138,186,249,56,4,92,88,92,105,161,86,200,214,169,67,37,42,69,179,210,63,210,59,27,228,0,209,196,98,136,96,133