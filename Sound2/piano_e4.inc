sound: db 88,2,254,31,0,254,31,0,254,31,0,254,31,0,252,63,0,252,63,0,252,63,0,252,127,0,248,127,0,248,127,0,248,127,0,248,255,0,240,255,0,240,255,0,240,255,0,224,255,1,224,255,1,224,255,1,224,255,1,192,255,3,192,255,3,192,255,3,192,255,7,128,255,7,128,255,7,128,255,7,0,255,15,0,255,15,0,255,15,0,255,15,0,254,31,0,254,31,0,254,31,0,254,63,0,252,63,0,252,63,0,252,63,0,252,127,0,248,127,0,248,127,0,248,127,0,240,255,0,240,255,0,240,255,0,240,255,0,224,255,1,224,255,1,224,255,1,224,255,3,192,255,3,192,255,3,192,255,3,128,255,7,128,255,7,128,255,7,128,255,7,0,255,15,0,255,15,0,255,15,0,255,31,0,254,31,0,254,31,0,254,31,0,254,63,0,252,63,0,252,63,0,252,63,0,248,127,0,248,127,0,248,127,0,248,255,0,240,255,0,240,255,0,240,255,0,240,255,1,224,255,1,224,255,1,224,255,1,192,255,3,192,255,3,192,255,3,192,255,3,128,255,7,128,255,7,128,255,7,128,255,15,0,255,15,0,255,15,0,255,15,0,255,31,0,254,31,0,254,31,0,254,31,0,252,63,0,252,63,0,252,63,0,252,127,0,248,127,0,248,127,0,248,127,0,248,255,0,240,255,0,240,255,0,240,255,0,224,255,1,224,255,1,224,255,1,224,255,1,192,255,3,192,255,3,192,255,3,192,255,7,128,255,7,128,255,7,128,255,7,0,255,15,0,255,15,0,255,15,0,255,15,0,254,31,0,254,31,0,254,31,0,254,63,0,252,63,0,252,63,0,252,63,0,252,127,0,248,127,0,248,127,0,248,127,0,240,255,0,240,255,0,240,255,0,240,255,0,224,255,1,224,255,1,224,255,1,224,255,3,192,255,3,192,255,3,192,255,3,128,255,7,128,255,7,128,255,7,128,255,7,0,255,15,0,255,15,0,255,15,0,255,31,0,254,31,0,254,31,0,254,31,0,254,63,0,252,63,0,252,63,0,252,63,0,248,127,0,248,127,0,248,127,0,248,255,0,240,255,0,240,255,0,240,255,0,240,255,1,224,255,1,224,255,1,224,255,1,192,255,3,192,255,3,192,255,3,192,255,3,128,255,7,128,255,7,128,255,7,128,255,15,0,255,15,0,255,15,0,255,15,0,255,31,0,254,31,0,254,31,0,254,31,0,252,63,0,252,63,0,252,63,0,252,127,0,248,127,0,248,127,0,248,127,0,248,255,0,240,255,0,240,255,0,240,255,0,224,255,1,224,255,1,224,255,1,224,255,1,192,255,3