sound: db 235,32,255,255,223,255,255,255,255,255,255,11,252,255,127,1,250,255,255,255,254,255,255,255,255,255,119,232,255,255,159,251,255,255,255,251,255,255,255,255,255,31,225,255,255,207,203,255,255,255,207,255,255,255,255,255,127,0,254,255,63,0,254,255,255,127,252,255,255,255,255,255,1,240,255,255,0,248,255,255,255,225,255,255,255,255,255,7,192,255,255,7,224,255,255,255,15,255,255,255,255,255,255,255,254,255,255,191,255,255,255,31,248,255,255,15,252,255,255,251,255,255,255,255,255,255,127,128,255,255,63,240,255,255,239,255,255,255,255,255,255,255,3,254,255,255,224,255,255,255,255,255,255,255,255,255,255,15,248,255,255,131,255,255,255,255,255,255,255,255,255,255,63,224,255,255,31,254,255,255,255,255,251,255,255,255,255,255,128,255,255,127,248,255,255,255,255,239,255,239,255,255,255,31,254,255,31,224,255,31,128,255,63,0,252,255,255,255,63,248,255,63,192,255,127,0,254,255,0,248,255,255,255,127,192,255,255,0,255,255,0,248,255,7,240,255,255,255,255,1,255,255,1,252,255,1,224,255,63,192,255,255,255,255,3,252,255,3,240,255,7,128,255,255,129,255,231,255,255,7,240,255,15,192,255,15,0,255,255,15,255,143,255,255,31,192,255,31,128,255,31,0,254,255,127,128,255,255,255,192,255,255,31,240,255,63,0,248,255,255,7,254,255,255,3,255,255,127,128,255,255,0,224,255,255,63,240,255,255,15,252,255,255,1,254,255,3,128,255,255,255,192,255,255,127,224,255,255,3,248,255,15,0,252,255,255,3,255,255,255,129,255,255,15,224,255,63,0,240,255,255,15,248,255,255,7,254,255,63,0,255,255,1,192,255,255,63,224,255,255,31,240,248,255,0,240,255,31,0,0,254,255,0,128,255,127,0,224,255,1,192,255,255,0,0,248,255,3,0,254,255,1,0,252,255,63,0,240,255,0,224,255,15,0,248,255,7,0,224,255,255,1,224,255,3,128,255,63,0,192,255,31,0,0,255,255,7,128,255,7,0,254,255,0,0,255,127,0,0,240,255,31,0,254,31,0,248,255,3,0,252,255,3,0,128,255,127,0,248,127,0,224,255,15,0,240,255,31,0,0,252,255,0,224,255,1,128,255,63,0,192,255,255,1,0,240,255,3,192,255,3,0,254,255,0,0,255,255,15,0,192,255,15,0,255,15,0,248,255,3,0,252,255,127,0,0,255,63,0,252,63,0,224,255,15,0,192,255,255,3,0,252,127,0,240,255,0,128,255,127,0,0,254,255,31,0,240,255,1,224,255,3,0,254,255,1,0,240,255,127,0,192,255,255,223,255,255,255,255,255,255,79,254,255,127,247,250,255,255,255,255,255,255,255,255,255,207,237,255,255,239,241,255,255,255,251,255,255,255,255,255,63,234,255,255,207,149,255,255,255,159,255,255,255,255,255,127,0,254,255,63,0,254,255,255,127,252,255,255,255,255,255,1,240,255,255,0,248,255,255,255,225,255,255,255,255,255,7,192,255,255,7,224,255,255,255,15,255,255,255,255,255,255,255,254,255,255,191,255,255,255,31,248,255,255,15,252,255,255,251,255,255,255,255,255,255,127,128,255,255,63,240,255,255,239,255,255,255,255,255,255,255,3,254,255,255,224,255,255,255,255,255,255,255,255,255,255,15,248,255,255,131,255,255,255,255,255,255,255,255,255,255,63,224,255,255,31,254,255,255,255,255,251,255,255,255,255,255,128,255,255,127,248,255,255,255,255,239,255,239,255,255,255,31,254,255,31,224,255,31,128,255,63,0,252,255,255,255,63,248,255,63,192,255,127,0,254,255,0,248,255,255,255,127,192,255,255,0,255,255,0,248,255,7,240,255,255,255,255,1,255,255,1,252,255,1,224,255,63,192,255,255,255,255,3,252,255,3,240,255,7,128,255,255,129,255,231,255,255,7,240,255,15,192,255,15,0,255,255,15,255,143,255,255,31,192,255,31,128,255,31,0,254,255,127,128,255,255,255,192,255,255,31,240,255,63,0,248,255,255,7,254,255,255,3,255,255,127,128,255,255,0,224,255,255,63,240,255,255,15,252,255,255,1,254,255,3,128,255,255,255,192,255,255,127,224,255,255,3,248,255,15,0,252,255,255,3,255,255,255,129,255,255,15,224,255,63,0,240,255,255,15,248,255,255,7,254,255,63,0,255,255,1,192,255,255,63,224,255,255,31,240,248,255,0,240,255,31,0,0,254,255,0,128,255,127,0,224,255,1,192,255,255,0,0,248,255,3,0,254,255,1,0,252,255,63,0,240,255,0,224,255,15,0,248,255,7,0,224,255,255,1,224,255,3,128,255,63,0,192,255,31,0,0,255,255,7,128,255,7,0,254,255,0,0,255,127,0,0,240,255,31,0,254,31,0,248,255,3,0,252,255,3,0,128,255,127,0,248,127,0,224,255,15,0,240,255,31,0,0,252,255,0,224,255,1,128,255,63,0,192,255,255,1,0,240,255,3,192,255,3,0,254,255,0,0,255,255,15,0,192,255,15,0,255,15,0,248,255,3,0,252,255,127,0,0,255,63,0,252,63,0,224,255,15,0,192,255,255,3,0,252,127,0,240,255,0,128,255,127,0,0,254,255,31,0,240,255,1,224,255,3,0,254,255,1,0,240,255,127,0,192,255,255,95,254,255,255,255,255,207,149,255,255,127,116,39,252,255,127,230,251,255,255,255,243,255,255,255,255,191,17,250,255,255,191,40,252,255,255,215,255,255,255,255,215,255,255,255,255,255,181,128,255,255,31,0,224,255,255,63,0,255,255,255,127,254,255,248,255,255,7,0,252,255,255,0,192,255,255,255,1,248,255,255,255,243,255,195,255,255,31,0,224,255,255,15,0,255,255,255,15,254,255,63,0,254,255,31,0,254,255,1,128,255,255,3,0,254,255,31,0,252,255,255,1,248,255,127,0,248,255,7,0,252,255,15,0,248,255,127,0,240,255,255,7,224,255,255,1,224,255,31,0,224,255,63,0,224,255,255,1,192,255,255,63,128,255,255,7,128,255,127,0,128,255,255,0,0,255,255,3,0,255,255,255,1,254,255,63,0,254,255,3,0,252,255,3,0,252,255,15,254,63,255,255,255,1,252,255,31,224,255,255,0,224,255,31,0,254,255,31,240,255,255,255,255,31,224,255,255,0,255,255,7,128,255,255,0,240,255,255,128,255,255,15,248,255,255,199,255,143,255,255,127,0,252,255,3,0,255,255,7,248,255,63,192,255,255,31,254,127,254,255,255,3,224,255,31,0,248,255,31,192,255,255,1,252,255,63,224,255,255,255,255,63,128,255,255,1,128,255,255,255,225,255,255,255,255,255,255,255,241,255,255,255,3,252,255,255,3,248,255,255,7,255,255,255,255,255,255,255,231,255,255,255,15,224,255,255,15,224,255,255,31,252,255,255,223,255,255,255,159,255,255,255,63,128,255,255,63,0,255,255,127,240,255,255,127,254,255,255,127,254,255,255,255,0,254,255,255,0,248,255,255,193,255,255,255,241,255,255,255,241,255,255,255,3,252,255,255,3,224,255,7,0,254,63,0,192,255,63,0,128,255,255,0,0,240,255,255,0,0,255,63,0,248,255,1,0,254,255,1,0,254,255,3,0,192,255,255,3,0,252,255,0,224,255,7,0,240,255,15,0,240,255,15,0,128,255,255,7,0,224,255,3,0,255,63,0,192,255,63,0,128,255,127,0,192,255,15,0,254,255,1,0,224,255,255,1,0,254,255,1,0,254,255,3,0,254,63,0,240,255,7,0,128,255,255,7,0,240,255,15,0,240,255,15,0,248,255,0,192,255,31,0,0,255,255,15,0,192,255,127,0,128,255,127,0,224,255,7,0,255,255,0,0,252,255,63,0,0,254,255,1,0,254,255,3,128,255,31,0,252,255,7,0,248,255,127,0,0,240,255,15,0,240,255,15,0,252,127,0,224,255,31,0,192,255,255,1,0,224,255,127,0,128,255,63,0,240,255,255,255,127,254,255,255,255,255,255,94,255,255,255,50,212,254,255,255,196,254,255,255,255,246,255,247,255,255,127,133,255,255,255,203,206,251,255,255,191,236,255,255,255,247,255,255,255,255,255,165,128,255,255,31,0,224,255,255,63,0,255,255,255,127,254,255,248,255,255,7,0,252,255,255,0,192,255,255,255,1,248,255,255,255,243,255,195,255,255,31,0,224,255,255,15,0,255,255,255,15,254,255,63,0,254,255,31,0,254,255,1,128,255,255,3,0,254,255,31,0,252,255,255,1,248,255,127,0,248,255,7,0,252,255,15,0,248,255,127,0,240,255,255,7,224,255,255,1,224,255,31,0,224,255,63,0,224,255,255,1,192,255,255,63,128,255,255,7,128,255,127,0,128,255,255,0,0,255,255,3,0,255,255,255,1,254,255,63,0,254,255,3,0,252,255,3,0,252,255,15,254,63,255,255,255,1,252,255,31,224,255,255,0,224,255,31,0,254,255,31,240,255,255,255,255,31,224,255,255,0,255,255,7,128,255,255,0,240,255,255,128,255,255,15,248,255,255,199,255,143,255,255,127,0,252,255,3,0,255,255,7,248,255,63,192,255,255,31,254,127,254,255,255,3,224,255,31,0,248,255,31,192,255,255,1,252,255,63,224,255,255,255,255,63,128,255,255,1,128,255,255,255,225,255,255,255,255,255,255,255,241,255,255,255,3,252,255,255,3,248,255,255,7,255,255,255,255,255,255,255,231,255,255,255,15,224,255,255,15,224,255,255,31,252,255,255,223,255,255,255,159,255,255,255,63,128,255,255,63,0,255,255,127,240,255,255,127,254,255,255,127,254,255,255,255,0,254,255,255,0,248,255,255,193,255,255,255,241,255,255,255,241,255,255,255,3,252,255,255,3,224,255,7,0,254,63,0,192,255,63,0,128,255,255,0,0,240,255,255,0,0,255,63,0,248,255,1,0,254,255,1,0,254,255,3,0,192,255,255,3,0,252,255,0,224,255,7,0,240,255,15,0,240,255,15,0,128,255,255,7,0,224,255,3,0,255,63,0,192,255,63,0,128,255,127,0,192,255,15,0,254,255,1,0,224,255,255,1,0,254,255,1,0,254,255,3,0,254,63,0,240,255,7,0,128,255,255,7,0,240,255,15,0,240,255,15,0,248,255,0,192,255,31,0,0,255,255,15,0,192,255,127,0,128,255,127,0,224,255,7,0,255,255,0,0,252,255,63,0,0,254,255,1,0,254,255,3,128,255,31,0,252,255,7,0,248,255,127,0,0,240,255,15,0,240,255,15,0,252,127,0,224,255,31,0,192,255,255,1,0,224,255,127,0,128,255,63,0,240,255,255,255,247,255,235,255,255,165,206,255,255,239,251,255,255,255,252,255,255,255,255,239,251,255,255,248,252,255,255,191,249,255,255,255,255,150,254,255,127,193,255,255,255,219,255,255,255,255,127,206,255,255,7,224,255,255,127,254,31,254,255,15,0,248,255,255,0,240,255,255,15,255,223,255,255,7,0,255,255,31,128,255,255,255,193,255,255,255,255,7,128,255,255,3,252,255,255,63,252,255,255,63,255,247,255,255,135,255,255,127,252,255,255,225,255,127,0,254,255,255,241,255,255,191,255,255,255,252,255,127,192,255,255,3,254,255,255,255,255,255,255,255,255,63,248,255,255,192,255,255,63,254,255,255,255,255,251,63,255,255,127,248,255,255,199,255,255,15,254,255,7,224,255,255,63,255,255,255,249,255,255,207,255,255,3,252,255,63,224,255,255,255,255,255,255,255,255,255,131,255,255,15,128,255,255,195,255,243,255,255,193,255,255,224,255,63,0,254,127,0,254,255,0,255,127,128,255,255,255,255,129,255,255,0,248,127,0,252,63,0,254,255,7,255,255,255,255,3,252,255,1,252,255,0,252,255,0,248,255,127,252,31,255,255,15,252,255,7,254,255,3,240,255,3,240,255,15,248,255,15,252,255,255,255,15,248,255,7,128,255,7,192,255,1,240,255,255,248,127,254,255,63,224,255,255,193,255,255,223,255,255,255,252,255,255,7,240,255,63,224,255,255,227,255,255,31,255,255,255,192,255,255,255,255,254,127,252,255,255,131,255,255,31,248,255,255,254,223,255,255,255,255,127,192,255,255,3,254,255,31,254,255,255,252,255,255,207,255,255,127,0,255,255,3,254,255,31,255,255,255,241,255,255,15,252,255,127,255,255,255,131,255,255,63,248,255,255,193,255,255,224,255,1,128,255,255,1,0,254,127,0,224,255,1,240,255,0,224,255,7,0,248,255,15,0,240,255,1,240,127,0,240,255,3,0,255,63,0,128,255,255,0,252,3,0,248,255,1,192,255,15,0,252,31,0,255,31,0,240,255,31,0,224,255,7,0,254,31,0,255,7,0,254,127,0,0,255,255,1,0,255,15,128,255,7,0,255,63,0,240,255,3,0,248,255,15,128,63,0,128,255,15,0,252,255,0,224,255,0,240,255,1,0,255,255,3,0,254,127,0,224,255,0,248,127,0,224,255,7,0,240,255,31,0,248,255,0,248,63,0,240,255,3,128,255,63,0,0,255,127,0,248,63,0,252,255,0,192,255,15,0,254,15,128,255,15,0,224,255,127,0,224,255,7,0,255,7,128,255,7,0,254,127,0,0,254,255,1,128,255,7,192,255,3,128,255,31,0,248,255,255,255,255,255,247,255,255,11,255,255,255,231,14,255,255,255,243,255,255,255,255,229,254,255,255,149,252,255,255,255,253,255,255,255,255,54,254,255,255,178,255,255,255,243,255,255,255,255,127,138,255,255,7,224,255,255,127,254,31,254,255,15,0,248,255,255,0,240,255,255,15,255,223,255,255,7,0,255,255,31,128,255,255,255,193,255,255,255,255,7,128,255,255,3,252,255,255,63,252,255,255,63,255,247,255,255,135,255,255,127,252,255,255,225,255,127,0,254,255,255,241,255,255,191,255,255,255,252,255,127,192,255,255,3,254,255,255,255,255,255,255,255,255,63,248,255,255,192,255,255,63,254,255,255,255,255,251,63,255,255,127,248,255,255,199,255,255,15,254,255,7,224,255,255,63,255,255,255,249,255,255,207,255,255,3,252,255,63,224,255,255,255,255,255,255,255,255,255,131,255,255,15,128,255,255,195,255,243,255,255,193,255,255,224,255,63,0,254,127,0,254,255,0,255,127,128,255,255,255,255,129,255,255,0,248,127,0,252,63,0,254,255,7,255,255,255,255,3,252,255,1,252,255,0,252,255,0,248,255,127,252,31,255,255,15,252,255,7,254,255,3,240,255,3,240,255,15,248,255,15,252,255,255,255,15,248,255,7,128,255,7,192,255,1,240,255,255,248,127,254,255,63,224,255,255,193,255,255,223,255,255,255,252,255,255,7,240,255,63,224,255,255,227,255,255,31,255,255,255,192,255,255,255,255,254,127,252,255,255,131,255,255,31,248,255,255,254,223,255,255,255,255,127,192,255,255,3,254,255,31,254,255,255,252,255,255,207,255,255,127,0,255,255,3,254,255,31,255,255,255,241,255,255,15,252,255,127,255,255,255,131,255,255,63,248,255,255,193,255,255,224,255,1,128,255,255,1,0,254,127,0,224,255,1,240,255,0,224,255,7,0,248,255,15,0,240,255,1,240,127,0,240,255,3,0,255,63,0,128,255,255,0,252,3,0,248,255,1,192,255,15,0,252,31,0,255,31,0,240,255,31,0,224,255,7,0,254,31,0,255,7,0,254,127,0,0,255,255,1,0,255,15,128,255,7,0,255,63,0,240,255,3,0,248,255,15,128,63,0,128,255,15,0,252,255,0,224,255,0,240,255,1,0,255,255,3,0,254,127,0,224,255,0,248,127,0,224,255,7,0,240,255,31,0,248,255,0,248,63,0,240,255,3,128,255,63,0,0,255,127,0,248,63,0,252,255,0,192,255,15,0,254,15,128,255,15,0,224,255,127,0,224,255,7,0,255,7,128,255,7,0,254,127,0,0,254,255,1,128,255,7,192,255,3,128,255,31,0,248,255,255,255,143,255,255,255,255,254,255,255,255,255,255,255,255,255,251,248,255,255,127,193,255,255,255,235,254,255,255,255,255,223,255,255,255,213,252,255,255,159,195,255,255,191,218,255,255,191,255,255,255,255,7,252,255,255,255,255,15,254,255,31,0,240,255,255,0,192,255,255,15,128,255,255,255,241,255,255,255,159,255,255,255,255,255,7,248,255,63,0,240,255,255,3,248,255,255,63,128,255,255,255,224,255,255,191,255,207,255,255,255,243,255,207,255,255,255,243,255,255,255,253,255,255,127,192,255,255,63,224,255,255,207,255,247,255,255,255,252,255,255,255,255,255,240,255,255,127,252,255,255,31,248,255,255,15,240,255,255,227,255,255,255,255,255,255,255,255,255,255,63,240,255,255,31,252,255,255,231,255,251,255,255,63,254,255,252,255,255,127,252,255,255,191,255,255,255,15,252,255,255,31,252,255,31,240,255,31,128,255,63,0,252,255,255,255,63,252,255,63,0,255,127,0,248,255,0,248,127,254,255,127,248,255,255,128,255,255,0,240,255,127,240,255,252,255,255,1,255,255,1,252,255,1,240,255,7,192,255,255,255,255,131,255,255,3,224,255,15,128,255,255,255,255,7,255,255,7,254,255,15,240,255,15,0,255,255,63,255,143,255,255,31,224,255,31,0,254,63,0,254,255,3,128,255,255,63,192,255,255,15,240,255,255,7,248,255,255,127,254,255,255,7,255,255,15,128,255,255,1,224,255,255,63,240,255,255,15,252,255,255,3,254,255,255,191,255,255,255,195,255,255,7,224,255,255,1,248,255,255,3,252,255,255,15,255,255,255,131,255,255,7,224,255,63,0,240,255,255,7,248,255,255,1,254,255,127,0,255,255,255,207,255,255,255,225,255,255,3,240,255,63,0,192,255,255,3,0,252,255,1,0,255,127,0,224,255,255,3,0,248,127,0,240,255,1,0,255,63,0,224,255,127,0,0,252,255,3,0,254,127,0,240,255,0,224,255,15,0,192,255,255,1,0,255,127,0,192,255,31,0,128,255,255,3,0,254,63,0,248,127,0,224,255,15,0,248,255,63,0,0,255,127,0,192,255,31,0,252,127,0,240,255,255,31,0,252,63,0,224,255,15,0,248,255,7,0,192,255,127,0,192,255,31,0,254,63,0,248,255,1,0,252,255,31,0,224,255,15,0,248,255,3,0,248,255,63,0,192,255,15,0,255,31,0,248,255,1,0,255,255,3,0,192,255,31,0,248,255,3,0,255,15,0,254,127,0,0,252,255,15,0,248,255,3,0,254,255,0,0,252,255,31,0,240,255,3,128,255,7,0,255,127,0,192,255,255,3,0,248,255,255,223,255,255,255,255,255,255,255,255,255,127,194,255,255,214,232,255,255,191,187,255,255,255,22,255,255,255,191,255,223,255,255,127,102,248,255,255,191,101,255,255,235,219,255,255,127,243,255,255,255,7,252,255,255,255,255,15,254,255,31,0,240,255,255,0,192,255,255,15,128,255,255,255,241,255,255,255,159,255,255,255,255,255,7,248,255,63,0,240,255,255,3,248,255,255,63,128,255,255,255,224,255,255,191,255,207,255,255,255,243,255,207,255,255,255,243,255,255,255,253,255,255,127,192,255,255,63,224,255,255,207,255,247,255,255,255,252,255,255,255,255,255,240,255,255,127,252,255,255,31,248,255,255,15,240,255,255,227,255,255,255,255,255,255,255,255,255,255,63,240,255,255,31,252,255,255,231,255,251,255,255,63,254,255,252,255,255,127,252,255,255,191,255,255,255,15,252,255,255,31,252,255,31,240,255,31,128,255,63,0,252,255,255,255,63,252,255,63,0,255,127,0,248,255,0,248,127,254,255,127,248,255,255,128,255,255,0,240,255,127,240,255,252,255,255,1,255,255,1,252,255,1,240,255,7,192,255,255,255,255,131,255,255,3,224,255,15,128,255,255,255,255,7,255,255,7,254,255,15,240,255,15,0,255,255,63,255,143,255,255,31,224,255,31,0,254,63,0,254,255,3,128,255,255,63,192,255,255,15,240,255,255,7,248,255,255,127,254,255,255,7,255,255,15,128,255,255,1,224,255,255,63,240,255,255,15,252,255,255,3,254,255,255,191,255,255,255,195,255,255,7,224,255,255,1,248,255,255,3,252,255,255,15,255,255,255,131,255,255,7,224,255,63,0,240,255,255,7,248,255,255,1,254,255,127,0,255,255,255,207,255,255,255,225,255,255,3,240,255,63,0,192,255,255,3,0,252,255,1,0,255,127,0,224,255,255,3,0,248,127,0,240,255,1,0,255,63,0,224,255,127,0,0,252,255,3,0,254,127,0,240,255,0,224,255,15,0,192,255,255,1,0,255,127,0,192,255,31,0,128,255,255,3,0,254,63,0,248,127,0,224,255,15,0,248,255,63,0,0,255,127,0,192,255,31,0,252,127,0,240,255,255,31,0,252,63,0,224,255,15,0,248,255,7,0,192,255,127,0,192,255,31,0,254,63,0,248,255,1,0,252,255,31,0,224,255,15,0,248,255,3,0,248,255,63,0,192,255,15,0,255,31,0,248,255,1,0,255,255,3,0,192,255,31,0,248,255,3,0,255,15,0,254,127,0,0,252,255,15,0,248,255,3,0,254,255,0,0,252,255,31,0,240,255,3,128,255,7,0,255,127,0,192,255,255,3,0,248,176,117,212,106,22,24,171,52,163,167,46,207,162,121,0,35,156,233,72,127,235,149,128,198,203,53,227,112,64,131,17,84,151,206,174,18,107,157,144,9,0,0,0,0,0,0,0,0,0,0,0,0,0,0,0,0,0,0,0,0,0,0,0,0,0,0,0,0,0,0,0,0,0,0,0,0,0,0,0,0,0,0,0,0,0,0,0,0,0,0,0,0,0,0,0,0,0,0,0,0,0,0,0,0,0,0,0,0,0,0,0,0,0,0,0,0,0,0,0,0,0,0,0,0,0,0,0,0,0,0,0,0,0,0,0,0,0,0,0,0,0,0,0,0,0,0,0,0,0,0,0,0,0,0,0,0,0,0,0,0,0,0,0,0,0,0,0,0,0,0,0,0,0,0,0,0,0,0,0,0,0,0,0,0,0,0,0,0,0,0,0,0,0,0,0,0,0,0,0,0,0,0,0,0,0,0,0,0,0,0,0,0,0,0,0,0,0,0,0,0,0,0,0,0,0,0,0,0,0,0,0,0,0,0,0,0,0,0,0,0,0,0,0,0,0,0,0,0,0,0,184,152,212,243,94,78,165,74,116,36,202,41,159,2,253,61,246,22,42,120,115,17,28,212,121,240,247,149,116,218,8,229,106,213,95,235,232,105,141,193,0,0,0,0,0,0,0,0,0,0,0,0,0,0,0,0,0,0,0,0,0,0,0,0,0,0,0,0,0,0,0,0,0,0,0,0,0,0,0,0,0,0,0,0,0,0,0,0,0,0,0,0,0,0,0,0,0,0,0,0,0,0,0,0,0,0,0,0,0,0,0,0,0,0,0,0,0,0,0,0,0,0,0,0,0,0,0,0,0,0,0,0,0,0,0,0,0,0,0,0,0,0,0,0,0,0,0,0,0,0,0,0,0,0,0,0,0,0,0,0,0,0,0,0,0,0,0,0,0,0,0,0,0,0,0,0,0,0,0,0,0,0,0,0,0,0,0,0,0,0,0,0,0,0,0,0,0,0,0,0,0,0,0,0,0,0,0,0,0,0,0,0,0,0,0,0,0,0,0,0,0,0,0,0,0,0,0,0,0,0,0,0,0,0,0,0,0,0,0,209,11,132,4,71,71,44,136,2,31,44,244,238,185,181,138,23,231,173,220,1,38,24,99,19,43,213,109,203,118,8,243,82,55,0,101,72,143,152,214,0,0,0,0,0,0,0,0,0,0,0,0,0,0,0,0,0,0,0,0,0,0,0,0,0,0,0,0,0,0,0,0,0,0,0,0,0,0,0,0,0,0,0,0,0,0,0,0,0,0,0,0,0,0,0,0,0,0,0,0,0,0,0,0,0,0,0,0,0,0,0,0,0,0,0,0,0,0,0,0,0,0,0,0,0,0,0,0,0,0,0,0,0,0,0,0,0,0,0,0,0,0,0,0,0,0,0,0,0,0,0,0,0,0,0,0,0,0,0,0,0,0,0,0,0,0,0,0,0,0,0,0,0,0,0,0,0,0,0,0,0,0,0,0,0,0,0,0,0,0,0,0,0,0,0,0,0,0,0,0,0,0,0,0,0,0,0,0,0,0,0,0,0,0,0,0,0,0,0,0,0,0,0,0,0,0,0,0,91,65,30,77,243,252,183,131,28,203,169,77,135,9,41,188,102,69,107,214,157,230,149,214,121,214,196,9,252,118,195,134,229,61,43,226,24,178,59,21,0,0,0,0,0,0,0,0,0,0,0,0,0,0,0,0,0,0,0,0,0,0,0,0,0,0,0,0,0,0,0,0,0,0,0,0,0,0,0,0,0,0,0,0,0,0,0,0,0,0,0,0,0,0,0,0,0,0,0,0,0,0,0,0,0,0,0,0,0,0,0,0,0,0,0,0,0,0,0,0,0,0,0,0,0,0,0,0,0,0,0,0,0,0,0,0,0,0,0,0,0,0,0,0,0,0,0,0,0,0,0,0,0,0,0,0,0,0,0,0,0,0,0,0,0,0,0,0,0,0,0,0,0,0,0,0,0,0,0,0,0,0,0,0,0,0,0,0,0,0,0,0,0,0,0,0,0,0,0,0,0,0,0,0,0,0,0,0,0,0,0,0,0,0,0,0,0,180,69,17,141,246,86,123,212,99,211,8,123,254,179,213,121,100,94,252,107,97,21,25,70,55,206,146,237,83,73,253,184,86,23,12,175,11,39,173,148,0,0,0,0,0,0,0,0,0,0,0,0,0,0,0,0,0,0,0,0,0,0,0,0,0,0,0,0,0,0,0,0,0,0,0,0,0,0,0,0,0,0,0,0,0,0,0,0,0,0,0,0,0,0,0,0,0,0,0,0,0,0,0,0,0,0,0,0,0,0,0,0,0,0,0,0,0,0,0,0,0,0,0,0,0,0,0,0,0,0,0,0,0,0,0,0,0,0,0,0,0,0,0,0,0,0,0,0,0,0,0,0,0,0,0,0,0,0,0,0,0,0,0,0,0,0,0,0,0,0,0,0,0,0,0,0,0,0,0,0,0,0,0,0,0,0,0,0,0,0,0,0,0,0,0,0,0,0,0,0,0,0,0,0,0,0,92,97,87,47,198,176,99,34,189,6,74,77,74,94,24,194,62,173,226,23,232,32,113,61,249,28,103,133,224,243,0,48,63,104,76,246,71,17,135,117,0,0,0,0,0,0,0,0,0,0,0,0,0,0,0,0,0,0,0,0,0,0,0,0,0,0,0,0,0,0,0,0,0,0,0,0,0,0,0,0,0,0,0,0,0,0,0,0,0,0,0,0,0,0,0,0,0,0,0,0,0,0,0,0,0,0,0,0,0,0,0,0,0,0,0,0,0,0,0,0,0,0,0,0,0,0,0,0,0,0,0,0,0,0,0,0,0,0,0,0,0,0,0,0,0,0,0,0,0,0,0,0,0,0,0,0,0,0,0,0,0,0,0,0,0,0,0,0,0,0,0,0,0,0,0,0,0,0,0,0,0,0,0,0,0,0,0,0,0,0,0,0,0,0,0,186,102,189,97,132,239,66,48,133,143,8,75,38,170,227,92,178,224,198,224,20,245,21,16,89,14,13,21,221,253,88,211,114,248,106,241,41,216,192,230,0,0,0,0,0,0,0,0,0,0,0,0,0,0,0,0,0,0,0,0,0,0,0,0,0,0,0,0,0,0,0,0,0,0,0,0,0,0,0,0,0,0,0,0,0,0,0,0,0,0,0,0,0,0,0,0,0,0,0,0,0,0,0,0,0,0,0,0,0,0,0,0,0,0,0,0,0,0,0,0,0,0,0,0,0,0,0,0,0,0,0,0,0,0,0,0,0,0,0,0,0,0,0,0,0,0,0,0,0,0,0,0,0,0,0,0,0,0,0,0,0,0,0,0,0,0,0,0,0,0,0,0,0,0,0,0,0,0,0,0,0,0,0,0,129,115,155,91,100,57,48,235,191,188,187,228,211,222,68,22,88,255,136,114,83,119,96,210,116,188,166,222,54,113,86,227,222,218,167,224,39,178,188,207,0,0,0,0,0,0,0,0,0,0,0,0,0,0,0,0,0,0,0,0,0,0,0,0,0,0,0,0,0,0,0,0,0,0,0,0,0,0,0,0,0,0,0,0,0,0,0,0,0,0,0,0,0,0,0,0,0,0,0,0,0,0,0,0,0,0,0,0,0,0,0,0,0,0,0,0,0,0,0,0,0,0,0,0,0,0,0,0,0,0,0,0,0,0,0,0,0,0,0,0,0,0,0,0,0,0,0,0,0,0,0,0,0,0,0,0,0,0,0,0,0,0,0,0,0,0,0,0,0,0,0,0,0,36,139,201,128,235,110,235,81,113,141,128,219,65,189,31,16,169,184,32,92,140,156,141,207,80,228,109,96,234,106,126,142,52,252,118,23,15,13,102,213,0,0,0,0,0,0,0,0,0,0,0,0,0,0,0,0,0,0,0,0,0,0,0,0,0,0,0,0,0,0,0,0,0,0,0,0,0,0,0,0,0,0,0,0,0,0,0,0,0,0,0,0,0,0,0,0,0,0,0,0,0,0,0,0,0,0,0,0,0,0,0,0,0,0,0,0,0,0,0,0,0,0,0,0,0,0,0,0,0,0,0,0,0,0,0,0,0,0,0,0,0,0,0,0,0,0,0,0,0,0,0,0,0,0,0,0,0,0,0,0,0,0,84,144,201,119,202,90,146,11,195,1,26,228,51,241,207,20,38,184,235,150,179,26,164,43,72,36,173,134,164,188,74,60,208,132,162,165,216,218,179,35,0,0,0,0,0,0,0,0,0,0,0,0,0,0,0,0,0,0,0,0,0,0,0,0,0,0,0,0,0,0,0,0,0,0,0,0,0,0,0,0,0,0,0,0,0,0,0,0,0,0,0,0,0,0,0,0,0,0,0,0,0,0,0,0,0,0,0,0,0,0,0,0,0,0,0,0,0,0,0,0,0,0,0,0,0,0,0,0,0,0,0,0,0,0,0,0,0,0,0,0,0,0,0,0,0,0,0,0,0,0,0,221,90,116,185,117,151,221,186,214,10,117,62,175,245,80,233,126,230,70,124,184,211,120,77,214,28,112,230,94,229,125,71,219,8,230,30,113,75,95,27,0,0,0,0,0,0,0,0,0,0,0,0,0,0,0,0,0,0,0,0,0,0,0,0,0,0,0,0,0,0,0,0,0,0,0,0,0,0,0,0,0,0,0,0,0,0,0,0,0,0,0,0,0,0,0,0,0,0,0,0,0,0,0,0,0,0,0,0,0,0,0,0,0,0,0,0,0,0,0,0,0,0,0,0,0,0,0,0,0,0,0,0,0,0,0,0,0,0,0,0,191,45,65,7,80,3,122,117,19,189,178,19,13,14,100,195,242,147,197,221,7,5,202,74,13,54,44,19,67,234,205,137,239,13,20,163,29,254,141,2,0,0,0,0,0,0,0,0,0,0,0,0,0,0,0,0,0,0,0,0,0,0,0,0,0,0,0,0,0,0,0,0,0,0,0,0,0,0,0,0,0,0,0,0,0,0,0,0,0,0,0,0,0,0,0,0,0,0,0,0,0,0,0,0,0,0,0,0,0,0,0,0,0,0,0,0,0,0,0,0,0,0,0,0,0,0,0,0,0,192,153,222,60,241,220,128,114,217,156,235,157,246,73,133,59,26,176,195,219,254,65,34,84,14,22,224,82,41,231,17,139,53,120,93,75,88,2,19,159,0,0,0,0,0,0,0,0,0,0,0,0,0,0,0,0,0,0,0,0,0,0,0,0,0,0,0,0,0,0,0,0,0,0,0,0,0,0,0,0,0,0,0,0,0,0,0,0,0,0,0,0,0,0,0,0,0,0,0,0,0,0,0,0,0,0,0,0,0,0,0,0,0,0,0,0,0,0,51,239,38,16,29,39,4,199,61,35,227,201,145,189,106,255,98,170,200,122,154,84,52,236,226,1,173,152,48,132,97,112,31,135,44,89,211,55,144,186,0,0,0,0,0,0,0,0,0,0,0,0,0,0,0,0,0,0,0,0,0,0,0,0,0,0,0,0,0,0,0,0,0,0,0,0,0,0,0,0,0,0,0,0,0,0,0,0,0,0,0,0,0,0,0,0,0,0,0,0,0,0,0,0,0,0,0,243,137,58,113,38,129,206,91,247,209,20,147,159,83,116,99,200,239,193,23,10,235,187,188,247,50,244,54,237,103,49,223,215,58,114,52,92,128,4,28,0,0,0,0,0,0,0,0,0,0,0,0,0,0,0,0,0,0,0,0,0,0,0,0,0,0,0,0,0,0,0,0,0,0,0,0,0,0,0,0,0,0,0,0,0,0,0,0,0,0,0,0,0,0,0,0,6,239,245,145,199,201,110,73,134,79,231,131,46,196,247,208,65,24,59,235,4,150,225,226,143,50,206,118,227,135,12,171,138,66,142,101,135,111,243,121,0,0,0,0,0,0,0,0,0,0,0,0,0,0,0,0,0,0,0,0,0,0,0,0,0,0,0,0,0,0,0,0,0,0,0,0,0,0,0,0,0,0,0,0,0,192,18,105,200,78,112,132,180,89,176,22,243,76,115,29,187,253,113,219,198,40,248,237,156,45,118,213,123,232,80,48,228,196,40,44,12,55,55,252,84,0,0,0,0,0,0,0,0,0,0,0,0,0,0,0,0,0,0,0,0,0,0,0,0,0,0,0,0,0,0,0,0,0,0,172,180,61,100,126,82,36,45,198,220,32,119,15,169,79,38,47,231,129,2,177,212,171,57,221,220,157,184,57,125,243,180,191,27,195,220,20,141,117,194,0,0,0,0,0,0,0,0,0,0,0,0,0,0,0,0,0,0,0,0,0,0,69,49,234,120,198,164,96,232,116,139,17,115,60,195,110,48,41,151,133,67,89,13,127,223,151,176,98,220,220,22,181,68,176,222,245,132,131,246,106,137,0,0,0,0,0,0,0,0,0,0,0,202,36,111,131,5,88,221,176,157,37,19,117,162,211,94,6,176,8,209,241,169,11,220,113,21,111,174,61,156,125,138,40,106,49,76,176,157,175,201,217,207,251,90,159,223,251,182,95,233,86,175,189,156,221,255,205,92,209,238,59,222,110,118,127,189,242,230,175,138,207,223,223,73,255,127,95,237,143,178,151,214,191,124,146,168,252,120,238,239,189,245,189,218,239,95,237,152,240,255,213,55,223,215,255,253,249,23,91,247,239,187,127,206,223,233,254,123,207,251,25,251,253,255,222,40,115,215,167,238,209,250,254,239,187,251,102,249,92,236,109,255,214,247,157,239,175,243,222,235,170,203,211,202,127,249,167,31,188,249,79,255,0,192,255,255,63,0,224,255,7,128,255,3,224,255,7,0,254,255,255,3,0,255,127,0,224,255,255,7,0,240,255,3,0,255,3,240,255,3,128,255,239,255,1,128,255,63,0,240,255,255,0,0,248,255,1,128,255,3,240,255,0,224,255,227,255,0,192,255,31,0,248,255,63,0,0,252,255,0,192,255,3,224,63,0,248,255,192,255,0,224,255,7,0,252,255,7,0,0,255,127,0,224,255,7,224,15,0,254,63,192,255,0,240,255,3,0,254,255,0,0,128,255,63,0,240,255,7,224,3,128,255,15,192,255,0,248,255,1,0,255,63,0,0,192,255,31,0,248,255,3,224,0,224,255,3,128,255,0,248,255,0,128,255,31,0,0,224,255,15,0,252,255,1,32,224,248,255,0,192,255,1,248,127,0,192,255,15,0,0,240,255,7,0,254,255,0,0,248,254,63,0,224,255,1,248,63,0,224,255,7,0,0,248,255,3,0,255,63,0,0,255,255,31,0,248,255,1,248,31,0,240,255,3,0,0,254,255,1,128,255,31,0,224,255,255,15,0,252,255,1,248,63,0,248,255,1,64,192,255,127,0,192,255,15,0,248,255,255,7,0,254,255,0,240,63,0,254,127,0,112,248,255,63,0,224,255,7,0,252,255,255,3,0,255,127,0,240,63,0,255,31,0,124,126,254,31,0,240,255,3,0,254,255,255,1,128,255,63,0,240,63,192,254,7,0,255,31,254,15,0,248,255,1,0,255,255,255,0,192,255,31,0,248,127,16,254,1,192,255,7,252,15,0,252,255,0,128,255,255,63,0,224,255,15,0,252,127,0,126,0,240,255,1,252,15,0,254,127,0,192,255,255,7,0,240,255,3,0,254,127,0,30,0,252,127,0,252,15,0,255,63,0,240,255,255,0,0,248,255,1,0,255,63,0,6,0,255,31,0,252,31,128,255,31,0,248,255,63,0,0,252,255,0,128,255,31,0,0,192,255,15,0,252,31,128,255,15,0,252,255,7,0,0,254,127,0,192,255,15,0,0,240,255,7,0,254,31,128,255,7,0,254,127,0,0,0,255,63,0,224,255,7,0,0,248,255,3,0,255,31,128,255,3,0,255,31,0,4,128,255,31,0,240,255,3,0,0,255,255,1,128,255,31,0,255,3,192,255,7,0,7,192,255,15,0,248,255,1,0,224,255,255,0,192,255,15,0,255,3,240,255,1,192,7,224,255,7,0,252,255,0,0,252,255,63,0,224,255,7,0,255,3,252,127,0,240,7,224,255,3,0,255,127,0,0,255,255,31,0,240,255,3,0,255,3,255,31,0,252,7,192,255,1,128,255,63,0,224,255