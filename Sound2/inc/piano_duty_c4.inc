sound: db 88,2,255,255,7,128,255,255,1,192,255,255,0,240,255,63,0,248,255,31,0,254,255,7,0,255,255,3,128,255,255,0,224,255,127,0,240,255,31,0,252,255,15,0,254,255,3,128,255,255,1,192,255,127,0,224,255,63,0,248,255,15,0,252,255,3,0,255,255,1,128,255,127,0,224,255,63,0,240,255,15,0,248,255,7,0,254,255,1,0,255,255,0,192,255,63,0,224,255,31,0,240,255,7,0,252,255,3,0,254,255,0,128,255,127,0,192,255,31,0,240,255,15,0,248,255,3,0,252,255,1,0,255,127,0,128,255,63,0,224,255,15,0,240,255,7,0,252,255,1,0,254,255,0,0,255,63,0,192,255,15,0,224,255,7,0,248,255,1,0,252,255,0,0,255,63,0,128,255,31,0,192,255,7,0,240,255,3,0,248,255,0,0,254,127,0,0,255,31,0,128,255,15,0,224,255,3,0,240,255,1,0,252,127,0,0,254,63,0,128,255,15,0,192,255,7,0,224,255,1,0,248,255,0,0,252,63,0,0,255,31,0,128,255,7,0,224,255,3,0,240,255,0,0,248,63,0,0,254,31,0,0,255,7,0,192,255,3,0,224,255,0,0,240,127,0,0,252,31,0,0,254,15,0,128,255,3,0,192,255,1,0,240,127,0,0,248,63,0,0,252,15,0,0,255,7,0,128,255,1,0,224,255,0,0,240,63,0,0,252,31,0,0,254,7,0,0,255,3,0,192,255,0,0,224,127,0,0,248,31,0,0,252,15,0,0,255,3,0,128,255,1,0,192,127,0,0,240,31,0,0,248,15,0,0,254,3,0,0,255,1,0,128,127,0,0,224,63,0,0,240,15,0,0,252,7,0,0,254,1,0,128,255,0,0,192,63,0,0,224,31,0,0,248,7,0,0,252,3,0,0,255,0,0,128,127,0,0,224,31,0,0,240,15,0,0,248,3,0,0,254,1,0,0,127,0,0,192,63,0,0,224,15,0,0,248,7,0,0,252,1,0,0,126,0,0,128,63,0,0,192,15,0,0,240,7,0,0,248,1,0,0,252,0,0,0,63,0,0,128,31,0,0,224,7,0,0,240,3,0,0,252,0,0,0,126,0,0,0,31,0,0,192,15,0,0,224,3,0,0,248,1,0,0,124,0,0,0,63,0,0,128,15,0,0,192,7,0,0,240,1,0,0,248,0,0,0,62,0,0,0,31,0,0,128,7,0,0,224,1,0,0,240,0,0,0,60,0,0,0,30,0,0,128,7,0,0,192,3,0,0,224,0,0,0,120,0,0,0,28,0,0,0,15,0,0,128,3,0,0,224,1,0,0,112,0,0,0,56,0,0,0