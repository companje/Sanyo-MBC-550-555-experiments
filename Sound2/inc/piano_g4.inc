sound: db 88,2,254,7,224,127,0,254,15,192,255,0,252,15,128,255,1,248,31,128,255,3,240,63,0,255,3,224,127,0,254,7,224,255,0,252,15,192,255,0,248,31,128,255,1,248,63,0,255,3,240,63,0,254,7,224,127,0,254,15,192,255,0,252,15,128,255,1,248,31,0,255,3,240,63,0,255,7,224,127,0,254,7,192,255,0,252,15,192,255,1,248,31,128,255,1,240,63,0,255,3,240,127,0,254,7,224,127,0,252,15,192,255,0,252,31,128,255,1,248,31,0,255,3,240,63,0,254,7,224,127,0,254,15,192,255,0,252,15,128,255,1,248,31,128,255,3,240,63,0,255,3,224,127,0,254,7,224,255,0,252,15,192,255,0,248,31,128,255,1,248,63,0,255,3,240,63,0,254,7,224,127,0,254,15,192,255,0,252,15,128,255,1,248,31,0,255,3,240,63,0,255,7,224,127,0,254,7,192,255,0,252,15,192,255,1,248,31,128,255,1,240,63,0,255,3,240,127,0,254,7,224,127,0,252,15,192,255,0,252,31,128,255,1,248,31,0,255,3,240,63,0,254,7,224,127,0,254,15,192,255,0,252,15,128,255,1,248,31,128,255,3,240,63,0,255,3,224,127,0,254,7,224,255,0,252,15,192,255,0,248,31,128,255,1,248,63,0,255,3,240,63,0,254,7,224,127,0,254,15,192,255,0,252,31,128,255,1,248,31,0,255,3,240,63,0,255,7,224,127,0,254,7,192,255,0,252,15,192,255,1,248,31,128,255,1,240,63,0,255,3,240,127,0,254,7,224,127,0,252,15,192,255,0,252,31,128,255,1,248,31,0,255,3,240,63,0,254,7,224,127,0,254,15,192,255,0,252,15,128,255,1,248,31,128,255,3,240,63,0,255,3,224,127,0,254,7,224,255,0,252,15,192,255,0,248,31,128,255,1,248,63,0,255,3,240,63,0,254,7,224,127,0,254,15,192,255,0,252,15,128,255,1,248,31,0,255,3,240,63,0,255,7,224,127,0,254,7,192,255,0,252,15,192,255,1,248,31,128,255,1,240,63,0,255,3,240,127,0,254,7,224,127,0,252,15,192,255,0,252,31,128,255,1,248,31,0,255,3,240,63,0,254,7,224,127,0,254,15,192,255,0,252,15,128,255,1,248,31,128,255,3,240,63,0,255,3,224,127,0,254,7,224,255,0,252,15,192,255,0,248,31,128,255,1,248,63,0,255,3,240,63,0,254,7,224,127,0,254,15,192,255,0,252,15,128,255,1,248,31,0,255,3,240,63,0,255,7,224,127,0,254,7,192,255,0,252,15,192,255,1,248,31,128,255,1,240,63,0,255,3,112