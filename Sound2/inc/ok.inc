sound: db 14,227,7,126,128,255,1,255,3,248,124,192,15,240,63,224,127,128,127,248,192,31,240,127,192,63,128,127,0,63,240,3,252,15,248,31,224,15,226,7,254,128,255,3,255,7,252,3,252,129,31,224,127,192,255,0,127,0,63,240,3,252,15,248,31,224,15,224,7,254,128,255,3,255,7,252,3,252,128,31,240,127,192,255,0,127,0,63,240,3,252,15,248,31,224,31,192,15,252,1,254,7,254,7,248,47,192,15,248,1,240,7,248,31,224,127,128,63,240,7,224,63,224,127,128,127,133,241,3,254,0,254,3,252,15,224,191,16,127,224,15,224,127,128,255,0,254,42,140,31,248,3,248,31,224,63,128,63,40,141,31,240,7,248,31,224,127,0,127,80,156,63,240,7,248,63,224,127,0,255,130,194,248,1,63,128,255,1,254,3,248,3,120,141,31,240,7,248,31,224,63,128,127,0,190,132,31,248,3,248,31,224,63,192,127,0,157,198,15,248,1,254,15,240,63,224,239,2,30,226,15,252,1,252,31,240,255,1,254,7,212,199,15,248,3,14,254,128,131,63,224,225,15,122,252,1,126,224,129,63,240,193,31,120,224,15,142,63,224,15,60,240,7,31,252,129,15,254,192,249,3,254,192,3,127,224,129,31,248,224,15,248,3,254,192,3,127,224,129,63,248,192,15,252,1,254,224,129,63,240,193,31,248,224,15,63,224,15,60,240,7,31,248,129,31,254,63,192,31,120,224,15,62,240,3,31,252,15,240,7,30,248,131,15,254,192,3,254,1,127,224,129,63,248,192,31,124,224,15,240,3,15,252,129,7,254,208,195,31,240,7,31,248,129,15,254,192,227,7,252,192,7,127,224,131,63,240,15,224,15,30,248,3,15,252,1,127,128,63,120,224,15,60,240,7,252,1,254,192,131,63,240,193,31,240,7,248,3,15,252,192,3,127,224,15,224,15,124,248,3,30,126,193,243,129,31,240,225,7,252,255,0,255,31,2,126,104,128,159,95,129,63,0,84,85,85,85,85,169,170,170,170,170,170,170,170,170,170,170,170,170,170,170,170,170,170,170,170,170,170,170,170,170,170,170,170,170,170,170,170,170,170,170,170,170,170,170,170,170,170,170,170,170,170,170,170,170,170,170,170,170,170,170,170,170,170,170,170,170,170,170,170,170,170,170,170,170,170,170,170,170,170,170,170,170,170,146,54,130,37,147,182,12,77,27,90,38,201,38,219,146,164,174,164,78,54,151,109,36,169,156,70,31,141,165,141,114,75,150,139,172,164,168,96,155,78,74,214,60,149,100,109,89,179,55,54,219,101,216,128,31,248,3,252,1,127,148,99,2,126,192,31,224,7,252,145,142,25,248,3,127,128,63,240,7,214,96,3,126,224,31,240,7,254,128,18,108,192,15,248,7,254,192,31,240,26,110,224,15,252,3,126,192,31,240,26,108,192,15,248,7,252,192,31,240,37,216,128,31,240,15,248,1,63,224,151,134,27,248,3,127,128,63,240,7,254,213,120,3,127,192,15,240,7,254,192,31,104,199,12,252,128,63,192,15,248,1,63,208,26,110,224,15,252,1,254,192,63,240,7,188,4,27,240,3,254,128,63,224,15,252,1,253,130,31,248,3,252,0,127,192,63,224,31,224,181,248,1,254,0,254,1,254,3,252,7,248,87,218,31,224,31,224,63,192,127,128,255,0,255,64,235,15,240,15,240,31,224,63,192,127,128,127,80,218,15,240,15,240,31,224,63,192,127,128,127,128,214,15,240,15,240,31,192,127,128,255,0,254,163,150,63,192,127,0,255,3,240,63,0,254,3,168,149,187,128,254,3,240,255,0,252,31,0,255,99,165,255,1,252,7,224,255,0,248,31,0,255,85,45,127,1,252,7,224,255,0,240,63,0,254,87,106,127,3,252,15,128,255,1,240,63,0,254,143,90,255,2,248,15,128,255,1,224,127,0,172,90,233,11,232,63,0,255,7,192,255,1,240,43,189,9,244,31,128,255,3,240,255,0,170,22,189,0,255,1,252,95,192,255,21,85,45,250,6,248,31,128,255,15,208,223,212,170,118,1,254,7,192,255,3,200,95,37,235,2,248,15,128,254,13,160,170,22,109,3,252,7,128,255,2,146,189,162,93,0,255,0,248,127,9,66,215,164,11,240,63,128,254,139,170,170,69,217,128,255,1,240,127,1,43,85,187,128,255,3,224,191,0,182,174,93,128,255,1,244,31,0,84,147,46,192,255,0,250,159,128,106,213,22,224,127,0,253,31,0,173,106,23,240,63,128,253,7,100,213,164,11,248,23,192,238,130,172,170,36,93,192,127,1,124,23,80,119,181,234,15,248,47,144,93,4,219,77,85,221,4,255,1,228,15,170,42,10