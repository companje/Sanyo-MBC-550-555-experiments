sound: db 210,48,19,187,145,63,208,31,240,15,248,151,116,35,63,1,63,192,31,240,15,240,151,116,3,127,1,63,128,63,224,31,240,167,245,2,126,1,127,128,63,224,31,240,47,233,70,126,2,126,0,63,224,63,224,15,233,4,254,2,254,0,127,192,63,224,79,203,141,252,2,254,0,127,128,63,224,159,210,110,228,7,224,7,240,7,240,7,248,11,233,6,236,7,252,7,240,31,192,63,128,175,65,102,118,3,240,31,240,31,192,127,0,215,34,35,251,1,248,15,248,15,224,63,128,82,178,19,249,1,252,5,252,15,240,31,64,107,145,137,253,0,254,7,252,7,240,31,192,165,217,200,254,0,254,2,254,7,240,23,232,149,204,68,110,0,255,1,255,3,248,15,224,90,100,102,55,128,127,1,255,3,248,31,80,107,54,176,191,0,252,7,208,255,1,252,47,37,187,137,108,38,145,237,39,162,245,85,160,150,157,64,254,19,192,254,19,192,255,7,212,218,76,96,191,9,64,254,21,160,255,5,90,201,102,32,251,13,160,255,9,224,255,3,170,101,39,144,221,4,176,255,4,208,255,137,82,179,25,236,126,1,236,127,2,244,255,178,146,221,68,118,147,64,254,11,169,222,87,165,204,4,182,155,0,244,95,0,93,159,146,205,100,183,153,200,255,10,200,182,146,141,100,246,147,208,255,1,65,175,101,34,177,221,4,242,255,0,84,107,50,145,253,37,32,255,23,16,43,217,12,230,31,0,236,63,129,172,101,35,208,239,4,176,191,0,173,181,9,192,254,19,192,255,1,64,107,50,129,253,6,64,255,2,104,37,27,193,252,19,128,253,7,160,150,157,64,254,19,192,255,23,84,218,76,32,251,9,224,255,139,72,237,6,176,255,5,240,255,5,164,100,35,208,255,0,240,191,1,212,50,17,200,111,18,216,255,160,74,187,9,236,55,145,236,95,17,169,217,72,118,155,72,236,63,8,109,27,201,236,22,128,253,7,106,155,9,100,55,1,221,87,85,138,76,32,187,137,164,166,171,148,108,34,187,11,162,170,163,170,234,170,170,170,10