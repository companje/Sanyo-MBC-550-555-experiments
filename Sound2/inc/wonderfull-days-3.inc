sound: db 2,0,18,0,0,0,0,0,192,193,255,255,255,255,183,63,252,255,255,255,255,255,67,32,0,0,0,0,28,3,67,0,0,0,2,192,192,191,252,255,255,7,35,248,31,255,199,255,240,29,124,0,15,224,3,96,0,255,128,3,112,0,60,128,111,240,159,252,191,127,225,15,249,3,127,194,159,248,3,126,224,15,224,1,180,128,159,195,3,62,147,108,154,143,253,225,219,96,119,240,15,151,241,15,246,15,126,112,61,120,2,127,4,139,112,49,95,160,71,116,232,33,248,5,111,15,223,23,146,115,236,246,248,237,112,154,45,7,79,108,30,218,24,126,196,99,252,72,30,113,135,97,132,29,188,203,228,118,224,126,140,217,7,226,11,126,23,163,235,16,29,134,231,56,17,119,200,7,165,225,96,120,136,239,209,193,188,144,63,60,31,30,251,48,124,227,216,225,144,31,104,14,131,47,132,57,12,190,25,248,3,248,107,241,207,7,255,7,223,10,63,60,194,124,240,124,224,165,131,67,7,194,15,14,15,31,56,42,116,192,248,224,241,205,225,19,132,47,143,127,94,152,31,56,30,108,192,195,216,5,248,129,31,163,7,255,1,31,230,31,124,0,63,248,71,240,129,131,1,3,167,15,95,252,63,16,0,96,224,255,249,127,224,255,255,255,15,28,0,0,6,0,0,0,112,242,255,255,255,241,255,255,255,31,8,0,0,8,0,0,0,224,241,255,255,255,231,255,255,255,127,5,0,0,48,0,0,0,128,224,255,255,255,159,255,255,255,255,159,0,0,224,0,0,0,0,0,251,255,255,31,255,255,255,255,27,1,0,128,1,0,0,0,64,251,255,255,127,252,255,255,255,63,0,0,0,2,0,0,0,0,254,255,255,255,255,252,255,255,255,247,0,0,0,0,0,128,75,1,26,128,66,255,255,255,255,255,255,167,127,0,128,0,188,192,15,0,0,0,0,0,192,27,254,255,15,127,248,135,255,255,255,255,255,241,15,14,0,0,0,8,192,5,28,128,0,6,112,128,31,252,245,255,127,251,0,63,255,249,223,255,240,3,26,0,0,4,0,0,134,127,0,1,2,144,32,9,255,240,255,127,255,79,62,0,255,3,0,254,255,7,0,248,255,127,0,0,228,95,1,0,255,255,255,0,0,128,254,255,251,2,0,192,255,255,255,1,0,0,246,255,255,255,1,0,0,128,255,255,255,63,0,0,0,0,252,255,255,255,127,0,0,0,0,248,255,255,255,255,63,0,0,0,0,0,248,255,255,255,255,31,0,0,0,0,0,254,255,255,255,255,255,3,0,0,0,0,0,224,255,255,255,255,255,255,1,0,0,0,0,0,224,255,255,255,255,255,127,0,0,0,0,0,0,0,255,255,255,255,255,255,255,1,0,0,0,0,0,0,0,224,255,255,255,255,255,255,255,15,0,0,0,0,0,0,0,224,255,255,255,255,255,255,255,255,0,0,0,0,0,0,0,0,0,252,255,255,255,255,255,255,255,191,0,0,0,0,0,0,0,0,224,255,255,255,255,255,255,255,255,7,0,0,0,0,0,0,0,0,208,255,255,255,255,255,255,255,255,255,51,0,0,0,0,0,0,0,0,0,252,138,255,255,255,255,255,255,255,247,255,255,255,55,3,0,0,0,0,0,0,0,240,255,255,255,255,255,255,255,255,63,0,0,0,0,0,0,0,224,255,255,255,191,255,255,255,255,255,16,0,0,1,0,0,0,0,250,255,255,127,255,255,255,255,61,2,0,0,23,0,0,0,0,228,255,255,255,253,255,255,255,63,27,0,0,0,0,0,0,0,240,255,255,255,255,249,255,255,31,255,3,0,0,0,0,128,255,32,184,192,0,193,255,255,255,255,255,255,191,31,0,255,117,0,0,0,0,0,0,0,0,137,254,255,127,191,253,255,255,255,255,255,255,255,79,23,0,0,0,0,144,36,16,64,0,0,0,0,11,223,255,255,255,223,0,255,255,255,255,255,207,3,16,0,0,0,0,0,0,252,16,0,0,0,32,11,252,217,255,255,255,255,23,198,229,139,15,240,255,0,0,255,95,0,0,252,207,35,128,177,254,131,16,192,247,255,123,24,0,194,253,255,23,0,1,225,255,127,159,7,0,0,250,255,255,15,0,0,0,220,255,255,255,16,0,0,0,240,255,255,255,127,71,0,0,0,0,228,255,255,255,255,3,0,0,0,0,128,255,255,255,255,63,10,0,0,0,0,144,255,255,255,255,255,119,6,0,0,0,0,8,219,255,255,255,255,255,33,0,0,0,0,0,8,243,255,255,255,255,255,63,0,0,0,0,0,0,128,255,255,255,255,255,255,239,1,0,0,0,0,0,0,0,254,255,255,255,255,255,255,127,33,0,0,0,0,0,0,0,146,255,255,255,255,255,255,255,63,0,0,0,0,0,0,0,0,128,255,255,255,255,255,255,255,127,127,0,0,0,0,0,0,0,0,255,252,255,255,255,255,255,255,125,1,0,0,0,0,0,0,0,0,248,255,255,255,255,255,255,255,255,127,60,2,0,0,0,0,0,0,0,192,19,132,251,255,255,255,255,255,255,255,255,255,255,131,0,0,0,0,0,0,0,0,254,255,255,255,249,255,255,255,255,0,3,0,0,0,0,0,24,220,255,255,255,255,255,255,255,29,7,64,0,24,0,0,32,0,38,251,255,255,175,255,255,255,191,195,16,0,224,1,0,0,0,128,192,255,255,31,255,255,255,255,159,0,0,0,1,0,0,0,192,239,255,255,255,255,247,255,254,219,38,0,0,0,0,0,241,179,42,214,69,56,232,223,255,255,191,255,159,127,0,14,243,100,158,12,0,0,0,0,64,192,24,254,239,119,252,142,223,241,63,254,199,127,248,14,142,64,0,32,130,127,176,14,6,65,0,56,134,255,248,223,255,255,15,252,225,63,252,135,255,224,31,236,128,12,128,0,80,232,14,195,1,56,8,71,255,184,12,247,251,255,255,131,112,126,242,3,248,31,4,192,255,15,0,128,251,250,7,48,8,255,69,0,232,254,255,183,0,2,249,255,63,2,0,144,252,255,255,31,0,0,120,252,255,255,3,0,0,0,250,255,255,255,0,0,0,128,225,255,255,255,255,5,0,0,0,64,255,255,255,255,255,7,0,0,0,0,224,255,255,255,255,95,0,0,0,0,0,192,255,255,255,255,255,95,6,0,0,0,0,224,253,255,255,255,255,63,2,0,0,0,0,0,56,255,255,255,255,255,255,3,0,0,0,0,0,0,224,255,255,255,255,255,255,55,0,0,0,0,0,0,0,240,255,255,255,255,255,255,255,255,1,0,0,0,0,0,0,192,255,255,255,255,255,255,255,255,62,0,0,0,0,0,0,0,0,0,254,255,255,255,255,255,255,255,3,0,0,0,0,0,0,0,0,254,255,255,255,255,255,255,255,7,17,0,0,0,0,0,0,0,48,175,255,255,255,255,255,255,255,127,186,13,0,0,0,0,0,0,0,0,120,6,253,255,255,255,255,255,255,247,255,255,255,223,1,0,0,0,0,0,0,0,192,255,255,255,255,255,255,255,255,251,0,0,128,0,0,0,0,136,255,255,255,127,255,255,255,251,63,4,0,0,2,0,16,0,130,224,255,255,255,255,255,255,255,93,6,0,0,110,0,0,0,0,193,254,255,255,237,255,255,255,127,12,0,0,48,0,0,0,128,237,251,255,255,255,247,255,255,191,102,1,0,0,0,0,0,254,215,44,152,4,216,126,249,255,251,255,255,127,11,64,18,223,38,219,8,0,0,0,0,144,224,251,255,223,255,255,95,191,255,255,255,255,63,250,8,0,0,0,0,192,71,0,7,0,0,0,12,182,125,254,255,255,249,176,195,231,255,255,159,239,63,28,158,0,112,0,0,192,255,11,134,193,0,24,6,223,224,63,254,250,127,209,195,254,129,7,224,63,0,0,255,95,0,0,232,255,1,240,224,253,198,1,160,251,191,199,3,8,212,255,255,7,128,64,216,255,255,255,1,0,128,247,255,255,31,0,0,0,210,255,255,255,65,0,0,0,192,247,255,255,255,31,0,0,0,0,240,255,255,255,255,69,0,0,0,0,128,255,255,255,255,255,5,0,0,0,0,96,223,255,255,255,255,239,27,0,0,0,0,0,223,255,255,255,255,127,203,0,0,0,0,0,0,231,255,255,255,255,255,59,0,0,0,0,0,0,96,254,255,255,255,255,255,239,0,0,0,0,0,0,0,0,255,255,255,255,255,255,255,127,6,0,0,0,0,0,0,0,240,255,255,255,255,255,255,255,31,6,0,0,0,0,0,0,0,192,254,255,255,255,255,255,255,255,127,0,0,0,0,0,0,0,224,148,255,255,255,255,255,255,255,127,16,1,0,0,0,0,0,0,0,254,252,255,255,255,255,255,255,255,223,55,0,0,8,0,0,0,0,0,240,16,240,255,255,255,255,255,255,239,255,255,255,223,28,0,0,0,0,0,0,0,128,239,255,255,255,255,255,255,255,127,0,0,128,0,0,0,0,0,255,255,255,127,254,255,255,127,124,0,0,0,2,0,0,0,32,204,255,255,255,253,255,255,255,247,32,0,0,30,0,0,0,0,0,254,255,255,251,255,255,255,255,22,0,0,24,0,0,0,0,236,255,255,255,255,255,255,255,207,126,0,0,0,0,0,0,252,109,9,223,240,134,127,255,255,255,255,243,13,95,224,6,119,56,128,3,0,0,0,4,224,0,127,255,215,231,126,235,19,255,255,255,255,121,204,3,20,0,0,8,240,17,134,44,0,0,24,192,33,127,255,254,255,127,97,219,191,245,255,255,223,182,4,9,0,128,0,0,72,223,23,160,0,0,2,144,132,231,253,223,255,255,227,153,255,37,31,192,255,1,0,254,255,1,0,224,223,79,16,198,119,31,0,16,255,255,223,3,0,64,255,255,39,0,0,144,255,255,255,3,0,0,144,255,255,255,0,0,0,128,255,255,255,159,0,0,0,88,254,255,255,255,127,0,0,0,0,248,255,255,255,255,127,0,0,0,0,192,255,255,255,255,255,3,0,0,0,0,0,255,255,255,255,255,255,28,0,0,0,0,0,236,255,255,255,255,255,75,0,0,0,0,0,0,246,255,255,255,255,255,31,0,0,0,0,0,0,0,254,255,255,255,255,255,255,0,0,0,0,0,0,0,0,254,255,255,255,255,255,255,255,11,0,0,0,0,0,0,0,248,255,255,255,255,255,255,255,247,13,0,0,0,0,0,0,0,0,228,255,255,255,255,255,255,255,127,0,0,0,0,0,0,0,64,128,255,255,255,255,255,255,255,191,96,0,0,0,0,0,0,0,0,252,255,255,255,255,255,255,255,255,175,105,0,0,0,0,0,0,0,0,0,240,227,253,255,255,255,255,255,255,255,255,255,255,111,1,0,0,0,0,0,0,0,32,251,255,255,255,255,255,255,255,127,0,0,0,1,0,0,0,224,242,255,255,255,255,255,255,255,63,1,0,0,4,0,0,0,128,224,255,255,255,255,255,255,255,127,0,0,0,252,0,0,0,0,128,252,255,255,247,255,255,255,255,22,2,0,0,0,0,0,0,204,255,255,255,255,175,255,255,247,253,3,0,0,0,0,0,252,159,15,56,1,240,254,255,255,255,255,255,255,31,128,62,15,120,16,2,0,0,0,0,0,0,227,255,207,247,255,159,63,127,255,255,255,252,205,91,128,0,0,0,3,134,30,4,0,0,16,32,248,255,253,255,255,255,3,189,111,255,255,255,255,73,56,192,32,0,64,0,128,111,15,3,16,4,0,28,225,121,222,255,253,255,123,138,231,15,126,128,255,7,0,252,255,1,0,224,127,223,0,134,241,79,2,128,158,255,223,134,0,56,255,255,31,0,0,128,255,255,255,13,0,0,252,255,255,127,0,0,0,112,255,255,255,3,0,0,0,128,255,255,255,255,63,3,0,0,0,224,255,255,255,255,151,1,0,0,0,0,254,255,255,255,255,37,0,0,0,0,192,252,255,255,255,255,255,30,0,0,0,0,0,244,255,255,255,255,255,63,0,0,0,0,0,0,238,255,255,255,255,255,127,0,0,0,0,0,0,0,253,255,255,255,255,255,255,1,0,0,0,0,0,0,0,248,255,255,255,255,255,255,255,37,0,0,0,0,0,0,0,192,255,255,255,255,255,255,255,127,2,0,0,0,0,0,0,0,0,250,255,255,255,255,255,255,255,188,1,0,0,0,0,0,0,0,188,255,255,255,255,255,255,255,249,2,0,0,0,0,0,0,0,0,224,255,255,255,255,255,255,255,255,191,135,1,0,0,0,0,0,0,0,112,1,120,252,255,255,255,255,255,239,255,255,255,255,0,4,0,0,0,0,0,0,0,253,255,255,255,255,255,255,255,127,0,1,128,0,0,0,0,16,252,255,255,127,254,255,255,255,24,3,0,0,12,0,0,0,0,226,254,255,255,253,255,255,255,127,6,0,0,88,0,0,0,0,198,232,255,255,167,255,255,255,255,201,0,0,0,0,0,0,0,224,255,255,255,255,239,255,255,255,61,5,0,0,0,0,0,248,219,55,222,7,252,237,255,255,247,255,239,223,126,0,45,239,99,28,4,0,0,0,0,2,192,31,255,195,255,248,15,255,255,255,255,239,127,240,6,5,0,0,16,128,39,120,0,6,192,1,124,192,63,250,207,255,225,7,252,133,63,248,31,127,224,15,252,0,22,96,0,72,246,7,56,0,7,200,0,63,240,7,254,249,127,255,1,249,116,242,3,250,31,0,192,255,15,0,0,246,255,4,208,162,255,1,8,196,255,255,123,0,128,240,255,127,0,2,128,207,255,255,63,0,0,0,248,255,255,163,1,0,128,255,255,255,63,6,0,0,0,144,249,255,255,255,15,0,0,0,224,253,255,255,255,255,0,0,0,0,0,200,255,255,255,255,191,0,0,0,0,0,194,255,255,255,255,255,127,1,0,0,0,0,192,255,255,255,255,255,63,6,0,0,0,0,0,240,255,255,255,255,255,255,3,0,0,0,0,0,0,224,255,255,255,255,255,255,15,0,0,0,0,0,0,0,248,255,255,255,255,255,255,255,255,1,0,0,0,0,0,0,0,252,255,255,255,255,255,255,255,15,0,0,0,0,0,0,0,0,192,255,255,255,255,255,255,255,255,23,0,0,0,0,0,0,0,64,227,255,255,255,255,255,255,255,11,0,0,0,0,0,0,0,0,64,232,255,255,255,255,255,255,255,255,127,19,0,0,0,0,0,0,0,0,12,30,192,191,255,255,255,255,255,243,255,255,255,31,4,0,0,0,0,0,0,0,224,254,255,255,239,255,255,255,255,39,5,0,0,0,0,0,192,128,255,255,255,223,255,255,255,255,51,0,0,0,0,0,0,128,1,248,255,255,191,255,255,255,255,52,1,0,128,19,0,0,0,0,240,247,255,255,255,255,255,255,159,3,0,0,16,0,0,0,128,253,255,255,255,255,255,255,255,159,71,2,0,0,0,0,0,159,209,38,188,73,240,255,255,255,255,255,255,255,13,96,211,255,0,7,0,0,0,0,0,0,204,255,255,223,255,255,255,255,255,255,255,255,109,95,64,0,0,0,0,192,1,40,0,0,128,0,252,192,63,255,255,255,225,16,252,127,255,243,127,231,25,62,3,12,128,17,0,6,255,193,59,208,0,60,192,63,240,31,252,231,127,232,5,252,159,124,192,255,27,0,252,254,7,0,0,255,29,39,192,79,252,3,45,224,159,252,7,0,192,119,254,103,12,0,0,254,255,255,15,0,0,254,248,255,231,24,0,0,128,255,255,255,63,0,0,0,0,248,255,255,255,111,0,0,0,0,192,255,255,255,255,111,3,0,0,0,0,252,255,255,255,255,103,0,0,0,0,0,112,255,255,255,255,127,127,0,0,0,0,192,240,254,255,255,255,255,31,0,0,0,0,0,0,184,255,255,255,255,255,255,1,0,0,0,0,0,0,252,255,255,255,255,255,255,7,0,0,0,0,0,0,0,248,255,255,255,255,255,255,255,49,1,0,0,0,0,0,0,128,255,255,255,255,255,255,255,255,49,0,0,0,0,0,0,0,0,244,255,255,255,255,255,255,255,255,3,0,0,0,0,0,0,0,224,255,255,255,255,255,255,255,255,7,1,0,0,0,0,0,0,0,112,207,255,255,255,255,255,255,255,255,61,4,0,0,0,0,0,0,0,192,1,128,243,255,255,255,255,255,191,255,255,255,255,27,0,0,0,0,0,0,0,0,201,255,255,255,255,255,255,255,255,8,0,0,0,0,0,0,128,255,255,255,255,252,255,255,255,120,1,0,0,0,0,0,0,0,242,255,255,255,217,255,255,255,251,16,0,0,152,0,0,0,0,132,243,255,255,167,255,255,255,255,3,8,0,16,0,0,0,0,176,255,255,255,255,239,255,255,255,62,1,0,0,0,0,0,248,223,50,189,77,219,255,255,255,255,255,239,127,250,0,166,253,121,147,1,0,0,0,0,0,128,124,255,251,63,254,241,111,255,255,255,255,252,195,19,152,64,0,0,96,6,77,160,129,0,76,128,3,255,252,251,255,254,131,103,255,248,191,63,255,195,31,96,0,14,2,0,128,61,254,1,6,1,32,0,26,252,225,127,255,247,175,125,106,208,201,15,224,127,0,160,255,31,0,0,252,255,15,130,129,127,61,2,128,255,255,159,4,0,64,253,255,1,0,0,248,255,255,31,3,0,192,243,255,255,13,0,0,0,250,255,255,255,15,0,0,0,64,252,255,255,255,63,0,0,0,0,248,255,255,255,255,15,0,0,0,0,192,255,255,255,255,255,35,0,0,0,0,96,255,255,255,255,255,255,23,0,0,0,0,96,252,255,255,255,255,127,18,0,0,0,0,0,128,237,255,255,255,255,255,95,0,0,0,0,0,0,192,255,255,255,255,255,255,63,0,0,0,0,0,0,0,0,253,255,255,255,255,255,255,127,0,0,0,0,0,0,0,128,230,255,255,255,255,255,255,255,127,4,0,0,0,0,0,0,0,128,247,255,255,255,255,255,255,255,63,0,0,0,0,0,0,0,0,248,255,255,255,255,255,255,255,159,0,0,0,0,0,0,0,0,0,255,255,255,255,255,255,255,255,255,159,135,0,0,0,0,0,0,0,0,24,4,232,255,255,255,255,255,255,247,255,255,255,255,4,0,0,0,0,0,0,0,144,254,255,255,255,255,255,255,255,255,3,0,0,0,0,0,0,134,255,255,255,127,255,255,255,255,99,16,0,0,3,0,0,0,0,240,255,255,255,246,255,255,255,23,13,0,0,52,0,0,0,0,208,252,255,255,251,255,255,255,255,37,0,0,0,0,0,0,0,201,254,255,255,255,243,255,255,255,125,4,0,0,0,0,0,254,127,247,239,45,251,255,255,255,255,247,251,190,51,0,233,63,77,18,0,0,0,0,0,144,128,255,255,63,223,231,187,253,255,255,255,127,254,15,117,0,2,0,0,48,15,206,192,0,8,6,217,225,255,254,255,255,211,71,240,63,254,231,255,237,7,248,0,22,128,1,0,144,255,131,11,16,6,180,40,62,211,231,250,221,255,231,147,125,7,63,128,255,3,0,254,255,1,128,194,255,199,129,74,219,103,0,32,220,255,255,2,0,176,253,191,15,0,0,154,255,255,127,11,0,0,228,255,255,63,0,0,0,224,255,255,255,103,0,0,0,0,255,255,255,255,159,1,0,0,0,246,255,255,255,255,9,0,0,0,0,8,255,255,255,255,255,9,0,0,0,0,64,252,255,255,255,255,255,207,0,0,0,0,33,252,255,255,255,255,223,7,0,0,0,0,0,16,252,255,255,255,255,255,103,0,0,0,0,0,0,128,254,255,255,255,255,255,255,1,0,0,0,0,0,0,0,252,255,255,255,255,255,255,255,0,0,0,0,0,0,0,0,56,255,255,255,255,255,255,255,255,3,0,0,0,0,0,0,0,0,252,255,255,255,255,255,255,255,63,0,0,0,0,0,0,0,0,219,255,255,255,255,255,255,255,255,0,8,0,0,0,0,0,0,32,48,255,255,255,255,255,255,255,255,255,99,0,0,0,0,0,0,0,0,224,3,231,251,255,255,255,255,255,159,255,255,255,255,7,1,0,0,0,0,0,0,0,248,255,255,255,255,255,255,255,255,20,0,0,2,0,0,0,192,252,255,255,255,252,255,255,255,97,25,0,1,44,0,0,0,0,184,237,255,255,243,255,255,255,251,2,2,0,56,12,0,0,0,0,198,255,255,207,255,255,255,255,79,0,0,0,0,0,0,0,240,254,255,255,255,31,255,255,255,62,5,0,0,0,0,0,248,31,197,225,58,252,223,255,255,255,255,255,253,190,1,241,124,143,192,1,0,0,0,0,0,128,240,255,255,250,255,255,253,255,255,255,255,255,193,22,0,0,0,0,9,183,1,54,0,130,76,144,13,186,239,191,255,167,79,240,93,190,235,63,253,7,79,128,1,52,0,2,224,15,127,128,3,56,128,15,248,19,127,243,111,254,133,147,248,59,249,129,253,63,0,208,255,7,0,0,255,190,64,16,248,255,9,0,192,255,255,15,0,0,156,255,151,32,0,0,254,255,255,15,0,0,32,253,255,255,4,0,0,128,252,255,255,251,4,0,0,0,124,255,255,255,127,3,0,0,0,0,255,255,255,255,247,3,0,0,0,128,112,255,255,255,255,159,1,0,0,0,0,192,255,255,255,255,255,255,0,0,0,0,0,224,255,255,255,255,255,125,12,0,0,0,0,0,224,255,255,255,255,255,255,5,0,0,0,0,0,32,142,255,255,255,255,255,255,57,0,0,0,0,0,0,0,248,255,255,255,255,255,255,255,253,0,0,0,0,0,0,0,128,255,255,255,255,255,255,255,255,131,0,0,0,0,0,0,0,0,184,254,255,255,255,255,255,255,255,1,0,0,0,0,0,0,0,128,254,255,255,255,255,255,255,255,7,1,0,0,0,0,0,0,0,64,249,255,255,255,255,255,255,255,223,79,2,0,0,0,0,0,0,0,0,128,207,227,255,255,255,255,255,255,255,255,255,255,255,73,0,0,0,0,0,0,0,0,244,255,255,255,255,255,255,255,255,7,0,0,8,0,0,0,0,244,251,255,255,231,255,255,255,199,3,0,0,16,0,0,0,0,240,255,255,255,207,255,255,255,73,38,0,0,240,0,0,0,0,128,224,255,255,143,255,255,255,255,102,0,0,128,0,0,0,2,224,253,255,255,255,127,254,255,243,112,30,0,0,0,0,12,226,243,85,182,143,96,253,255,255,255,255,255,255,223,0,16,125,0,35,80,0,0,0,0,0,8,110,251,127,254,255,255,112,223,255,255,255,255,207,227,0,0,0,0,64,50,108,128,0,0,0,134,192,123,248,207,255,249,23,232,143,253,251,255,250,27,124,131,207,0,17,0,0,223,209,39,240,0,56,128,239,224,63,254,135,255,253,31,248,79,246,129,239,127,0,248,254,159,0,0,255,227,17,48,140,254,1,4,192,191,255,0,12,192,251,253,19,16,0,32,251,255,255,27,0,0,224,255,255,255,103,1,0,0,254,255,255,62,4,0,0,0,220,255,255,255,159,11,0,0,0,128,255,255,255,255,223,5,0,0,0,0,248,255,255,255,255,255,0,0,0,0,0,224,255,255,255,255,255,223,4,0,0,0,0,208,255,255,255,255,255,231,0,0,0,0,0,0,166,255,255,255,255,255,255,15,0,0,0,0,0,0,232,255,255,255,255,255,223,71,0,0,0,0,0,0,0,200,254,255,255,255,255,255,255,207,4,0,0,0,0,0,0,64,254,255,255,255,255,255,255,255,159,3,0,0,0,0,0,0,0,200,249,255,255,255,255,255,255,255,15,0,0,0,0,0,0,0,64,249,255,255,255,255,255,255,255,17,0,0,0,0,0,0,0,0,160,143,255,255,255,255,255,255,255,255,85,19,40,0,1,0,0,0,0,128,3,14,252,191,255,255,255,255,127,254,255,255,255,79,0,0,0,0,0,0,0,0,248,255,255,255,249,255,255,255,255,15,0,0,28,4,0,0,16,240,239,255,255,135,255,255,255,143,18,0,0,120,0,0,0,0,64,255,255,255,207,255,255,255,255,65,16,0,96,0,0,0,128,96,216,255,255,31,255,255,255,253,15,8,0,0,0,0,0,0,208,199,255,255,255,63,255,255,255,255,16,0,0,0,0,0,224,251,135,62,188,65,191,255,255,255,255,253,239,255,0,128,255,127,208,11,0,0,0,0,0,64,4,255,255,159,191,255,227,255,255,255,255,127,120,131,3,16,0,0,8,240,4,71,48,128,7,92,192,23,254,241,255,255,184,192,111,254,246,183,127,249,131,7,48,0,3,0,128,36,127,73,192,0,4,96,7,239,252,239,255,254,247,105,216,59,249,1,253,15,0,240,255,15,0,128,255,125,3,240,134,175,1,1,114,255,255,12,0,0,244,255,63,0,0,132,249,255,255,54,0,0,40,255,255,255,67,0,0,0,252,255,255,183,0,0,0,0,236,255,255,255,255,2,0,0,0,0,255,255,255,255,255,2,0,0,0,0,248,255,255,255,255,31,0,0,0,0,0,216,255,255,255,255,255,14,3,0,0,0,0,226,251,255,255,255,255,63,0,0,0,0,0,0,236,255,255,255,255,255,255,14,0,0,0,0,0,0,243,255,255,255,255,255,255,35,0,0,0,0,0,0,0,128,255,255,255,255,255,255,255,31,2,0,0,0,0,0,0,192,251,255,255,255,255,255,255,255,63,0,0,0,0,0,0,0,0,224,255,255,255,255,255,255,255,127,19,0,0,0,0,0,0,0,160,249,255,255,255,255,255,255,255,15,0,0,0,0,0,0,0,0,0,223,255,255,255,255,255,255,255,255,240,1,4,0,0,0,0,0,0,0,192,39,248,253,255,255,255,255,255,127,255,255,255,255,31,0,0,0,0,0,0,0,64,248,255,255,255,255,255,255,255,255,0,0,0,20,0,0,0,64,254,255,255,255,251,255,255,255,251,16,0,0,0,0,0,0,0,195,255,255,255,239,255,255,255,123,60,8,0,224,65,0,0,0,64,227,251,255,31,255,255,255,255,60,6,0,128,0,0,0,0,128,251,255,255,255,63,255,255,127,56,14,0,0,0,0,0,228,207,1,56,0,0,254,255,255,255,255,255,255,61,3,200,79,125,250,31,0,0,0,0,0,152,238,255,255,111,255,253,103,251,255,255,255,255,242,31,0,0,0,0,0,228,6,220,0,0,224,0,188,243,255,252,255,255,7,142,232,127,249,95,255,195,111,120,0,10,0,0,128,39,255,1,15,224,1,56,27,255,227,251,252,255,255,6,227,251,197,15,228,63,0,128,255,63,0,128,254,255,1,0,240,255,41,0,192,247,255,241,16,0,238,247,255,16,0,0,244,255,255,127,0,0,192,251,255,255,15,0,0,0,248,255,255,255,19,0,0,0,64,255,255,255,255,15,0,0,0,0,255,255,255,255,127,27,0,0,0,0,192,255,255,255,255,63,2,0,0,0,0,20,251,255,255,255,255,191,27,0,0,0,0,128,255,255,255,255,255,159,0,0,0,0,0,0,192,251,255,255,255,255,255,12,0,0,0,0,0,0,112,255,255,255,255,255,255,31,0,0,0,0,0,0,0,192,255,255,255,255,255,255,255,31,4,0,0,0,0,0,0,0,192,255,255,255,255,255,255,255,255,0,0,0,0,0,0,0,0,0,255,255,255,255,255,255,255,255,19,0,0,0,0,0,0,0,0,223,255,255,255,255,255,255,255,255,0,0,0,0,0,0,0,0,8,182,255,255,255,255,255,255,255,255,251,1,0,0,0,0,0,0,0,0,12,192,252,254,255,255,255,255,255,251,255,255,255,15,0,0,0,0,0,0,0,0,224,255,255,255,255,255,255,255,255,183,10,0,0,0,0,0,0,96,255,255,255,191,255,255,255,223,63,0,0,128,0,0,0,0,88,246,255,255,63,255,255,255,255,244,1,64,0,7,0,0,0,0,93,250,255,255,240,255,255,255,143,32,0,0,6,0,0,0,128,252,255,255,255,255,240,255,255,111,183,0,0,0,0,0,128,223,182,186,124,4,182,251,255,255,255,255,235,255,9,16,248,23,31,176,0,0,0,0,0,0,127,253,255,255,215,255,255,255,255,255,255,255,243,13,36,129,0,0,0,216,0,27,40,0,48,192,6,255,241,63,255,207,119,240,14,255,229,191,254,131,127,240,2,6,192,1,0,128,191,112,1,62,128,15,248,128,159,248,23,255,247,15,240,169,230,3,240,127,0,0,255,95,0,128,244,255,0,130,240,255,15,152,64,255,255,63,0,0,236,255,255,3,0,0,254,255,255,63,0,0,100,250,255,255,19,0,0,0,238,255,255,127,7,0,0,0,248,255,255,255,255,15,0,0,0,0,254,255,255,255,255,7,0,0,0,0,128,255,255,255,255,222,7,0,0,0,0,65,254,255,255,255,255,127,1,0,0,0,0,224,255,255,255,255,255,159,6,0,0,0,0,0,240,255,255,255,255,255,255,7,0,0,0,0,0,0,96,254,255,255,255,255,255,119,0,0,0,0,0,0,0,240,255,255,255,255,255,255,255,253,3,0,0,0,0,0,0,0,255,255,255,255,255,255,255,255,7,1,0,0,0,0,0,0,0,0,253,255,255,255,255,255,255,255,3,0,0,0,0,0,0,0,32,252,255,255,255,255,255,255,255,143,0,0,0,0,0,0,0,0,32,248,255,255,255,255,255,255,255,255,31,15,0,0,0,0,0,0,0,0,112,56,137,255,255,255,255,255,255,239,255,255,255,127,16,0,0,0,0,0,0,0,128,249,255,255,255,255,255,255,255,255,7,0,128,0,0,0,128,193,255,255,255,63,255,255,255,127,60,0,0,0,1,0,0,0,7,240,247,255,255,255,255,255,255,57,8,0,0,127,0,0,0,0,160,251,253,255,187,255,255,251,127,30,0,0,48,0,0,0,0,253,255,255,255,255,255,255,255,191,120,4,0,0,0,0,0,254,219,2,147,0,176,255,255,255,255,255,255,255,14,0,227,127,0,88,0,0,0,0,0,0,4,10,255,251,126,250,255,255,255,255,255,255,95,79,2,16,0,0,0,192,23,208,0,0,0,0,150,128,63,249,255,255,239,7,248,111,254,255,255,255,73,116,2,76,0,19,64,32,254,136,7,192,0,248,128,159,224,47,253,203,127,227,5,254,27,124,192,255,75,0,248,255,7,0,64,254,157,7,128,127,252,3,0,228,255,255,3,0,192,190,255,103,6,0,4,246,255,255,23,0,0,120,255,255,255,1,0,0,0,252,255,255,39,0,0,0,0,227,255,255,255,63,4,0,0,0,0,254,255,255,255,63,2,0,0,0,0,252,255,255,255,255,63,0,0,0,0,0,48,255,255,255,255,127,55,1,0,0,0,0,176,255,255,255,255,255,31,0,0,0,0,0,128,232,247,255,255,255,255,255,3,0,0,0,0,0,0,240,255,255,255,255,255,63,15,0,0,0,0,0,0,0,240,255,255,255,255,255,255,255,15,1,0,0,0,0,0,0,192,255,255,255,255,255,255,255,255,15,0,0,0,0,0,0,0,0,240,255,255,255,255,255,255,255,223,3,0,0,0,0,0,0,0,224,250,255,255,255,255,255,255,223,3,0,0,0,0,0,0,0,0,192,255,255,255,255,255,255,255,255,255,47,0,0,0,0,0,0,0,0,0,7,24,242,255,255,255,255,255,255,252,255,255,255,63,0,0,0,0,0,0,0,0,146,255,255,255,255,255,255,255,255,201,0,0,40,0,0,0,128,217,255,255,255,239,255,255,255,255,1,0,0,192,0,0,0,0,6,255,255,255,159,255,255,255,255,4,2,0,192,3,0,0,0,64,226,254,255,63,255,255,255,253,111,8,0,0,0,0,0,0,224,255,255,255,255,127,255,255,255,62,5,0,0,0,0,0,192,255,135,245,104,1,254,255,255,255,255,255,127,255,2,160,121,93,130,3,0,0,0,0,0,64,52,254,255,31,255,241,15,255,255,255,127,255,195,31,28,0,0,0,112,132,15,248,0,0,8,192,2,191,249,253,255,255,199,103,126,240,183,191,253,145,31,36,0,1,0,0,0,60,251,1,6,48,8,3,27,252,229,127,254,255,191,117,248,95,242,1,253,31,0,224,255,15,0,224,255,249,3,224,180,255,1,0,248,255,255,7,0,0,251,255,255,0,0,0,236,255,255,39,0,0,0,255,255,255,11,0,0,0,254,255,255,255,0,0,0,0,248,255,255,255,255,3,0,0,0,64,255,255,255,255,255,1,0,0,0,0,240,255,255,255,255,127,0,0,0,0,0,240,255,255,255,255,255,47,1,0,0,0,0,96,255,255,255,255,255,63,0,0,0,0,0,0,192,255,255,255,255,255,255,7,0,0,0,0,0,0,240,255,255,255,255,255,255,55,0,0,0,0,0,0,0,192,255,255,255,255,255,255,255,127,0,0,0,0,0,0,0,0,255,255,255,255,255,255,255,255,127,0,0,0,0,0,0,0,0,192,255,255,255,255,255,255,255,255,15,0,0,0,0,0,0,0,128,255,255,255,255,255,255,255,255,63,0,0,0,0,0,0,0,0,64,255,255,255,255,255,255,255,255,255,135,11,0,0,0,0,0,0,0,0,192,7,253,255,255,255,255,255,255,127,255,255,255,255,3,0,0,0,0,0,0,0,0,248,255,255,255,255,255,255,255,255,9,0,0,4,0,0,0,0,135,255,255,255,255,255,255,255,127,16,0,0,16,0,0,0,0,0,255,255,255,239,255,255,255,255,49,0,0,224,1,0,0,0,0,195,255,255,191,254,255,255,255,187,9,0,0,0,0,0,0,48,255,255,255,255,127,255,255,191,255,7,0,0,0,0,0,240,127,114,147,5,192,255,255,255,255,255,255,255,255,0,208,124,50,0,0,0,0,0,0,0,128,252,255,255,191,255,255,253,254,255,255,255,251,231,51,0,0,0,0,0,62,18,0,0,0,0,0,128,195,247,255,255,255,7,246,255,255,255,255,239,227,89,0,0,0,0,0,0,246,57,13,0,16,32,0,52,249,111,255,255,255,255,45,252,183,120,0,255,19,0,240,255,39,0,148,255,59,7,28,206,127,13,96,192,255,255,2,0,128,253,255,127,0,0,132,236,255,255,11,0,0,120,250,255,255,1,0,0,0,253,255,255,79,2,0,0,16,236,255,255,255,255,0,0,0,0,224,255,255,255,255,255,1,0,0,0,0,248,255,255,255,255,103,0,0,0,0,0,224,255,255,255,255,255,231,32,4,0,0,128,241,253,255,255,255,247,57,4,0,0,0,0,0,112,255,255,255,255,255,159,131,0,0,0,0,0,0,250,255,255,255,255,255,255,39,0,0,0,0,0,0,0,240,254,255,255,255,255,255,255,147,0,0,0,0,0,0,0,192,255,255,255,255,255,255,255,255,255,0,0,0,0,0,0,0,128,0,254,255,255,255,255,255,255,255,1,0,0,0,0,0,0,96,0,254,255,255,255,255,255,255,255,225,0,0,0,0,0,0,0,0,248,240,255,255,255,255,255,255,255,159,255,1,0,0,0,4,0,0,0,0,7,69,217,223,255,255,255,255,255,252,255,255,255,67,0,0,0,0,0,0,0,0,188,254,255,255,251,255,255,255,255,4,3,32,16,0,0,0,16,172,255,255,255,239,255,255,255,95,135,96,0,0,0,0,0,0,134,249,254,255,143,255,255,255,191,73,0,0,128,1,0,0,0,144,236,255,255,127,255,255,255,255,207,0,0,0,1,0,0,0,192,246,255,255,255,127,246,127,255,203,54,0,0,0,0,0,192,159,12,195,101,146,236,191,255,255,255,254,223,127,0,6,249,36,155,100,1,0,0,0,64,96,28,255,239,127,124,135,239,240,29,255,227,119,248,14,79,224,0,8,128,119,48,9,14,192,0,8,2,219,242,207,255,255,39,220,228,159,254,211,127,250,7,124,128,8,144,0,16,224,15,232,1,29,0,3,240,56,254,255,255,255,127,131,9,254,5,31,224,63,72,0,255,255,0,0,224,254,79,1,0,50,77,0,8,254,255,247,9,2,192,223,255,147,65,0,12,223,239,127,9,0,0,244,255,255,251,16,0,0,160,253,255,255,211,1,0,0,16,252,255,255,255,125,4,0,0,0,176,255,255,255,255,225,0,0,0,0,192,253,255,255,255,223,15,0,0,0,0,129,237,255,255,255,255,223,108,0,0,0,0,192,240,255,255,255,255,63,39,0,0,0,0,0,0,219,255,255,255,255,255,127,62,0,0,0,0,0,0,191,255,255,255,255,255,255,0,0,0,0,0,0,0,0,248,255,255,255,255,255,255,255,18,0,0,0,0,0,0,0,240,255,255,255,255,255,255,255,223,71,0,0,0,0,0,0,0,0,222,255,255,255,255,255,255,255,255,0,0,0,0,0,0,0,0,0,255,255,255,255,255,255,255,127,36,0,0,0,0,0,0,0,0,194,242,255,255,255,255,255,255,255,127,183,1,0,0,0,0,0,0,0,128,3,0,226,255,255,255,255,255,255,255,255,255,255,95,0,0,0,0,0,0,0,0,197,255,255,255,255,255,255,255,255,19,0,0,0,0,0,0,0,240,255,255,255,227,255,255,255,159,14,0,0,48,0,0,0,0,64,254,223,255,199,255,255,255,191,69,2,0,200,0,0,0,0,0,252,191,255,223,255,255,255,255,35,65,0,128,0,0,0,0,152,252,255,255,255,63,248,255,255,195,32,0,0,0,0,0,196,191,9,56,79,178,253,254,255,247,255,186,223,7,1,88,62,159,96,56,0,0,0,0,0,128,231,251,127,223,255,255,127,255,255,255,255,255,227,3,0,0,0,0,0,95,0,28,4,0,32,48,72,241,249,183,255,231,91,52,159,255,251,127,191,254,113,104,128,224,0,0,0,195,247,24,6,1,96,10,124,243,117,255,238,255,245,187,10,255,79,126,160,254,13,0,120,255,1,0,224,119,236,131,132,247,15,195,32,28,239,223,143,97,120,246,123,159,97,0,104,247,223,227,16,0,0,140,255,255,215,56,0,0,193,251,255,190,15,0,0,0,128,255,255,255,255,51,24,0,0,0,112,255,255,255,255,31,64,0,0,0,0,252,255,255,255,255,53,1,0,0,0,0,189,255,255,255,255,255,211,1,0,0,0,98,88,255,255,191,255,237,79,0,0,0,0,0,224,60,255,255,255,255,255,251,1,4,0,0,0,0,8,241,255,255,255,255,255,255,3,0,0,0,0,0,0,0,224,255,255,255,255,255,255,255,37,0,0,0,0,0,0,0,188,253,255,255,255,255,255,255,255,18,4,0,0,0,0,0,0,0,248,255,255,255,255,255,255,255,123,3,0,0,0,0,0,0,0,248,239,255,255,255,255,255,255,239,3,0,0,0,0,0,0,0,64,0,254,252,255,255,255,255,255,255,253,207,3,0,1,0,1,0,0,0,192,3,48,132,231,255,255,255,255,255,254,255,255,255,3,0,0,0,0,0,0,0,96,248,255,255,255,255,255,255,255,127,30,0,0,12,0,0,0,32,237,255,255,255,253,255,255,255,223,0,0,0,24,0,0,0,0,96,255,255,255,247,253,255,255,222,38,0,0,112,0,0,0,0,80,246,255,255,207,255,255,255,255,199,0,0,64,0,0,0,0,240,255,255,255,255,159,254,255,127,223,18,0,0,0,0,0,244,45,9,11,158,240,175,255,255,223,255,255,231,15,8,192,15,174,112,0,2,0,0,1,28,224,11,255,243,159,111,125,192,255,255,247,127,191,251,129,7,56,0,0,24,226,49,13,64,0,2,124,224,111,254,251,255,255,31,208,183,255,253,223,255,182,100,9,82,16,0,0,0,211,158,36,32,13,32,144,227,60,255,251,223,255,247,135,115,14,95,144,255,97,0,246,63,4,0,152,227,31,132,33,12,99,28,230,123,255,243,30,100,65,202,251,60,229,9,194,176,190,111,27,0,16,252,253,255,255,0,0,0,148,255,255,255,19,4,0,0,192,251,254,255,127,203,3,0,0,0,224,255,255,255,255,9,3,0,0,0,0,254,255,255,255,31,14,0,0,0,0,248,255,255,255,255,255,63,194,0,0,0,0,128,254,255,255,255,255,191,4,1,0,0,0,0,97,248,255,255,255,255,255,67,24,0,0,0,0,0,132,125,255,255,255,255,255,47,3,0,0,0,0,0,0,0,248,255,255,255,255,255,255,255,13,0,0,0,0,0,0,160,32,255,255,255,255,255,255,255,159,176,0,0,0,0,0,0,0,0,254,255,255,255,255,255,255,191,255,1,0,0,0,0,0,0,128,61,254,255,255,255,255,255,127,251,0,4,0,0,0,0,0,0,0,240,247,255,255,255,255,127,255,251,191,244,13,0,64,0,0,0,0,0,0,2,0,4,60,239,255,255,255,255,253,255,255,255,63,3,0,0,0,0,0,0,0,240,255,255,255,255,255,255,255,255,9,0,0,32,0,0,0,0,128,255,255,255,143,255,255,255,255,48,4,0,64,0,0,0,0,0,254,255,255,127,254,255,255,255,75,16,0,128,1,0,0,0,0,200,255,255,255,254,255,255,255,95,2,0,0,2,0,0,0,0,251,255,255,255,255,255,255,255,191,7,1,0,0,0,0,0,91,242,48,224,64,255,255,255,255,255,255,255,127,6,24,128,125,200,224,0,0,0,0,0,0,225,255,255,63,254,255,254,255,255,255,255,255,247,39,3,0,0,0,4,48,9,0,48,0,64,0,192,235,255,255,255,255,31,214,255,255,255,255,255,241,142,3,16,0,0,0,64,146,159,37,0,64,0,134,128,60,225,121,223,247,191,199,107,242,195,15,204,95,16,0,252,37,0,192,240,246,33,75,146,150,97,24,15,247,175,241,56,4,239,246,239,65,40,128,52,222,255,93,1,0,128,83,253,255,143,4,0,0,132,255,255,127,156,0,16,128,112,248,255,255,255,103,0,2,0,8,233,253,255,255,159,115,8,0,0,0,226,253,255,255,191,159,0,16,0,4,0,25,251,255,255,255,127,251,226,32,0,0,2,192,181,255,255,255,223,251,52,1,0,0,0,128,129,249,231,255,255,255,127,15,84,0,0,0,0,64,48,255,255,255,255,255,255,123,8,0,0,0,0,0,64,32,255,255,255,255,255,255,255,31,54,0,0,0,0,0,0,0,217,255,255,255,255,255,255,255,207,53,0,0,0,0,0,0,0,104,198,255,255,255,255,255,255,191,103,0,0,0,0,0,0,0,16,6,255,253,255,255,255,255,203,155,144,0,0,0,0,0,0,0,0,43,255,255,255,255,125,253,243,191,231,125,4,8,24,195,48,0,0,0,224,0,0,19,252,239,255,255,255,255,255,255,255,255,52,0,0,0,0,0,0,0,64,251,255,255,191,255,255,255,255,155,3,0,0,1,0,0,0,0,254,255,255,255,252,255,255,111,95,130,0,0,4,0,0,0,0,200,255,255,255,241,255,255,255,199,17,0,0,12,0,0,0,0,200,254,255,255,243,255,255,255,255,0,1,0,16,0,0,0,0,140,255,255,255,255,199,255,255,223,63,0,0,0,0,0,0,240,62,224,73,218,240,191,255,255,255,247,191,255,25,0,194,112,12,104,1,0,0,0,0,128,18,252,255,127,240,158,255,225,127,254,255,255,249,79,154,128,1,0,0,70,240,0,30,192,1,120,128,15,240,91,255,255,63,253,129,191,244,63,255,194,31,248,1,7,128,0,0,192,207,254,1,30,128,0,125,224,143,254,243,255,255,15,255,120,127,242,131,255,63,1,248,249,0,0,96,214,244,137,64,211,67,30,64,152,255,253,13,97,144,246,252,199,75,192,19,190,231,127,122,0,4,224,25,255,243,19,32,0,14,192,63,63,99,11,96,0,12,225,253,255,255,223,241,0,0,0,128,254,253,255,255,63,35,0,0,0,8,241,255,255,255,255,79,8,0,0,0,0,248,223,255,255,255,255,199,31,0,0,4,192,8,248,255,255,255,239,95,132,0,0,0,0,32,194,254,255,255,255,255,63,196,2,8,0,0,0,0,244,252,255,255,255,255,255,35,1,0,0,0,0,0,80,112,255,255,255,255,255,255,255,95,6,0,0,0,0,0,0,64,250,254,255,255,255,255,255,231,47,12,0,0,0,0,0,0,0,240,243,255,255,255,255,255,255,127,6,0,0,0,0,0,0,128,64,188,239,255,255,255,255,255,127,30,0,8,0,0,0,0,0,0,144,191,239,255,255,239,255,255,255,255,255,3,16,228,4,75,0,0,0,0,2,0,14,224,255,255,255,255,255,255,255,255,255,214,0,0,0,0,0,0,0,0,248,255,255,255,255,255,255,255,191,7,0,0,2,0,0,0,0,251,255,255,255,221,255,255,255,251,7,0,0,12,0,0,0,0,240,253,255,255,211,255,255,255,223,19,0,0,56,0,0,0,0,160,123,254,255,63,255,255,255,255,19,128,0,64,0,0,0,0,56,250,255,255,255,255,255,255,255,255,3,0,0,0,0,0,252,109,1,218,4,180,255,255,255,255,255,255,251,3,0,128,100,1,193,16,0,0,0,0,16,228,181,253,255,255,223,127,250,255,255,255,255,191,47,97,0,0,0,0,192,27,38,32,4,0,0,198,224,31,255,247,255,241,31,240,31,255,241,63,255,13,159,1,6,160,24,0,0,254,225,57,192,0,158,193,63,224,31,254,243,127,244,3,248,227,199,169,71,255,1,102,240,31,64,0,248,228,63,240,6,242,1,14,224,15,254,145,60,32,111,254,227,59,224,1,254,207,63,239,1,128,224,232,255,249,142,16,8,66,248,223,255,62,196,8,0,0,48,253,127,255,247,247,0,0,0,128,254,252,127,253,95,16,32,32,64,2,214,159,255,125,95,123,2,0,0,0,0,24,215,247,239,253,31,179,179,3,48,0,98,192,207,251,221,255,61,207,115,16,2,0,0,8,140,185,255,247,255,255,123,142,199,0,64,0,12,128,60,255,251,255,255,255,207,177,128,0,4,0,0,0,0,52,251,127,255,255,253,255,251,30,3,48,0,0,0,0,0,0,61,252,255,254,255,255,255,239,211,7,1,8,0,0,0,32,8,240,240,255,255,255,255,255,255,191,15,0,0,0,0,0,16,0,32,252,227,255,223,255,255,255,127,159,59,0,1,0,0,16,128,3,156,199,121,223,255,255,71,125,142,255,188,239,25,0,102,240,135,0,0,0,128,7,0,0,204,231,255,255,255,255,255,255,255,255,143,2,0,0,2,0,0,0,0,248,255,255,255,255,255,255,255,255,33,0,0,16,0,0,0,128,254,255,255,255,255,255,255,255,255,13,2,0,32,0,0,0,0,200,247,255,255,239,255,255,255,127,31,0,128,96,0,0,0,0,113,233,255,255,255,255,255,255,191,94,1,0,128,2,0,0,0,192,247,255,255,255,191,255,255,255,255,7,0,0,0,0,0,224,19,8,224,3,225,254,255,255,255,251,255,127,233,0,128,247,225,0,30,0,0,0,0,128,80,152,248,175,111,240,166,183,252,255,255,255,253,31,79,96,128,0,32,128,13,182,193,3,0,16,129,3,252,242,63,255,255,3,145,248,253,143,255,227,103,62,24,0,0,64,0,0,186,76,131,73,16,128,5,111,209,159,255,253,255,255,62,244,79,127,240,255,23,0,221,15,0,0,48,28,143,241,1,253,120,135,102,215,255,27,30,144,140,247,120,207,162,150,225,57,223,247,23,4,8,248,223,254,231,3,112,16,239,235,255,255,28,4,64,16,240,182,245,255,255,211,5,0,0,192,48,255,255,255,255,73,28,128,0,0,96,207,255,223,255,63,60,32,0,64,0,144,37,255,255,255,255,253,31,12,128,0,32,96,208,223,254,255,247,63,139,11,2,0,0,12,9,216,247,253,255,255,191,231,89,2,146,4,65,1,202,126,188,255,255,255,251,252,133,0,0,0,0,0,0,0,254,252,255,255,255,255,255,255,193,3,0,0,0,0,0,8,75,250,254,255,255,255,255,255,247,1,3,0,0,0,8,0,0,40,112,252,255,255,255,255,255,255,31,7,0,0,0,0,0,0,0,240,252,255,255,255,255,255,247,63,15,1,0,0,0,0,0,0,0,225,240,254,247,255,239,27,30,247,47,239,89,0,176,60,231,113,2,0,0,224,1,0,0,12,255,255,255,255,111,255,255,255,127,24,0,0,0,0,0,0,0,132,239,255,255,63,255,255,255,255,63,0,0,0,1,0,0,0,192,127,255,255,255,254,255,255,255,127,0,0,0,3,0,0,0,64,250,255,255,255,250,255,255,255,147,5,0,0,24,0,0,0,0,201,255,255,255,239,255,255,255,127,147,0,0,0,0,0,0,0,232,251,255,255,255,167,255,255,255,253,7,0,0,0,0,0,248,12,3,81,14,190,255,255,255,255,127,255,239,66,0,48,150,37,184,32,0,0,0,0,128,56,218,255,190,143,255,219,125,255,231,255,255,191,254,85,16,0,0,64,0,12,131,65,16,8,32,3,254,232,63,253,255,255,65,119,248,159,255,183,223,228,27,60,1,6,192,0,152,71,243,0,10,64,19,60,132,207,241,127,254,223,127,176,13,242,1,254,111,3,225,186,12,128,0,58,66,52,57,40,251,20,200,48,239,247,120,30,76,247,121,190,113,176,74,178,206,189,108,131,64,201,229,219,127,31,6,7,8,124,159,255,251,92,132,192,192,28,143,255,239,63,31,128,1,0,209,224,254,63,255,103,121,4,4,0,17,89,159,255,246,95,142,227,16,16,2,130,76,249,223,251,127,187,60,147,96,16,12,129,227,113,203,207,231,63,108,11,0,128,32,24,71,192,243,241,255,239,255,31,31,15,18,20,24,36,128,120,153,255,243,255,247,247,159,96,11,0,0,0,32,48,124,187,255,243,255,255,255,247,14,159,1,4,0,0,0,96,9,188,255,242,255,255,255,223,255,135,15,4,0,0,0,0,64,96,217,244,255,255,255,255,223,247,61,14,72,0,8,0,0,0,8,130,65,246,253,191,255,255,255,215,95,180,32,0,65,16,128,0,193,1,14,199,247,255,15,223,240,61,190,231,119,0,158,231,243,109,2,0,0,48,2,0,64,28,253,255,255,255,207,255,255,191,223,131,0,0,0,0,0,0,0,224,255,255,255,255,253,255,255,247,63,0,0,128,0,0,0,0,232,244,255,255,255,254,255,239,255,124,5,0,0,22,0,0,0,32,153,254,255,255,248,255,255,255,31,128,0,0,12,0,0,0,0,230,249,255,255,243,255,255,255,255,0,8,0,16,0,0,64,0,232,254,255,255,255,183,255,255,253,190,11,0,0,0,0,0,216,34,8,116,29,254,255,255,255,255,255,253,62,27,32,89,108,129,46,1,0,0,0,0,100,145,254,255,95,255,239,31,245,255,255,255,255,191,56,2,64,0,0,128,193,59,32,7,64,144,12,154,97,187,252,215,255,242,9,254,227,191,252,143,255,240,13,184,0,19,96,0,108,240,15,156,128,27,120,3,111,242,77,254,237,191,252,131,111,242,199,63,192,31,249,0,126,224,1,48,192,31,122,195,127,224,15,12,242,29,190,79,95,120,186,95,243,43,50,69,135,235,26,93,130,224,120,156,199,235,112,29,134,195,116,221,174,251,32,29,32,128,36,217,7,255,38,95,36,128,38,192,55,249,254,93,182,193,54,65,0,9,160,31,252,223,62,250,4,156,0,2,64,80,205,170,95,247,255,30,124,0,104,0,0,164,192,127,217,175,123,124,15,230,0,20,0,0,120,112,223,228,251,253,223,7,241,0,14,0,4,56,8,223,241,255,255,255,199,57,0,7,0,0,28,0,3,56,248,127,255,255,254,247,223,255,130,7,0,0,8,0,1,56,170,125,253,251,255,247,231,239,227,15,4,1,0,24,4,16,96,56,236,211,255,251,255,255,255,31,62,2,0,0,0,0,192,32,208,231,203,255,223,255,239,255,125,178,15,112,0,16,160,0,112,0,171,234,213,255,255,15,112,120,62,255,127,124,128,223,243,60,14,3,1,0,14,0,0,0,30,255,255,255,255,215,255,255,255,199,3,0,0,8,0,0,0,0,248,252,255,255,247,255,255,255,255,15,2,0,48,0,0,0,0,224,243,255,255,207,255,255,255,255,7,0,0,64,0,0,0,0,144,248,255,255,191,254,255,255,191,47,131,0,208,0,0,0,0,52,193,255,255,63,255,255,255,127,71,2,0,0,3,0,0,0,64,245,255,255,255,255,250,255,255,255,190,0,0,0,0,0,128,199,34,0,28,164,251,255,255,255,255,255,255,68,1,160,104,86,197,34,0,0,0,0,128,4,253,247,255,126,221,247,227,254,255,255,255,255,31,109,0,0,0,0,128,193,32,0,0,0,0,144,196,247,253,191,255,255,117,144,47,251,103,255,236,27,124,2,141,128,17,16,0,250,225,55,184,3,116,128,15,226,59,252,174,255,225,61,184,15,246,193,31,254,3,252,128,31,224,1,120,192,39,240,41,218,133,211,100,155,238,211,124,8,110,247,101,58,200,215,225,159,62,215,65,32,14,209,243,59,156,4,62,136,108,215,231,63,88,13,160,129,56,125,251,126,38,255,128,0,1,232,143,249,127,248,31,48,139,0,144,3,243,3,255,103,159,60,128,28,128,4,144,153,147,254,243,252,55,109,39,97,50,12,114,73,180,203,231,249,44,219,197,101,0,10,4,192,25,60,151,245,243,60,159,97,25,4,130,65,104,12,143,199,223,255,191,126,221,117,131,64,1,0,130,68,147,105,182,220,190,255,254,221,246,217,52,97,2,197,2,12,0,6,155,108,223,254,255,124,223,230,243,36,136,6,129,0,0,12,1,120,152,254,255,255,255,255,255,241,31,132,3,0,16,4,128,1,60,140,231,249,159,255,243,127,126,5,139,96,16,4,3,0,16,5,162,120,252,199,255,248,20,204,227,127,23,239,2,30,126,249,63,120,0,0,112,0,0,0,224,219,255,255,255,239,127,255,255,191,97,0,0,0,0,0,0,0,0,255,255,255,191,251,255,255,255,219,0,0,0,0,0,0,0,1,254,255,255,255,254,255,255,255,159,7,0,0,2,0,0,0,8,242,255,255,255,253,255,255,255,39,13,0,0,0,0,0,0,0,196,255,255,255,245,255,255,255,127,146,4,0,32,0,0,0,0,200,255,255,255,255,195,255,255,255,255,3,0,0,0,0,0,188,101,121,209,38,248,255,255,255,255,255,159,246,1,0,120,210,131,60,6,1,0,0,0,4,104,252,255,63,252,225,15,250,252,255,255,255,151,31,56,192,1,0,192,0,31,240,129,3,88,128,3,60,248,171,255,255,159,7,248,236,103,63,251,147,15,249,0,3,52,128,0,8,254,145,15,97,64,130,36,237,105,159,254,246,255,127,106,210,151,252,224,255,15,224,4,15,21,0,1,88,244,146,47,224,1,3,216,128,231,61,254,65,94,246,176,79,112,146,131,95,237,217,14,116,36,203,123,250,49,13,195,1,222,230,254,231,113,8,195,16,192,175,157,255,31,142,3,4,3,56,194,249,254,249,251,163,115,0,7,128,128,15,125,95,250,62,180,73,24,240,0,76,227,200,143,255,191,103,63,220,210,4,40,96,210,247,240,231,95,127,131,15,12,8,0,24,48,96,255,242,254,199,255,139,35,7,6,8,4,29,120,251,240,255,247,255,247,249,7,2,2,0,4,0,24,0,254,240,255,255,250,255,239,255,67,135,4,0,0,16,0,96,44,252,249,248,255,243,239,239,207,135,12,12,0,24,0,48,68,104,201,242,255,255,255,255,255,167,79,10,8,0,0,0,0,4,192,136,220,255,243,255,255,255,223,151,31,5,7,72,0,20,160,40,248,81,242,231,255,255,7,142,140,63,63,127,126,240,254,244,255,225,2,0,0,15,0,0,2,61,254,255,255,255,241,255,255,255,135,5,0,0,12,0,0,0,0,248,254,255,255,227,255,255,255,255,8,0,0,16,0,0,0,0,160,255,255,255,175,255,255,255,255,31,0,0,96,0,0,0,0,192,199,255,255,31,255,255,127,255,126,32,0,128,0,0,0,0,192,207,255,255,127,254,255,255,255,255,0,0,0,0,0,0,0,0,223,255,255,255,255,252,255,255,250,127,0,0,0,0,0,224,7,0,4,34,8,252,255,255,255,255,255,119,179,1,0,131,237,6,11,0,0,0,0,0,208,252,249,255,255,241,135,207,253,255,255,255,255,63,62,104,0,0,0,96,240,5,36,1,4,128,25,124,118,255,246,255,255,5,154,243,119,254,191,255,151,63,224,0,24,0,6,128,109,123,3,30,128,11,112,18,242,230,247,253,207,255,129,63,63,111,94,201,126,188,25,72,35,1,2,129,129,135,59,131,55,14,142,156,120,251,250,231,96,225,203,219,7,7,15,95,206,156,57,124,24,72,244,224,249,193,227,131,195,5,15,127,156,31,24,28,120,92,249,240,231,225,17,131,1,0,4,10,222,158,191,253,19,209,96,50,96,96,244,121,223,247,135,59,15,102,0,28,56,56,253,248,243,225,243,129,11,131,3,4,14,28,158,60,252,121,240,242,224,227,128,135,3,14,143,63,31,63,62,253,185,240,96,192,128,195,195,131,211,123,127,254,127,126,57,56,48,0,224,192,192,1,131,195,103,175,255,95,255,31,254,113,244,96,64,192,128,129,35,7,199,31,191,255,126,127,120,118,96,200,192,128,1,0,3,67,30,158,158,255,253,255,255,249,247,161,196,1,0,3,0,6,96,28,224,124,121,251,190,255,229,239,203,22,7,12,6,0,44,0,24,0,240,192,225,255,128,7,128,3,224,255,47,30,240,255,55,160,28,225,1,128,3,0,1,0,16,255,255,255,126,254,255,255,249,33,225,0,0,7,0,0,0,0,126,255,255,255,252,255,255,251,131,64,1,0,6,0,4,0,2,60,252,127,255,241,253,255,255,247,131,2,0,4,0,0,0,48,120,254,254,255,255,251,255,247,199,15,0,0,56,0,0,96,0,252,252,255,255,207,255,255,111,191,7,0,0,0,0,0,0,0,124,249,252,255,255,31,254,255,255,31,0,187,0,0,0,64,224,170,0,208,191,167,127,255,255,255,191,125,113,111,2,64,180,137,135,5,0,0,0,0,16,32,235,253,253,161,251,247,159,255,255,255,255,63,127,112,8,32,0,0,0,130,2,128,13,128,1,19,112,135,239,224,255,159,131,51,252,207,255,255,191,254,193,63,184,0,30,0,0,252,66,31,248,0,62,193,39,254,192,223,249,155,127,195,127,62,224,31,96,144,127,242,65,240,200,15,0,194,63,134,7,60,252,26,88,160,249,246,195,128,241,7,191,7,4,188,190,29,52,112,120,240,192,194,233,135,7,3,7,62,15,14,252,60,60,96,81,240,225,239,193,143,191,39,7,52,136,126,248,61,249,242,99,240,129,130,1,3,31,134,191,252,121,58,240,32,112,128,130,195,129,63,231,31,190,61,60,249,34,250,192,132,249,241,55,211,79,55,12,15,0,21,60,0,224,255,9,182,253,255,27,128,191,255,1,0,208,141,63,0,247,255,255,79,192,1,253,1,2,0,196,127,128,9,248,255,255,251,255,255,221,7,8,34,47,4,0,24,176,37,106,192,255,167,216,103,183,128,255,95,9,32,191,31,0,128,255,165,161,232,255,183,190,38,255,239,31,0,0,39,114,3,0,224,171,111,1,223,254,255,253,248,123,250,2,96,196,192,27,0,7,2,79,94,156,232,255,1,112,224,96,240,255,15,1,255,255,63,0,124,8,0,16,0,0,64,0,224,255,255,255,135,255,255,255,95,2,0,0,0,0,0,0,0,224,255,255,255,159,255,255,255,219,17,33,0,192,0,0,0,0,17,251,255,255,63,254,255,255,255,35,64,0,0,1,0,0,0,148,188,255,255,255,250,255,255,235,143,0,0,0,4,0,0,0,48,120,255,255,255,241,255,255,127,255,3,0,0,8,0,0,0,192,240,155,252,255,255,65,255,255,95,7,224,30,0,0,0,192,125,0,0,200,63,227,255,255,255,255,255,25,254,55,0,36,224,157,176,3,0,0,0,0,0,184,251,255,127,200,223,215,255,255,255,255,255,159,109,32,17,0,0,0,192,27,0,0,0,2,64,192,124,248,255,255,255,127,224,15,223,143,127,255,31,124,130,108,224,1,96,0,133,197,3,88,4,14,2,111,240,31,252,229,255,251,39,240,193,31,193,31,126,2,126,226,15,208,228,255,0,1,249,103,0,129,67,134,15,37,131,127,52,30,216,250,251,240,2,209,225,231,129,5,151,3,47,50,95,60,56,24,112,241,251,224,195,225,3,7,2,54,126,126,60,184,252,96,80,192,131,193,193,31,243,15,46,0,15,24,28,62,179,111,237,120,124,194,131,80,1,62,30,78,109,255,120,178,124,100,231,193,34,133,141,15,15,15,126,56,60,122,208,61,128,227,0,1,243,95,135,207,255,255,28,96,251,248,0,128,224,203,23,4,191,127,127,158,160,56,113,12,0,48,224,135,200,134,191,255,15,254,159,255,61,8,96,24,30,0,0,224,11,94,160,175,255,63,254,104,254,219,15,34,0,68,0,3,66,0,126,230,239,220,255,251,255,127,252,15,220,2,24,32,1,47,0,30,224,55,159,207,127,255,23,190,49,125,64,192,153,128,9,192,7,32,15,109,219,255,4,15,120,0,240,255,127,120,192,255,183,1,253,15,0,0,2,0,0,0,128,255,255,255,255,241,255,255,207,204,7,9,0,0,0,0,0,0,241,255,255,255,231,255,255,255,63,4,0,0,16,0,0,0,0,192,255,255,255,223,255,255,255,255,45,0,0,192,0,0,0,0,2,254,255,255,63,255,255,255,255,141,1,0,128,3,0,0,0,12,248,255,255,255,252,255,255,255,51,3,0,0,7,0,8,0,56,248,252,255,255,255,240,255,255,7,128,63,0,0,0,0,64,126,0,224,231,241,235,247,255,255,255,223,127,31,31,0,48,48,252,80,0,0,0,0,0,0,143,255,31,63,54,254,60,252,255,255,255,255,255,195,6,0,0,0,0,52,10,0,0,0,0,32,0,252,255,255,255,255,63,192,127,254,255,255,255,3,54,0,64,0,0,0,0,208,190,7,0,12,128,16,0,255,191,255,255,255,255,123,252,106,241,1,252,15,0,240,255,15,0,0,254,127,0,32,240,255,2,128,197,255,255,7,1,0,254,255,127,0,0,128,252,255,255,7,0,0,192,255,255,255,15,0,0,64,252,255,255,255,1,0,0,0,196,255,255,255,255,3,0,0,0,160,255,255,255,255,255,3,0,0,0,0,248,255,255,255,255,127,0,0,0,0,0,142,255,255,255,255,255,255,0,0,0,0,0,192,255,255,255,255,255,63,0,0,0,0,0,0,224,255,255,255,255,255,127,15,0,0,0,0,0,0,248,255,255,255,255,255,255,15,0,0,0,0,0,0,0,224,255,255,255,255,255,255,255,63,0,0,0,0,0,0,0,128,255,255,255,255,255,255,255,255,63,0,0,0,0,0,0,0,0,128,255,255,255,255,255,255,255,255,3,0,0,0,0,0,0,0,0,255,255,255,255,255,255,255,255,111,0,0,0,0,0,0,0,0,0,252,255,255,255,255,255,255,255,31,7,0,0,0,0,0,0,0,0,224,243,255,255,255,255,255,255,255,127,124,255,252,126,240,64,0,0,0,0,0,0,0,0,60,254,255,255,255,255,255,255,251,199,131,131,7,6,13,30,188,125,248,249,112,240,233,65,1,3,6,15,14,6,16,56,48,96,64,240,225,192,255,255,255,3,6,4,126,255,255,255,255,63,0,0,0,0,0,201,79,255,159,62,126,31,124,32,224,64,224,203,231,183,207,47,14,31,0,8,0,32,0,240,195,231,225,255,255,255,191,253,31,0,0,0,0,64,224,193,255,255,255,223,255,31,28,8,16,0,0,32,224,233,227,255,231,255,223,255,63,6,0,16,0,0,208,249,255,243,255,247,243,207,7,25,190,62,12,120,112,176,240,224,241,195,215,15,7,15,30,4,60,88,252,60,240,67,224,199,131,143,7,63,135,63,56,28,16,112,32,240,64,240,131,227,7,203,31,31,31,24,126,120,52,224,240,192,192,131,197,7,15,3,31,62,60,124,248,248,240,241,233,227,131,135,5,15,7,28,12,60,60,56,120,240,240,225,193,163,131,15,135,31,12,28,60,120,114,240,244,232,193,193,131,131,7,3,14,14,62,28,124,56,252,104,240,231,225,143,227,15,135,22,0,60,24,186,16,96,113,192,227,192,207,195,255,27,255,15,126,3,248,248,244,65,128,215,32,5,0,7,6,72,30,248,95,240,240,225,240,203,219,131,159,7,47,15,78,28,56,56,120,55,240,226,228,193,135,225,3,199,6,15,94,12,190,120,254,240,252,225,249,227,225,15,227,15,212,13,24,30,16,116,96,254,192,242,225,225,15,219,7,254,15,92,16,176,60,96,224,160,243,193,247,131,127,31,159,14,60,31,248,50,112,224,192,235,129,163,129,143,7,55,63,44,62,249,250,240,240,193,195,131,204,7,1,14,38,122,93,120,16,232,103,209,243,227,15,5,63,27,190,20,60,240,253,96,240,131,224,3,129,3,15,15,6,62,120,63,120,240,225,253,225,235,199,195,7,79,15,22,28,4,52,0,120,240,177,64,240,195,243,131,207,223,159,63,28,46,120,31,48,224,193,241,129,195,131,5,15,132,30,60,252,62,252,248,250,241,225,255,203,71,131,135,7,28,14,56,16,112,48,160,96,224,211,128,131,7,239,15,222,62,252,63,240,57,240,225,192,225,131,239,3,223,15,54,6,248,63,248,112,224,248,193,211,128,135,139,7,14,204,63,126,112,120,240,240,229,193,225,199,7,7,7,28,14,28,28,56,120,240,240,192,225,193,195,3,23,15,63,31,60,62,248,120,240,224,224,192,128,131,131,15,2,31,60,63,124,60,120,248,97,249,193,231,67,207,7,128,15,44,30,216,62,240,249,224,241,131,229,3,207,3,31,30,4,63,112,122,240,224,252,225,227,211,135,39,15,14,58,56,252,32,192,224,240,169,64,219,131,191,7,255,159,126,29,248,58,252,64,128,64,192,7,1,7,2,30,12,126,25,255,112,248,97,249,131,241,7,197,15,135,31,0,60,24,112,0,240,0,224,129,193,135,231,15,14,62,62,254,60,252,240,248,224,193,195,131,3,4,15,31,28,30,124,56,248,113,224,224,195,131,129,255,15,15,0,30,30,88,24,240,47,240,33,208,131,3,255,11,159,190,95,58,176,254,240,1,128,193,1,1,0,30,31,174,31,252,191,254,117,224,255,227,127,129,195,3,0,15,8,4,188,125,104,112,240,247,224,203,205,246,7,47,3,95,20,0,8,120,176,224,96,193,226,199,207,193,159,23,62,14,124,26,92,32,112,224,224,129,192,229,15,143,7,30,28,61,60,120,120,240,192,224,225,3,193,3,151,15,79,62,156,60,120,249,32,244,65,197,128,128,47,199,15,250,31,28,126,24,124,176,255,225,208,131,231,7,129,7,42,31,12,62,248,126,112,96,0,248,195,167,130,191,159,15,23,196,31,190,123,252,254,189,224,65,194,0,0,4,12,92,183,122,124,124,248,225,240,209,231,131,15,66,14,22,12,0,56,80,240,160,236,225,193,151,161,15,199,31,30,31,26,125,56,116,32,112,0,224,129,193,7,3,15,14,31,56,124,125,254,64,248,128,192,3,224,7,0,7