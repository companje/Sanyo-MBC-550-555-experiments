sound: db 36,183,37,39,50,165,165,77,106,178,173,181,180,164,149,180,18,74,155,36,165,37,91,108,75,150,105,171,36,113,198,146,182,164,37,219,146,72,147,182,166,105,77,50,141,219,172,54,171,109,59,105,45,171,146,37,137,54,41,109,12,106,54,205,182,101,50,146,117,235,66,90,91,168,69,150,174,204,36,203,76,109,90,102,218,162,77,158,180,225,38,9,203,10,205,134,73,146,93,106,218,150,150,153,152,100,177,165,101,51,76,35,115,150,237,37,109,27,179,115,34,141,148,125,146,37,105,216,44,19,91,201,145,246,74,147,39,92,54,153,38,54,13,238,53,164,23,109,59,73,216,72,82,151,59,65,75,130,217,38,59,165,233,79,219,148,204,182,236,38,155,140,153,178,36,217,54,13,108,149,73,146,105,171,109,6,205,236,102,4,82,102,146,77,182,153,54,155,187,205,182,201,36,37,153,34,56,179,109,219,200,108,121,178,164,217,38,51,147,146,115,178,77,54,73,106,201,108,152,100,216,178,54,187,204,114,178,237,166,89,102,217,124,178,173,105,76,162,36,219,182,237,60,155,153,201,146,38,9,206,60,19,185,153,144,205,46,155,73,146,183,219,153,37,155,97,230,109,153,201,72,182,205,196,90,161,37,121,221,38,131,164,103,182,7,146,230,205,4,100,178,45,137,108,19,39,13,27,209,206,38,51,73,146,36,211,206,212,102,183,137,96,150,204,38,179,111,155,37,179,200,88,217,105,19,51,147,157,109,243,100,147,196,38,27,59,201,100,147,20,184,72,106,54,113,211,174,55,201,140,132,188,104,218,200,168,97,179,35,220,14,120,26,225,3,242,225,192,55,12,28,28,60,63,6,230,227,227,193,97,48,126,14,12,255,241,227,224,96,142,143,131,135,31,31,199,140,136,223,227,121,194,207,129,159,241,115,28,126,252,120,200,140,159,7,99,240,255,0,12,158,31,0,226,255,7,128,156,63,15,8,199,143,1,192,243,115,32,48,127,14,4,195,255,17,48,248,127,4,16,243,231,64,120,254,220,0,225,231,227,193,230,231,71,0,247,135,3,227,63,31,24,120,255,12,192,206,191,0,16,191,25,24,48,63,51,144,206,207,39,17,124,124,4,227,228,96,100,230,135,7,38,35,230,224,225,195,140,151,118,208,152,241,181,25,177,225,35,19,231,236,108,51,140,156,153,105,108,198,154,88,200,96,187,201,92,178,205,204,136,153,57,115,50,9,62,25,177,19,227,203,153,113,243,158,17,198,228,135,137,60,27,29,142,159,156,57,164,100,230,205,216,48,54,76,12,31,206,204,157,49,184,220,27,27,51,163,63,195,128,57,55,99,224,135,249,120,224,254,192,129,143,225,1,195,120,192,255,3,240,191,65,188,255,49,206,127,128,247,63,224,193,15,126,204,3,63,250,193,15,255,240,195,63,252,193,31,127,252,134,31,31,227,206,141,241,99,236,248,49,102,220,56,99,92,156,49,46,142,25,39,206,28,19,103,140,139,115,198,205,33,199,196,153,227,226,220,113,115,206,57,49,199,152,152,99,220,140,51,110,206,57,55,230,24,19,115,140,137,57,198,196,28,227,98,154,113,49,199,57,156,225,24,204,113,28,238,56,14,103,60,6,55,30,143,25,143,203,9,199,197,141,231,230,196,227,226,198,99,242,227,113,242,224,49,249,240,49,120,240,56,121,240,152,57,118,156,60,126,28,28,119,28,29,103,140,28,115,140,28,115,204,156,51,206,156,49,198,156,57,230,156,57,103,142,25,103,142,25,99,142,29,99,206,13,99,199,135,115,199,195,241,227,225,184,241,96,220,241,112,238,120,56,126,60,28,119,28,142,59,14,143,29,143,195,143,135,227,143,195,113,199,225,248,227,48,222,227,56,239,113,28,231,56,140,115,28,142,59,14,199,29,135,227,142,195,113,198,193,56,199,225,156,227,96,156,113,0,206,112,96,254,56,32,206,112,56,238,56,4,119,56,198,127,28,226,94,28,241,47,14,248,23,15,236,143,7,231,143,131,243,199,195,241,227,225,248,225,96,254,241,0,255,104,128,127,52,128,127,30,192,63,14,224,31,67,232,143,35,244,207,1,240,199,1,248,179,1,240,251,1,240,207,1,240,31,0,240,127,0,192,127,3,128,255,3,0,255,3,0,254,7,0,244,31,0,226,63,0,194,255,1,98,254,15,32,224,255,1,1,255,219,1,176,255,143,16,128,255,119,0,224,255,3,0,252,63,0,64,252,31,32,228,191,3,48,252,31,16,0,255,127,0,46,254,7,112,225,255,0,7,252,3,123,192,31,216,3,252,129,125,192,31,240,7,252,129,127,128,31,240,15,248,3,255,128,63,240,15,248,3,254,0,127,224,13,240,7,254,1,254,113,31,192,159,129,1,252,231,24,192,127,206,1,240,231,12,16,127,142,8,241,239,200,128,255,70,140,240,103,224,0,251,3,14,240,119,224,128,127,195,12,248,127,204,0,127,70,12,240,47,236,0,255,3,14,240,63,228,128,255,3,14,240,63,224,128,255,3,15,248,31,240,4,254,1,63,240,7,252,1,63,224,31,240,1,255,129,15,248,15,252,0,127,128,31,240,7,220,0,127,192,0,255,67,14,248,31,28,128,127,224,1,127,130,15,240,7,46,240,31,0,176,255,0,136,255,129,128,255,129,1,255,3,30,242,7,24,241,15,24,193,127,128,240,127,0,192,127,0,224,255,0,192,255,0,224,255,32,224,127,24,240,255,24,224,71,156,176,35,14,252,240,7,15,252,129,3,127,224,135,63,120,224,15,28,248,7,15,158,129,7,199,192,193,115,240,224,25,120,240,6,30,124,129,7,255,232,129,63,252,224,31,60,240,14,31,120,135,15,158,195,7,207,225,131,231,240,193,115,240,224,57,124,240,28,60,120,14,30,60,7,15,158,131,7,207,193,131,231,224,193,113,240,224,56,60,112,28,30,56,6,15,30,131,7,207,193,131,199,224,193,99,240,224,57,120,112,28,62,56,14,31,28,135,15,142,195,7,199,225,131,227,240,193,113,248,224,57,124,112,28,62,120,14,31,28,135,15,142,195,7,207,225,131,231,240,193,115,248,224,59,124,224,29,62,240,12,63,120,142,29,56,134,30,60,6,30,60,7,30,60,7,30,28,6,14,28,7,30,60,6,28,120,12,56,240,8,120,240,1,240,224,225,224,193,193,129,31,30,7,62,56,28,248,192,225,224,3,199,193,79,120,4,252,240,57,240,195,243,128,31,30,7,255,57,224,192,15,7,15,248,15,236,128,255,135,14,241,223,8,112,244,31,56,96,254,16,0,248,255,31,224,248,255,0,224,252,63,0,240,221,31,0,199,223,3,3,198,249,113,98,220,241,99,196,128,121,242,124,56,112,124,188,51,100,28,120,23,7,33,115,247,31,128,193,255,200,32,224,248,243,51,30,128,27,243,7,28,144,239,220,12,112,102,30,184,3,230,152,61,31,15,136,243,239,24,24,14,15,135,131,199,195,231,241,193,240,225,120,192,110,240,56,127,0,62,31,15,254,133,143,207,199,133,129,55,142,135,51,198,192,193,227,7,5,225,112,192,241,240,28,33,98,252,113,112,32,188,227,63,240,241,247,177,225,225,25,31,152,49,122,192,129,191,255,0,63,238,15,252,198,28,240,31,252,3,254,224,15,252,131,63,240,15,63,1,31,124,4,252,240,51,224,195,207,128,7,63,6,126,248,56,240,225,225,192,135,159,3,63,126,28,188,248,112,224,195,135,131,7,31,30,60,248,224,224,193,135,7,15,30,60,120,240,193,193,131,15,14,62,124,112,240,225,131,131,15,62,60,124,240,224,225,131,7,15,31,124,120,248,240,227,195,135,31,31,62,124,120,240,225,195,131,15,31,28,252,248,97,224,199,15,15,62,124,112,240,225,131,7,31,62,60,248,240,193,131,15,31,60,248,240,193,131,15,62,60,240,227,195,1,126,240,192,129,31,60,120,240,131,15,30,248,225,131,15,252,192,135,7,254,128,129,129,255,224,1,252,191,3,224,248,63,0,15,254,112,120,240,29,227,131,63,24,60,254,243,65,224,25,31,143,192,3,127,0,30,199,131,225,7,30,30,143,224,225,159,3,31,248,99,124,24,30,192,7,242,24,60,144,7,240,1,124,0,15,224,3,248,128,63,192,15,248,0,62,192,7,240,1,127,8,15,252,97,120,224,15,199,7,126,152,63,240,7,252,65,252,224,63,192,31,248,1,248,192,15,130,15,248,0,252,224,35,14,15,127,196,152,63,142,142,241,33,7,76,156,248,193,7,156,31,248,224,3,55,6,142,145,115,92,252,193,135,31,56,48,126,200,1,240,192,225,35,14,120,112,252,220,25,66,207,157,16,62,200,184,2,63,240,29,240,1,63,224,119,248,113,128,7,248,129,39,226,57,124,240,129,15,63,124,236,131,7,30,240,241,192,255,240,31,248,192,255,192,135,143,15,62,62,56,63,248,1,255,0,191,11,248,3,252,240,238,1,127,128,31,60,252,7,252,3,255,3,254,0,126,240,193,248,1,255,128,15,224,31,60,224,31,240,7,248,129,15,248,7,252,128,23,252,1,63,240,129,63,224,135,27,252,3,62,104,244,3,62,176,193,31,240,67,130,63,224,195,66,63,192,135,2,63,224,71,34,31,232,193,131,31,224,102,192,15,124,176,224,7,62,24,224,7,62,12,248,131,31,6,252,129,15,3,127,192,31,24,126,192,15,142,31,200,15,248,1,252,7,129,15,252,13,124,124,240,227,1,15,128,255,4,30,56,248,225,193,3,31,255,31,56,24,252,241,7,14,200,63,62,15,252,240,239,193,131,95,14,31,200,26,240,225,131,131,15,62,124,252,224,195,131,15,62,62,120,240,225,195,7,31,120,120,248,193,131,15,31,126,248,224,193,15,31,248,224,193,15,31,60,224,199,131,63,248,224,227,23,15,240,129,63,244,8,128,127,255,0,2,255,193,1,31,63,224,193,7,220,255,47,4,240,47,94,128,127,112,2,190,95,11,252,63,22,232,23,62,208,63,124,240,63,60,240,31,38,224,23,134,224,31,22,224,31,19,224,11,59,240,15,61,240,7,61,248,135,30,248,195,30,252,193,15,252,65,15,254,224,5,254,240,1,127,240,128,63,120,128,63,124,193,63,60,192,31,62,224,15,94,224,15,31,240,7,31,240,135,31,248,131,6,248,195,11,252,225,7,254,161,5,254,208,2,127,208,129,127,104,193,63,180,224,15,26,240,7,30,248,67,7,252,161,9,254,208,0,127,104,192,63,52,224,23,26,240,143,13,248,195,6,252,97,3,254,176,0,95,120,128,63,124,192,31,30,224,15,15,248,133,14,252,67,7,254,161,1,255,208,128,63,124,192,23,122,240,11,29,248,133,15,252,194,7,124,225,3,62,240,3,63,248,129,31,248,192,15,124,224,7,126,240,15,63,240,135,47,248,129,23,252,192,11,124,225,1,62,240,1,31,248,160,31,120,192,15,126,224,7,62,240,11,15,248,133,7,252,194,3,126,224,1,63,216,128,31,108,192,15,118,224,7,123,240,131,61,248,193,22,252,96,15,126,176,7,63,88,131,31,236,193,7,246,224,3,123,240,131,61,248,193,14,252,96,11,126,240,5,63,240,131,31,216,130,31,108,193,15,244,192,7,118,224,23,59,240,11,61,240,135,60,248,67,30,252,67,15,254,161,11,254,208,5,255,232,130,127,100,129,63,178,193,62,153,100,31,77,178,139,36,219,71,50,249,39,155,253,19,108,242,9,100,187,12,50,253,2,25,252,3,9,252,3,15,252,67,7,248,225,7,248,247,7,248,243,15,96,219,15,120,240,5,7,248,7,126,240,128,159,63,32,240,159,0,132,127,48,129,63,250,128,255,31,18,249,127,0,224,223,4,240,127,0,254,127,0,254,114,0,191,49,129,159,152,193,15,140,232,71,102,118,35,51,178,145,145,153,201,136,204,100,68,102,50,35,127,25,145,255,76,192,127,54,192,63,27,192,223,15,224,255,7,240,255,3,248,251,1,252,254,0,126,126,0,127,56,128,191,93,192,63,124,192,63,38,224,31,15,224,15,31,240,135,31,240,191,15,224,249,15,0,252,15,0,252,39,0,252,31,0,128,255,1,0,248,63,0,255,15,18,224,63,28,104,128,127,244,3,240,223,38,128,95,254,5,0,250,7,0,232,223,3,128,253,143,4,200,183,15,44,218,31,84,236,79,96,179,125,32,255,100,147,221,134,224,223,10,240,47,39,208,123,211,36,145,205,147,248,193,15,192,187,111,192,247,246,0,254,143,1,236,111,1,248,127,1,240,255,2,240,127,9,192,191,5,192,255,66,32,127,19,128,255,17,192,191,0,192,95,5,226,239,0,179,31,128,216,31,0,236,63,128,246,95,2,254,79,0,253,3,140,126,97,198,31,120,33,95,152,145,15,94,216,3,63,224,131,31,246,192,145,51,242,192,15,62,240,224,27,57,248,13,28,124,102,46,54,3,19,155,193,193,199,228,226,99,240,241,113,248,248,56,60,124,28,30,62,14,31,30,135,15,143,195,135,199,193,195,195,224,225,97,240,240,112,120,120,56,60,60,28,30,30,14,15,15,135,135,135,195,195,195,225,227,225,240,241,112,248,248,56,124,120,28,60,60,12,30,30,14,31,15,135,15,135,195,135,195,227,195,227,241,225,241,249,224,240,120,112,120,124,120,60,62,60,30,31,30,31,15,14,15,15,143,135,135,199,135,131,227,195,195,227,225,225,241,240,240,120,112,112,124,60,120,60,62,60,30,31,30,143,15,143,199,7,199,199,131,195,227,193,227,241,225,241,248,240,248,120,240,120,60,120,60,60,60,60,28,60,30,30,30,30,30,30,30,31,62,22,31,124,22,30,124,14,124,240,8,248,240,209,240,225,225,224,225,193,193,195,135,135,15,15,14,31,15,15,30,30,30,62,60,56,124,112,112,240,9,124,0,62,248,60,248,232,59,240,252,209,97,224,7,193,131,143,135,15,14,7,127,224,3,240,131,7,193,63,216,7,240,15,60,6,30,62,14,128,63,30,0,60,254,14,0,254,63,12,16,127,62,24,224,223,191,7,7,192,227,227,241,240,193,224,241,224,129,96,190,205,62,0,6,254,127,3,156,248,131,71,208,131,235,192,195,195,224,241,241,241,240,112,112,120,120,56,124,248,56,60,124,120,27,46,6,151,183,229,203,134,195,131,195,193,231,115,50,57,123,120,56,120,72,60,252,96,224,160,159,65,142,224,193,7,46,205,193,102,11,30,60,30,12,28,62,28,28,62,62,30,62,12,26,60,196,22,248,102,142,195,243,195,165,240,193,242,241,193,224,225,224,193,225,227,225,241,240,225,241,209,240,108,120,138,30,62,30,30,6,60,154,15,30,147,15,15,31,60,193,15,154,104,195,195,177,248,194,7,251,225,131,230,209,193,224,193,225,115,240,224,49,248,240,61,120,96,155,31,60,76,31,15,135,15,15,7,199,204,225,227,65,244,241,225,240,112,120,60,60,28,14,62,143,7,143,135,135,135,195,195,195,227,225,241,240,240,120,120,124,60,60,60,30,62,30,14,30,30,6,15,15,135,15,158,195,7,147,225,195,225,226,225,225,241,241,241,225,240,209,116,184,52,62,28,14,31,30,30,15,30,31,14,15,15,143,199,227,195,225,241,225,240,225,225,177,120,120,120,120,56,12,30,60,62,30,30,159,15,14,143,143,135,199,135,199,226,99,227,209,193,241,240,240,177,121,112,248,124,56,76,62,30,60,28,30,22,7,31,50,88,150,27,15,19,151,7,15,143,7,143,135,23,207,135,135,135,7,30,60,28,31,62,154,45,248,62,124,56,56,124,224,120,48,124,128,127,192,127,152,230,27,240,3,126,0,30,31,14,28,14,207,7,224,15,222,129,31,252,7,255,15,30,30,30,60,124,0,124,0,30,252,31,248,253,224,224,255,0,248,7,240,96,241,240,193,255,193,242,225,193,240,192,251,0,248,241,0,224,147,63,0,254,255,35,0,255,28,192,151,240,131,127,134,3,143,15,128,15,128,15,192,7,254,15,62,128,31,192,31,192,31,3,126,0,63,240,127,48,240,7,248,7,254,193,192,31,128,63,240,15,0,127,0,254,7,252,7,252,15,240,31,128,31,192,63,0,255,3,225,3,254,3,224,199,192,199,193,63,0,254,1,224,1,240,3,224,127,120,32,0,254,0,252,3,62,0,252,31,128,63,248,15,192,31,15,48,0,255,15,3,15,96,0,128,255,225,7,254,19,64,124,44,248,61,252,193,123,0,30,126,60,128,126,24,248,63,248,7,255,1,255,252,31,252,1,124,240,7,248,1,62,124,7,63,224,129,127,240,3,15,252,131,15,120,240,15,62,224,129,31,60,224,225,56,62,224,225,15,31,120,248,195,55,30,254,240,132,135,57,124,225,33,14,231,56,206,225,152,199,57,158,115,152,225,57,198,13,143,56,252,112,142,227,14,231,60,254,112,238,240,135,243,142,63,28,111,248,224,252,195,7,224,15,62,0,127,240,7,255,3,29,240,31,244,128,255,129,7,254,31,60,224,255,224,129,255,3,15,254,63,240,240,255,1,135,127,7,96,248,131,130,240,15,3,184,127,0,192,255,131,0,254,3,0,248,43,2,224,31,0,192,127,128,3,255,3,12,248,7,0,240,31,32,224,127,0,0,255,3,64,252,7,1,227,47,8,224,63,240,1,254,193,7,112,0,62,31,1,224,248,207,64,48,127,13,16,248,231,1,224,255,63,128,250,227,9,156,199,199,225,192,31,159,0,72,127,3,195,251,120,24,14,236,167,0,250,15,30,252,240,15,226,241,9,236,127,3,127,59,224,15,23,248,163,2,127,84,224,207,12,254,153,192,159,25,252,179,129,126,50,240,103,3,125,118,160,207,38,126,236,192,159,14,252,216,133,63,157,232,145,137,31,187,240,163,19,62,50,225,99,7,126,116,194,71,38,124,108,194,135,78,248,200,132,143,76,248,216,193,31,157,248,147,137,63,59,248,177,131,63,50,241,39,3,63,118,240,99,7,62,116,224,195,6,126,108,224,199,6,126,236,192,135,14,124,200,192,143,13,252,216,192,143,29,248,208,129,31,27,248,177,129,31,58,216,227,3,63,54,240,99,3,63,102,224,195,6,126,108,224,199,12,124,200,192,135,13,252,152,129,15,25,248,176,129,31,51,240,49,3,31,54,240,99,6,62,102,224,195,4,126,204,192,135,13,252,152,128,143,27,248,177,145,31,27,249,177,3,159,25,249,89,216,207,192,63,16,254,31,240,31,248,240,3,188,209,3,126,224,15,124,224,7,126,224,3,62,224,7,126,224,7,62,240,131,31,248,129,63,248,195,31,252,225,15,14,244,48,223,195,31,252,192,124,240,1,15,248,0,63,248,192,15,254,225,15,122,184,199,120,224,15,222,28,135,61,252,224,30,244,131,15,63,108,105,120,240,131,236,192,203,142,135,143,103,112,30,222,199,198,227,240,88,195,24,7,31,28,120,97,248,3,103,68,7,103,60,240,103,252,7,118,248,224,177,60,232,1,151,158,88,226,3,254,192,3,30,156,15,62,240,120,124,228,7,31,216,195,31,174,224,31,248,0,31,207,240,209,57,24,28,199,200,193,56,116,56,116,48,248,24,15,62,138,67,57,202,3,30,159,195,28,135,3,158,195,143,35,29,14,60,143,3,222,225,9,62,237,7,99,60,252,4,206,226,97,60,248,31,77,133,207,227,57,24,31,253,131,127,224,7,250,129,127,240,7,3,124,30,14,199,127,56,24,255,192,128,255,192,15,252,3,62,240,31,120,192,63,240,0,255,192,1,252,129,67,248,3,135,240,15,14,225,31,28,195,63,56,134,127,112,12,255,224,24,254,129,113,252,135,227,248,15,199,241,31,14,241,63,24,194,63,48,132,127,224,0,255,192,1,254,131,3,252,7,135,248,31,12,225,63,24,192,255,192,128,255,1,135,251,25,28,142,247,24,134,195,255,8,4,250,29,2,224,251,30,128,231,127,0,224,127,31,192,225,255,0,0,158,255,31,32,142,255,49,0,255,63,0,192,31,28,0,255,243,0,62,192,7,126,224,195,191,192,65,248,31,7,252,127,62,0,248,247,15,24,207,63,56,3,246,225,63,206,0,63,252,67,24,158,15,99,48,206,211,15,28,207,121,248,128,15,89,130,158,227,80,124,46,204,123,28,206,98,195,39,38,195,15,124,112,19,126,165,78,33,251,15,254,241,0,63,192,232,15,240,235,193,254,17,236,183,129,127,50,216,39,147,237,36,241,71,30,252,224,193,15,28,252,208,131,31,61,248,209,131,31,57,240,161,7,31,122,240,161,5,62,210,224,99,13,62,214,224,67,29,62,148,224,67,139,124,180,192,199,11,124,172,192,199,10,124,172,192,131,10,188,40,193,139,18,188,40,193,139,22,188,104,65,139,22,180,104,73,139,150,180,104,73,139,150,180,108,73,75,26,180,164,97,75,90,246,164,97,79,90,246,160,101,75,90,180,160,69,139,90,180,40,69,139,212,176,80,139,15,165,248,129,10,31,234,209,35,45,45,208,195,7,62,124,72,195,22,42,233,169,21,60,180,160,207,22,240,216,2,30,90,192,215,18,244,208,146,254,180,160,47,37,240,47,41,255,81,192,255,18,240,167,4,253,41,129,127,82,224,15,0,246,39,33,253,3,192,127,8,225,191,148,160,63,130,210,7,75,232,31,0,240,55,9,192,223,8,192,127,0,128,255,32,33,127,0,1,127,9,72,255,19,0,253,7,96,251,23,0,254,31,128,254,63,0,246,63,0,164,255,1,128,255,3,192,255,31,0,254,127,0,188,175,13,105,144,198,255,3,0,255,127,0,64,255,31,0,240,255,15,128,254,255,0,128,254,255,3,129,36,253,255,111,1,208,190,247,158,0,64,255,23,160,192,79,146,84,223,210,190,37,27,196,74,211,146,151,24,246,41,13,173,109,105,13,158,189,148,164,77,250,250,3,64,255,63,1,96,91,255,134,0,75,251,23,128,132,249,158,128,0,240,191,37,5,10,164,255,1,128,252,255,223,3,0,240,127,0,60,129,254,127,64,208,63,252,45,0,218,127,75,248,5,8,255,79,128,150,180,237,9,96,78,224,219,3,148,125,109,75,18,152,135,246,37,160,32,63,208,15,96,121,201,27,144,150,254,129,30,32,61,201,15,252,1,255,217,22,128,255,0,63,248,23,112,64,255,193,2,254,5,14,240,15,124,192,127,96,1,255,1,45,248,15,40,225,127,0,132,255,1,4,252,7,144,240,63,128,234,255,2,10,254,15,32,249,63,0,69,255,1,20,253,7,16,244,31,80,210,127,64,11,254,1,75,250,7,44,225,31,224,5,127,128,5,254,3,60,232,15,240,192,63,224,2,255,0,31,252,7,94,240,31,104,193,255,160,13,255,3,46,248,31,44,193,95,176,37,127,129,150,252,5,16,240,47,80,162,255,64,130,254,2,8,254,43,36,228,175,144,128,191,69,82,255,53,73,254,55,36,233,223,16,164,111,203,128,125,45,17,246,117,64,217,215,33,105,219,135,164,125,31,146,182,125,64,250,245,1,105,215,7,164,90,31,208,178,63,0,205,255,0,254,253,3,250,182,15,232,207,30,176,30,127,128,227,253,1,27,240,7,248,128,63,160,9,63,192,7,252,1,158,240,3,124,194,7,248,0,31,192,3,124,64,15,248,129,31,240,3,126,192,47,252,1,255,176,3,255,193,15,248,7,63,240,15,254,192,31,248,1,127,224,7,254,128,31,248,3,126,224,15,248,129,63,224,5,254,192,23,252,3,31,240,15,124,192,63,240,3,255,128,31,252,3,94,240,15,252,192,63,240,131,127,192,15,252,3,15,240,7,124,192,63,224,1,255,128,7,248,3,28,224,15,113,128,63,220,3,254,113,14,242,255,99,248,195,31,224,61,255,0,206,248,7,120,198,59,196,161,127,224,13,254,7,207,240,63,48,134,255,6,3,248,55,56,128,255,1,3,248,63,48,0,255,3,2,248,63,0,128,255,3,0,240,63,48,0,255,3,7,224,31,240,0,31,252,15,248,192,227,129,15,28,30,252,192,225,225,15,30,15,250,248,225,128,143,28,14,120,28,240,128,199,112,30,120,30,226,129,239,193,31,240,31,252,33,239,97,30,224,63,204,97,254,195,28,224,63,220,3,252,129,7,240,15,55,192,255,128,1,254,23,28,192,63,192,0,254,3,14,208,63,224,1,255,1,14,240,15,112,128,255,0,2,248,15,24,224,127,192,128,255,1,2,252,15,0,224,127,0,192,255,7,240,240,127,0,15,254,7,224,63,249,31,128,255,255,3,128,254,63,0,224,255,63,128,95,254,3,240,195,63,192,66,255,128,0,254,203,7,208,95,62,0,223,250,7,78,200,27,96,0,127,168,73,248,190,23,8,160,63,98,129,252,175,6,176,255,15,192,246,127,64,66,255,1,172,173,55,0,90,134,95,200,7,120,9,191,65,53,236,73,88,242,35,28,208,79,120,71,62,211,182,232,10,167,116,19,172,210,22,240,39,125,198,122,90,1,255,202,151,176,157,63,67,134,171,166,93,138,135,94,134,77,155,172,70,62,128,28,43,18,68,15,147,175,133,189,89,1,254,147,36,189,134,192,191,69,250,31,64,255,7,192,255,2,168,255,11,208,255,4,232,221,116,43,5,250,183,66,248,23,9,242,47,0,232,31,0,253,22,224,223,2,252,91,160,127,11,244,111,129,246,47,208,191,5,248,191,64,255,23,224,95,2,252,79,128,127,9,240,63,0,254,23,192,255,0,248,95,0,255,11,224,127,1,252,47,192,255,5,240,191,0,255,19,224,127,2,252,79,128,255,9,240,191,1,254,55,192,255,6,248,223,0,255,11,224,111,1,252,45,128,191,5,240,183,0,254,23,192,255,2,248,223,0,127,27,224,127,3,252,109,128,255,13,240,191,1,254,55,192,255,6,248,95,0,255,11,240,127,1,254,7,192,223,2,252,27,128,63,9,240,231,0,254,22,192,223,0,252,9,225,15,39,240,229,66,31,78,224,195,9,124,189,192,135,3,240,122,1,15,7,224,113,12,62,142,192,227,12,124,156,193,199,57,248,56,3,143,113,232,17,134,30,227,240,35,12,63,206,241,199,24,254,28,227,14,49,252,49,194,31,102,248,227,132,127,204,240,199,8,255,24,241,15,3,254,49,192,31,7,252,227,128,127,14,248,199,0,255,24,224,143,3,252,49,200,63,134,248,71,24,127,12,229,143,1,252,49,132,63,6,248,135,0,255,24,192,159,3,252,99,128,255,4,208,63,1,240,47,0,252,41,161,127,4,232,31,192,191,3,240,79,128,253,27,0,127,6,192,191,32,224,127,0,240,255,179,3,252,255,7,224,255,3,192,255,72,0,253,255,63,0,248,191,0,32,254,223,2,0,255,23,128,252,255,0,0,128,255,7,128,126,50,248,31,240,15,255,129,95,96,191,222,1,248,221,6,192,79,124,128,221,110,49,80,255,1,7,240,15,120,128,127,224,7,248,3,126,192,31,240,7,252,3,127,192,63,224,7,252,157,15,232,225,63,128,7,255,243,1,124,251,3,240,225,63,192,1,255,0,0,252,127,0,240,249,31,0,1,254,126,3,192,254,31,0,244,254,3,144,189,221,0,248,243,62,128,31,242,3,58,224,31,240,1,127,240,7,252,129,55,240,5,60,240,15,248,192,31,240,3,126,224,15,248,166,31,144,7,254,192,23,240,3,90,224,47,232,35,255,32,27,240,6,191,0,122,187,4,237,142,169,94,180,25,244,133,191,192,111,127,1,222,223,18,140,78,167,146,237,65,247,172,109,34,73,222,2,127,64,38,244,147,254,64,187,229,4,125,210,15,200,18,249,8,108,211,63,224,39,176,15,108,130,63,40,62,249,79,99,242,119,0,62,240,47,246,131,205,70,7,157,216,27,248,68,7,63,248,224,129,15,62,158,193,97,56,216,108,131,203,100,48,217,14,183,201,96,147,13,46,147,193,54,25,76,22,195,100,48,216,38,135,205,98,240,12,6,223,229,240,25,12,190,193,225,179,24,60,131,195,102,48,248,6,135,77,96,240,13,15,155,224,160,155,30,124,241,193,39,55,248,160,6,15,110,208,97,13,30,204,160,195,26,124,56,129,135,55,248,48,6,31,207,224,225,12,62,158,193,199,51,120,56,138,15,71,241,241,44,30,142,199,195,241,120,186,28,30,151,195,231,99,248,116,12,159,174,193,211,53,120,186,6,31,150,193,195,53,248,240,12,30,62,193,135,103,240,224,25,60,121,6,15,158,69,147,103,208,101,17,252,249,28,252,112,12,58,120,6,31,124,14,30,244,44,120,248,124,248,240,240,240,225,225,195,135,135,15,31,62,60,124,240,113,240,195,143,129,31,62,12,252,240,33,192,31,126,24,248,193,99,2,255,160,126,192,255,100,7,224,127,18,96,240,63,0,3,248,55,120,0,127,211,39,240,7,108,150,207,130,13,104,31,252,131,63,192,7,255,31,12,248,242,255,128,15,62,29,52,120,250,131,32,73,122,244,29,184,129,117,192,255,164,9,154,242,99,226,240,201,7,221,39,120,57,236,65,131,79,36,248,32,17,220,77,182,225,193,124,26,6,231,147,124,120,136,108,67,146,77,7,191,225,48,125,14,166,201,35,60,137,78,179,65,126,54,12,238,135,102,240,124,88,54,77,202,38,201,53,217,68,63,210,118,96,178,63,36,220,7,196,207,162,232,250,36,248,135,196,163,121,208,36,192,159,224,227,251,128,77,131,167,109,129,237,55,137,79,210,134,109,192,31,132,195,217,64,127,146,6,230,195,240,96,4,240,79,240,121,18,31,130,62,2,158,3,227,7,79,30,7,231,4,156,19,230,142,129,103,29,127,3,248,15,62,143,199,241,1,231,131,249,0,207,241,49,60,128,115,230,7,248,112,124,192,7,240,8,127,184,15,252,99,248,8,31,15,199,227,99,240,100,28,68,7,126,62,0,194,227,195,7,112,2,62,248,240,1,144,135,159,31,0,240,248,241,1,128,139,31,28,0,248,248,225,1,1,15,31,60,112,240,240,199,7,132,13,62,120,0,117,224,7,31,192,7,254,224,3,124,224,7,22,192,7,255,192,5,6,255,15,0,80,240,55,31,0,70,255,241,1,40,252,191,15,128,224,227,27,0,28,255,143,3,192,240,127,31,4,193,231,231,224,0,92,158,7,131,131,121,176,73,18,164,241,31,76,156,77,151,71,211,231,16,124,145,46,203,52,31,125,7,0,79,255,7,32,31,199,31,128,15,254,79,208,30,252,127,112,22,176,127,128,193,192,127,0,56,192,127,0,124,224,127,64,63,224,31,16,60,240,55,224,31,240,31,224,15,240,15,240,7,248,7,248,7,252,3,252,1,255,1,127,192,127,128,63,224,63,192,31,240,15,224,15,252,7,240,3,254,3,240,3,255,0,248,225,31,0,124,240,15,192,7,248,7,240,7,254,3,248,192,127,0,252,244,127,0,244,255,127,0,240,255,63,0,248,255,15,0,254,255,15,0,254,255,7,128,175,255,1,192,255,255,1,224,203,127,0,240,254,255,0,248,251,63,0,248,255,63,0,252,251,31,0,62,252,15,0,63,255,7,0,246,255,7,128,255,255,3,0,255,255,3,128,255,255,1,224,251,255,1,96,255,127,0,240,255,31,0,224,255,7,0,248,255,0,0,254,15,0,224,255,1,0,252,255,0,0,255,31,0,224,255,1,0,252,127,0,128,255,31,0,248,255,0,0,254,15,0,192,255,1,0,252,63,32,192,255,3,2,250,63,112,192,255,3,7,252,61,240,192,159,3,14,252,123,240,192,255,135,7,252,31,60,224,255,192,3,254,15,60,192,127,224,1,254,7,30,230,123,240,96,158,7,15,247,61,120,48,207,131,131,241,60,60,152,207,193,131,249,28,30,140,207,225,225,248,24,30,140,15,224,193,255,0,30,252,15,224,193,255,0,30,252,31,224,193,255,1,30,248,31,240,193,255,1,14,248,63,224,128,255,1,15,240,63,96,0,255,7,6,240,127,96,0,255,7,7,224,247,224,0,126,28,1,224,143,65,192,254,30,4,228,239,227,96,253,13,26,132,255,193,0,248,242,14,192,135,255,1,24,224,31,54,1,254,231,7,176,109,219,6,223,182,3,162,79,209,96,31,52,217,182,73,208,253,23,4,230,195,3,208,119,113,0,126,240,1,248,224,87,240,96,176,240,35,192,199,195,129,215,229,3,63,159,12,254,15,6,92,31,193,199,151,192,255,113,192,255,135,193,255,240,129,127,240,193,63,240,129,63,240,193,31,248,224,15,252,224,7,127,240,131,63,252,225,15,126,240,15,127,248,13,127,248,142,63,254,134,29,115,198,28,57,99,14,156,33,7,206,129,3,207,128,3,199,192,131,231,224,129,99,224,193,115,240,192,49,240,224,57,120,224,24,120,240,28,60,240,12,28,248,14,30,252,6,14,124,6,15,124,3,31,126,131,7,62,131,7,191,129,7,159,193,131,223,192,131,207,224,193,103,228,192,103,240,224,51,112,240,25,56,240,25,60,248,12,28,124,6,30,60,7,15,62,3,7,159,129,131,207,192,129,231,224,193,103,224,224,51,240,240,25,120,248,140,60,124,70,62,62,35,31,159,145,139,207,200,193,103,228,224,51,114,240,25,60,248,12,30,124,6,7,158,131,3,207,192,129,103,224,192,51,112,224,25,57,240,140,28,120,70,14,60,3,7,30,131,7,159,145,139,207,200,133,103,228,195,115,240,227,49,240,225,25,248,240,12,252,120,14,124,124,6,62,60,3,63,158,3,31,143,129,15,207,192,143,231,192,199,99,224,227,51,240,227,57,240,241,25,248,248,12,124,124,6,62,60,7,30,62,3,31,159,137,15,207,198,7,99,227,163,49,179,209,153,217,200,204,108,100,102,54,50,51,19,153,153,137,205,204,196,70,102,98,35,51,185,177,153,217,208,192,108,96,99,51,240,161,27,217,137,15,78,204,7,39,7,7,23,7,131,143,131,131,135,201,131,115,244,100,112,112,112,56,120,120,124,120,120,124,60,60,14,30,30,15,15,142,15,15,143,135,7,231,131,131,243,192,193,249,224,224,240,224,112,112,112,113,121,248,184,60,120,88,44,124,108,30,62,118,50,31,59,131,143,139,139,143,143,135,199,193,193,199,199,193,115,98,99,112,129,195,249,88,108,204,100,112,30,39,19,62,30,7,31,59,11,15,15,227,112,60,198,3,159,227,113,120,28,206,231,113,56,30,231,112,14,227,48,30,227,112,134,113,56,206,57,24,227,120,28,59,14,199,57,30,103,12,199,243,132,31,61,198,241,28,224,62,30,195,231,156,49,250,30,128,227,255,56,246,30,62,246,15,48,250,31,7,98,103,7,56,227,7,143,129,67,253,225,142,199,57,158,200,249,135,227,49,130,78,230,192,123,176,199,113,184,197,116,120,241,49,60,240,18,62,224,25,118,248,3,54,60,140,215,194,135,11,171,194,79,164,201,65,242,233,19,236,193,51,230,206,242,224,120,200,159,179,192,212,112,60,62,201,26,28,131,91,14,143,15,143,231,15,158,129,75,252,196,79,252,128,27,120,16,46,185,149,13,47,223,15,6,159,199,7,158,200,5,201,225,125,232,224,120,88,102,54,120,158,39,26,166,143,27,135,143,56,152,199,196,193,71,230,228,112,240,224,113,50,51,25,56,176,201,156,152,13,28,28,71,14,142,7,14,30,15,31,198,129,39,183,137,131,123,248,192,231,228,242,114,114,224,115,240,224,1,126,216,4,126,112,0,63,248,128,31,124,192,15,62,240,7,15,248,193,7,254,224,131,111,129,193,119,193,100,251,96,178,109,48,217,62,152,108,31,92,52,31,12,186,109,6,159,39,147,205,131,201,230,195,65,247,197,224,195,98,240,225,114,248,112,48,248,120,56,124,56,24,60,60,28,62,28,14,30,14,7,15,7,135,135,135,131,199,195,193,227,225,225,225,225,224,241,240,240,120,112,120,124,56,120,60,56,60,62,28,60,30,28,60,31,30,30,29,30,158,13,14,158,14,14,30,14,14,30,15,14,159,15,15,159,15,15,159,15,15,159,31,14,223,31,14,158,31,14,158,31,14,159,15,15,223,15,7,207,15,7,207,7,7,207,7,7,207,15,7,207,7,7,239,3,135,239,147,131,239,139,131,231,131,131,231,131,195,231,131,195,243,193,195,243,193,225,241,224,97,248,224,96,248,224,48,120,242,128,121,243,192,253,123,192,239,99,0,255,79,0,223,143,4,255,15,7,254,15,6,192,47,10,192,255,9,0,255,7,0,248,63,0,224,127,0,192,255,1,0,252,31,8,248,127,0,0,255,2,12,252,31,0,252,255,0,28,248,31,0,16,254,7,16,224,127,0,0,254,31,0,128,255,63,0,252,255,15,0,246,255,3,0,255,255,1,0,255,255,0,0,254,127,0,60,126,30,60,8,240,63,112,63,64,62,241,255,131,0,240,255,227,0,192,255,239,3,192,195,251,225,225,125,192,153,52,240,255,167,128,0,240,249,65,112,240,125,255,126,193,2,224,227,255,129,64,224,229,195,101,224,225,192,225,255,97,240,240,192,120,240,120,240,195,79,74,146,224,35,201,224,3,134,135,64,242,232,107,254,1,252,56,10,248,0,22,252,28,60,200,9,240,31,124,48,126,124,14,248,60,31,6,56,60,6,27,120,12,28,96,31,52,13,188,4,7,32,105,56,120,56,124,95,56,60,124,56,124,248,56,62,52,45,184,63,60,60,62,28,60,46,79,32,109,60,40,182,72,63,96,26,216,83,222,6,150,22,206,5,252,6,47,216,60,201,11,36,111,131,3,240,191,246,133,225,231,193,160,241,223,132,21,236,55,5,128,143,31,134,13,253,7,28,145,75,246,242,193,144,240,112,241,240,228,228,104,240,124,124,216,52,185,95,26,28,124,24,28,30,109,36,60,102,116,114,60,124,58,112,51,29,72,146,77,54,217,100,209,225,231,97,99,211,224,193,227,131,225,227,227,193,193,131,225,193,163,193,229,35,131,195,246,209,226,203,135,7,239,15,104,73,105,240,129,151,226,32,76,210,161,101,147,147,177,236,178,225,240,252,36,249,236,180,176,173,72,122,206,36,96,39,185,108,70,248,104,27,209,112,248,64,105,60,153,156,36,201,62,4,76,182,45,100,62,184,60,30,146,188,30,26,240,60,25,204,176,189,68,100,240,37,150,240,100,252,2,238,244,31,136,209,31,128,130,255,0,30,254,15,192,73,31,2,227,123,22,128,207,161,1,254,131,73,241,15,224,39,95,128,223,245,5,208,151,232,5,230,128,127,136,6,254,7,2,196,127,2,0,255,63,1,16,219,159,6,0,255,47,12,88,190,31,2,216,255,7,0,246,255,128,128,252,248,25,102,196,237,121,121,240,7,18,192,255,144,0,218,93,63,0,253,243,4,240,143,31,128,255,9,0,255,255,1,128,255,15,128,255,255,8,0,254,7,96,249,127,144,0,252,3,104,76,255,3,234,248,1,128,255,5,7,254,31,0,248,126,192,7,199,15,120,248,255,125,240,127,192,31,224,31,248,7,248,15,254,2,63,192,7,248,29,126,192,7,255,29,124,128,131,127,0,31,60,240,127,240,1,15,231,29,62,240,240,240,225,15,143,167,14,31,60,252,51,60,240,112,116,120,240,224,112,248,224,225,225,240,192,195,225,225,193,195,195,225,129,195,199,225,129,195,195,225,193,195,243,225,193,195,241,225,225,227,241,225,240,225,248,240,248,225,248,240,240,113,252,112,248,48,222,120,240,56,254,120,240,56,254,120,240,56,248,120,240,248,248,248,240,224,106,248,240,224,106,248,241,193,43,248,225,193,39,238,224,193,31,238,192,129,31,127,226,131,15,63,226,135,15,63,142,135,15,31,30,131,15,30,60,130,15,30,60,225,47,62,124,240,97,62,252,240,240,31,124,24,248,51,48,66,254,60,248,224,195,3,60,120,240,32,14,30,28,140,131,231,131,225,240,248,56,60,60,31,135,143,207,225,224,227,115,62,252,232,220,143,59,58,114,112,142,143,79,192,227,227,35,240,248,124,12,63,30,143,195,143,199,225,184,227,113,28,230,120,156,135,57,14,199,35,142,195,49,176,227,112,14,238,56,62,131,63,142,207,112,15,227,51,140,227,120,142,227,56,143,99,60,198,241,24,199,120,28,227,24,143,99,30,227,115,196,99,60,198,56,198,227,24,199,56,142,51,140,199,240,227,120,142,31,131,51,252,24,158,97,198,225,28,55,6,231,240,153,156,142,199,112,60,30,203,205,112,44,62,195,209,120,12,231,115,24,142,227,49,141,204,15,26,17,15,39,7,15,13,6,167,185,137,79,20,145,249,56,153,221,108,98,60,156,204,78,50,177,28,14,199,51,25,28,15,147,209,73,46,38,223,193,248,104,6,147,205,68,102,51,152,77,6,226,227,69,208,103,3,226,241,34,225,179,195,224,255,3,224,251,1,224,255,3,252,127,0,252,63,0,254,127,0,254,31,0,255,46,128,255,7,224,255,3,128,63,0,224,127,2,254,127,0,252,15,0,254,7,0,255,8,192,191,15,200,127,4,248,127,0,250,135,1,255,15,0,255,108,0,254,22,224,255,0,240,63,56,240,123,120,240,237,112,208,241,249,64,252,119,0,240,63,0,240,127,112,224,255,252,16,0,255,3,32,254,63,0,252,31,56,26,0,62,216,30,28,252,205,0,252,31,14,243,252,12,28,15,30,12,191,143,15,3,15,3,254,15,12,62,14,14,240,7,126,24,62,24,124,184,185,242,120,48,124,62,240,112,240,202,120,120,240,156,225,233,176,225,225,129,5,135,135,195,195,227,144,195,195,135,7,15,135,195,241,97,143,45,143,39,224,128,195,227,84,30,15,127,24,120,140,151,131,47,61,116,240,248,52,8,58,255,241,6,71,162,135,212,197,195,65,56,143,126,80,243,195,230,167,192,255,193,224,255,0,240,255,34,240,143,6,248,103,131,252,178,192,254,89,32,191,36,152,47,19,204,151,73,230,203,38,251,36,145,109,146,100,159,104,146,77,52,233,54,153,116,155,76,186,79,38,221,47,3,236,151,65,246,203,0,240,255,33,240,255,36,16,252,55,8,248,63,0,164,255,6,240,255,15,128,255,63,0,254,44,7,224,191,65,32,239,49,22,226,31,241,1,240,145,126,192,206,253,0,64,254,103,128,49,127,194,0,248,127,10,0,254,183,1,120,255,15,96,208,189,1,225,36,255,131,195,224,255,0,145,255,9,228,179,105,50,118,131,221,102,194,112,219,129,202,114,27,128,5,247,64,114,208,13,146,44,243,107,224,76,110,168,241,13,48,23,227,139,113,38,179,145,217,36,243,62,196,142,60,144,183,9,166,111,163,200,109,10,62,179,230,8,127,36,30,12,238,190,160,63,188,188,30,209,255,4,0,255,2,192,255,38,240,255,34,248,127,17,248,63,0,252,31,0,254,14,144,127,22,137,63,9,196,159,4,232,71,2,252,35,1,254,145,2,223,72,129,111,180,232,23,74,240,11,5,248,197,2,252,35,1,254,145,2,223,74,145,47,164,232,23,74,244,11,21,250,149,42,253,10,21,254,149,10,255,72,133,47,164,200,23,90,244,11,45,250,133,22,253,66,137,126,161,68,191,80,162,95,40,209,47,148,232,23,74,244,11,37,250,133,18,253,66,139,126,163,69,62,145,66,191,72,160,95,36,208,47,146,232,23,75,244,11,37,250,133,22,248,70,10,253,35,137,126,129,68,191,64,162,223,104,209,111,180,200,55,90,228,27,45,244,137,4,250,68,2,253,34,129,126,145,64,191,72,160,95,36,208,47,18,248,23,9,252,139,4,254,69,2,255,34,129,127,144,192,55,104,240,11,52,248,5,27,252,130,13,126,193,6,191,32,131,127,144,193,31,72,224,15,52,240,19,26,248,9,13,252,132,6,126,64,2,63,105,129,15,181,128,135,223,208,195,111,104,225,55,44,240,27,22,248,31,6,252,15,11,254,14,1,222,143,1,230,143,1,242,15,7,224,15,7,232,15,7,252,31,6,248,127,0,128,255,1,0,255,7,0,252,31,0,224,63,0,128,255,1,0,253,7,64,248,31,0,240,127,128,67,255,7,120,131,63,128,61,240,31,224,3,254,3,12,224,255,0,20,248,255,0,248,224,255,0,248,148,255,3,252,3,254,3,240,7,252,15,192,63,128,255,0,252,7,240,31,192,63,224,255,7,0,224,255,0,254,1,248,63,0,248,119,248,255,0,224,255,62,0,255,3,224,63,224,255,240,3,192,255,0,255,192,30,0,254,15,248,0,224,1,248,127,192,31,128,126,0,255,3,252,0,248,0,254,7,192,127,192,30,240,255,3,248,1,248,2,240,31,200,31,0,254,129,207,3,240,125,1,198,127,0,96,254,255,6,12,1,0,252,159,38,96,255,127,128,127,128,126,147,128,61,0,63,32,33,105,242,29,1,254,158,144,127,128,7,144,159,36,100,127,182,1,208,255,166,65,9,191,192,240,125,186,4,75,91,80,158,244,75,48,222,134,229,128,248,127,128,32,249,252,9,146,190,47,1,32,109,75,75,18,120,199,32,105,70,108,144,110,137,176,164,37,41,164,109,123,65,91,182,253,54,160,127,2,223,210,230,40,216,214,82,219,194,214,16,240,63,0,107,214,82,2,255,133,180,246,47,41,144,86,74,155,63,1,253,79,104,63,72,237,3,145,163,180,22,192,146,189,5,232,63,172,31,192,151,96,238,64,178,15,178,1,255,4,218,32,41,165,216,148,222,1,124,91,120,2,252,191,128,237,73,1,208,23,248,95,34,249,182,228,211,68,218,250,97,211,210,49,110,136,230,100,25,177,79,80,70,219,19,146,180,194,130,73,69,69,150,191,129,218,182,12,107,123,72,208,111,156,72,183,193,178,109,144,242,165,97,206,169,64,114,207,146,36,215,200,39,160,39,237,146,217,38,179,73,242,109,0,242,109,9,251,38,32,255,45,96,249,26,4,248,155,134,180,117,17,64,255,18,192,52,39,65,250,75,122,192,63,177,35,254,3,127,207,15,200,29,182,4,174,100,99,50,6,254,203,19,236,222,36,33,179,63,136,205,253,54,56,178,75,219,6,252,225,187,128,124,242,54,160,102,255,150,0,179,77,242,64,74,82,55,182,21,5,109,131,204,166,136,109,31,148,25,91,206,7,4,232,165,84,39,193,242,102,198,95,27,129,110,157,18,220,70,21,137,170,217,114,36,179,202,108,191,7,222,164,160,145,186,145,153,146,221,114,219,102,248,150,89,6,252,161,233,130,127,192,229,193,7,105,205,62,240,249,194,23,252,128,1,254,224,7,62,96,98,248,1,15,71,134,31,248,0,159,241,7,14,248,51,254,192,129,7,134,31,63,124,120,252,240,224,225,195,135,7,11,143,31,15,134,14,63,62,30,12,31,31,142,7,15,7,238,192,193,225,56,120,248,80,6,255,7,119,240,227,129,6,31,31,120,224,193,7,7,31,252,24,248,193,103,192,15,63,0,63,124,1,252,225,3,240,135,31,192,127,224,1,252,47,192,192,251,255,1,129,255,15,0,248,255,0,128,255,15,0,248,255,3,15,127,63,48,112,240,7,16,15,63,32,56,248,96,1,240,125,0,32,248,31,30,248,255,241,97,242,78,11,28,125,104,241,102,248,9,109,141,79,178,147,145,73,164,15,11,77,207,214,134,135,143,7,210,248,89,22,44,27,219,194,227,29,104,43,250,240,194,224,243,193,196,114,25,232,147,246,28,54,30,101,225,115,30,60,240,248,0,188,241,225,255,13,192,255,1,40,255,1,49,248,137,7,224,159,3,0,255,131,4,252,31,8,252,31,11,192,251,54,0,223,159,7,36,127,31,8,252,127,96,240,248,225,0,224,227,131,0,3,223,246,135,1,192,255,31,0,128,255,31,0,254,63,0,254,127,0,200,255,7,79,8,154,62,62,48,248,127,48,192,251,109,1,222,151,4,254,15,2,228,223,0,200,254,0,184,253,13,192,99,154,49,255,7,9,187,7,75,252,195,182,182,49,209,251,134,36,190,184,13,248,150,180,33,158,25,55,220,48,44,90,176,112,123,126,120,122,234,24,200,240,103,128,241,221,33,109,153,99,39,135,217,71,143,25,15,6,238,224,128,221,204,3,195,241,143,132,227,71,0,252,255,0,192,63,7,224,255,63,0,255,247,0,252,63,199,240,63,31,135,251,1,28,236,7,252,160,31,240,7,255,192,63,248,3,255,225,31,248,7,127,224,27,252,129,239,240,15,62,135,63,240,25,254,161,231,240,7,60,195,63,240,12,254,128,119,224,7,254,1,254,224,15,224,15,248,7,126,6,124,192,127,224,3,240,3,14,192,191,225,0,255,115,3,240,255,255,128,255,251,7,240,231,127,0,28,248,31,0,128,255,31,0,188,255,1,128,244,31,124,64,159,192,131,15,128,62,248,1,127,193,7,252,193,63,248,131,63,128,27,254,16,166,241,7,60,128,15,246,0,62,248,7,248,65,126,224,7,254,128,31,252,3,126,240,31,240,3,252,128,31,240,7,252,128,62,248,1,252,160,15,208,3,254,144,63,252,129,254,1,30,255,132,151,252,27,194,57,198,208,210,209,64,7,198,15,242,228,1,188,199,237,217,39,101,253,23,224,79,3,224,63,0,130,255,2,10,254,3,0,240,63,0,208,127,0,192,127,128,0,255,1,2,254,3,1,252,15,4,240,31,120,192,127,224,3,255,192,15,252,3,63,224,15,248,129,63,240,15,254,128,15,248,3,126,192,31,252,1,127,240,15,252,193,63,240,3,255,192,15,252,1,63,240,15,252,192,63,224,3,255,128,15,252,3,127,240,7,252,193,87,224,7,30,129,31,124,4,126,240,17,248,195,71,224,15,31,1,63,124,4,254,240,17,248,193,79,224,7,31,129,63,252,4,126,240,21,248,195,103,224,7,31,129,31,124,6,126,240,12,252,192,43,240,131,239,192,15,190,129,63,120,6,126,240,29,248,193,119,224,3,239,192,15,188,3,63,120,14,252,224,25,248,193,119,224,7,207,192,31,62,3,63,120,12,252,224,17,248,193,103,224,7,143,129,31,60,2,63,248,12,252,224,49,240,193,71,224,7,159,129,31,124,6,63,240,25,252,224,35,240,131,159,192,15,62,3,63,248,12,252,224,59,240,131,239,224,15,254,131,63,248,14,254,224,63,248,131,255,224,15,254,129,63,248,6,126,224,25,248,129,111,224,7,158,129,31,124,6,62,240,17,252,192,71,240,3,159,193,15,124,6,63,248,9,124,192,39,248,129,143,224,7,62,131,31,248,12,62,240,31,248,192,119,240,3,255,193,15,60,7,31,248,30,124,224,55,248,193,247,224,7,159,131,31,124,14,62,240,57,248,192,231,224,7,31,131,31,124,24,124,240,97,240,193,135,193,7,31,14,62,124,56,248,224,193,224,131,7,135,31,30,60,124,248,240,240,193,195,195,7,15,31,62,60,120,248,240,224,225,195,135,135,15,31,30,62,124,120,240,240,225,193,195,135,7,15,31,30,60,120,120,240,225,225,193,131,135,7,31,30,30,60,120,120,248,224,225,224,131,135,131,15,30,14,62,120,60,248,224,240,224,131,195,129,15,15,7,31,60,30,124,112,120,240,193,225,192,135,199,131,15,30,15,62,60,60,248,240,240,224,195,195,131,15,158,15,126,224,63,240,129,255,128,15,62,3,126,248,96,240,224,129,225,131,7,131,31,30,28,126,124,112,240,240,224,193,195,131,135,7,15,30,30,60,120,120,240,224,225,195,131,131,143,7,15,62,62,28,248,240,112,224,195,193,131,15,7,47,62,28,190,248,112,248,226,195,193,131,79,7,15,46,30,124,120,120,240,225,225,225,13,135,7,63,25,31,220,100,124,120,147,224,193,143,195,7,63,22,31,248,20,124,240,83,240,193,143,195,7,63,14,31,252,56,124,240,195,248,192,31,229,129,95,148,3,254,1,159,232,135,60,2,31,56,104,120,224,241,225,193,199,135,7,15,31,30,60,124,120,240,240,224,225,193,131,135,15,15,30,62,94,112,120,176,225,225,145,25,204,100,112,180,195,131,197,31,15,124,240,124,224,131,231,131,31,240,15,60,139,47,155,48,60,120,193,240,225,50,135,131,15,178,12,252,192,121,240,65,100,131,15,96,19,124,16,205,226,195,124,150,31,102,179,120,16,139,228,131,88,36,31,196,162,249,48,22,205,135,177,104,60,140,193,226,67,12,22,31,226,178,248,0,7,205,7,48,88,124,128,193,226,131,28,22,31,228,176,248,0,7,205,31,56,72,254,193,195,226,15,28,52,127,192,32,225,3,15,154,62,248,144,249,129,7,137,31,252,16,248,65,15,192,31,224,2,249,3,30,32,63,224,1,252,1,248,192,255,3,15,216,63,160,8,248,63,96,129,255,7,3,138,63,14,60,252,127,224,192,241,3,128,131,255,15,12,254,127,0,248,248,247,192,195,255,7,6,30,127,24,112,240,255,0,224,227,159,1,30,255,31,0,126,252,19,192,227,255,3,224,195,255,3,132,95,126,32,120,240,63,0,62,240,63,192,31,252,31,240,15,126,30,248,7,255,15,252,135,143,7,231,131,143,7,255,195,135,7,254,225,135,7,239,224,135,3,127,240,225,129,63,248,225,0,30,126,120,8,14,62,60,0,3,255,128,128,131,255,193,199,1,224,224,255,128,0,224,135,7,6,248,47,62,28,248,128,227,239,127,0,15,255,63,12,56,252,62,4,0,255,252,0,12,252,255,24,71,248,240,65,226,121,194,131,127,126,150,192,244,241,224,225,249,131,5,195,155,103,48,121,158,31,192,227,90,112,115,79,30,223,67,15,60,159,7,130,61,15,134,47,195,3,180,15,135,71,217,38,9,79,210,195,224,192,162,219,165,129,244,15,14,164,59,188,64,211,130,63,56,224,232,113,240,240,135,71,90,240,192,243,129,3,135,3,31,28,120,252,0,252,224,131,132,63,0,254,237,0,224,199,135,31,30,30,62,120,240,135,15,15,254,195,143,63,248,224,227,7,240,240,241,193,59,252,248,224,7,31,31,240,195,199,7,255,225,227,3,127,248,120,64,63,254,31,128,15,255,7,224,195,255,1,120,240,253,0,62,252,63,128,15,190,15,224,131,255,3,248,128,255,0,62,224,63,128,31,240,15,192,7,248,1,240,1,254,1,60,0,127,0,6,240,31,128,3,255,15,0,0,255,7,0,224,255,7,0,128,255,7,96,136,255,1,54,192,127,0,14,240,63,192,15,224,31,128,31,248,19,240,209,255,1,224,13,127,0,30,252,95,240,1,252,255,158,0,135,79,255,13,60,56,253,19,200,130,225,3,31,5,255,224,127,32,120,240,227,193,7,254,0,122,12,62,94,240,225,125,0,124,224,227,3,126,14,254,128,255,224,241,193,135,15,15,120,240,14,14,31,62,240,160,31,30,30,224,227,64,3,158,7,31,30,120,120,8,207,131,227,3,126,60,8,254,135,225,248,1,158,7,127,240,48,248,15,134,241,3,124,30,222,192,195,113,60,128,127,224,195,0,252,7,199,136,240,3,62,48,248,7,60,120,192,31,48,226,1,62,192,135,7,252,1,31,15,248,7,248,31,240,127,192,63,192,255,3,127,0,255,15,134,1,252,127,0,0,142,252,3,0,12,255,15,0,32,254,255,0,128,240,255,1,0,200,255,15,0,192,255,127,0,72,253,255,5,64,235,255,3,0,128,255,7,0,192,255,255,0,32,254,255,3,0,135,255,15,0,224,255,255,1,64,255,255,7,0,250,255,31,0,192,255,255,31,0,248,255,255,0,0,255,255,31,0,240,255,255,0,0,255,255,15,0,240,255,255,1,0,255,255,15,0,192,255,255,1,0,252,255,255,1,0,252,255,11,0,192,255,255,1,0,225,255,31,0,0,207,255,49,0,126,124,15,112,192,195,63,192,33,12,255,3,28,62,248,195,224,129,227,31,7,6,14,127,56,28,35,248,227,112,140,195,31,199,25,134,127,28,60,56,252,113,240,224,248,227,193,1,225,207,129,7,5,255,15,62,0,252,31,240,6,224,63,128,15,128,255,7,14,0,254,31,240,56,192,255,15,0,128,255,1,0,12,255,253,1,160,254,63,0,224,255,63,0,8,255,31,0,128,240,127,0,128,135,255,1,0,62,248,31,0,112,224,127,0,0,128,255,1,0,248,253,31,0,192,255,127,1,0,126,252,15,0,240,255,255,1,128,127,248,15,0,248,143,255,1,192,255,255,7,0,252,255,127,0,224,255,255,1,0,254,255,31,0,224,255,255,3,0,254,255,31,0,224,255,255,3,0,254,255,15,0,224,255,127,0,0,255,255,7,0,248,255,255,0,0,255,255,15,0,224,255,31,0,16,248,127,0,248,3,255,3,232,3,248,31,192,15,240,127,0,31,192,255,128,127,0,255,0,255,0,254,1,254,1,252,3,254,3,248,7,248,15,224,31,224,31,192,63,128,127,128,255,0,255,0,254,3,252,1,252,7,240,7,240,31,192,31,192,255,0,127,128,255,3,248,1,252,31,96,1,252,255,95,0,248,237,255,1,240,7,254,7,224,63,248,63,0,255,129,255,1,240,15,254,15,0,255,224,127,0,248,15,255,7,128,255,241,127,0,224,255,255,31,0,252,127,255,15,0,248,255,255,7,0,255,71,255,1,224,127,192,127,0,248,15,252,15,0,255,215,255,1,128,255,255,127,0,240,255,255,7,0,252,127,255,1,128,255,247,127,0,248,255,253,7,0,255,255,127,0,240,255,255,3,0,255,255,31,0,248,255,127,0,240,175,255,3,192,127,248,31,0,254,240,127,0,252,237,255,0,160,243,255,0,252,129,255,0,252,249,63,128,127,192,127,0,254,129,255,0,254,252,63,0,11,240,31,0,63,192,127,0,254,2,254,3,240,7,252,7,224,15,240,63,128,63,192,255,1,248,128,255,15,0,0,255,127,0,0,240,255,255,31,0,223,254,255,1,0,224,255,159,4,0,252,255,255,0,32,233,255,7,0,36,224,107,41,91,124,2,65,74,248,242,54,6,8,218,255,111,11,0,248,255,47,64,208,146,236,135,238,47,10,2,246,223,30,164,225,218,150,45,72,158,107,104,82,22,225