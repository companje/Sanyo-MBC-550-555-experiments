sound: db 88,2,254,255,0,128,255,63,0,192,255,31,0,240,255,15,0,248,255,3,0,254,255,1,0,255,127,0,128,255,63,0,224,255,15,0,240,255,7,0,252,255,3,0,254,255,0,128,255,127,0,192,255,31,0,224,255,15,0,248,255,3,0,252,255,1,0,255,255,0,128,255,63,0,224,255,31,0,240,255,7,0,248,255,3,0,254,255,0,0,255,127,0,192,255,63,0,224,255,15,0,240,255,7,0,252,255,1,0,254,255,0,128,255,127,0,192,255,31,0,240,255,15,0,248,255,3,0,252,255,1,0,255,127,0,128,255,63,0,224,255,31,0,240,255,7,0,252,255,3,0,254,255,0,0,255,127,0,192,255,31,0,224,255,15,0,248,255,7,0,252,255,1,0,255,255,0,128,255,63,0,192,255,31,0,240,255,15,0,248,255,3,0,254,255,1,0,255,127,0,128,255,63,0,224,255,15,0,240,255,7,0,252,255,3,0,254,255,0,128,255,127,0,192,255,31,0,224,255,15,0,248,255,3,0,252,255,1,0,255,255,0,128,255,63,0,224,255,31,0,240,255,7,0,248,255,3,0,254,255,0,0,255,127,0,192,255,63,0,224,255,15,0,240,255,7,0,252,255,1,0,254,255,0,128,255,127,0,192,255,31,0,240,255,15,0,248,255,3,0,252,255,1,0,255,127,0,128,255,63,0,224,255,31,0,240,255,7,0,252,255,3,0,254,255,0,0,255,127,0,192,255,31,0,224,255,15,0,248,255,7,0,252,255,1,0,255,255,0,128,255,63,0,192,255,31,0,240,255,7,0,248,255,3,0,254,255,1,0,255,127,0,128,255,63,0,224,255,15,0,240,255,7,0,252,255,3,0,254,255,0,128,255,127,0,192,255,31,0,224,255,15,0,248,255,3,0,252,255,1,0,255,255,0,128,255,63,0,224,255,31,0,240,255,7,0,248,255,3,0,254,255,0,0,255,127,0,192,255,63,0,224,255,15,0,248,255,7,0,252,255,1,0,254,255,0,128,255,127,0,192,255,31,0,240,255,15,0,248,255,3,0,252,255,1,0,255,127,0,128,255,63,0,224,255,31,0,240,255,7,0,252,255,3,0,254,255,0,0,255,127,0,192,255,31,0,224,255,15,0,248,255,7,0,252,255,1,0,255,255,0,128,255,63,0,192,255,31,0,240,255,7,0,248,255,3,0,254,255,1,0,255,127,0,128,255,63,0,224,255,15,0,240,255,7,0,252,255,3,0,254,255,0,128,255,127,0,192,255,31,0,224,255,15,0,248,255,3,0,252,255,1,0,255,255,0,128,255,63,0,224,255,31,0,240,255,7,0,248,255,3,0