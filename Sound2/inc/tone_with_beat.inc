sound: db 144,6,254,3,248,15,224,63,128,255,0,254,3,248,15,192,127,0,255,1,252,7,240,31,192,127,0,255,3,248,15,224,63,128,255,0,254,3,248,31,192,127,0,255,1,252,7,240,31,192,127,0,255,3,248,15,224,63,128,255,0,254,3,248,15,192,127,0,255,1,252,7,240,31,192,127,0,254,3,248,15,224,63,128,255,0,254,3,248,31,192,127,0,255,1,252,7,240,31,192,127,0,255,3,248,15,224,63,128,255,0,254,3,248,15,192,127,0,255,1,252,7,240,31,192,127,0,255,3,248,15,224,63,128,255,0,254,3,248,15,192,127,0,255,1,252,7,240,31,192,127,0,254,3,248,15,224,63,128,255,0,254,3,248,15,192,127,0,255,1,252,7,240,31,192,127,0,254,3,248,15,224,63,128,255,0,254,3,248,15,192,127,0,255,1,252,7,240,31,192,127,0,148,107,15,35,252,0,19,65,5,49,137,8,24,117,16,97,154,161,128,0,227,242,75,103,8,185,168,0,65,77,245,108,22,94,12,6,47,229,26,89,45,60,53,1,9,64,42,168,40,219,92,3,10,192,50,44,189,44,128,46,153,129,84,22,2,11,3,2,128,122,148,118,36,129,45,15,101,192,12,82,254,3,248,15,224,63,128,255,0,254,3,248,15,192,127,0,255,1,252,7,240,31,192,127,0,255,3,248,15,224,63,128,255,0,254,3,248,31,192,127,0,255,1,252,7,240,31,192,127,0,255,3,248,15,224,63,128,255,0,254,3,248,15,192,127,0,255,1,252,7,240,31,192,127,0,254,3,248,15,224,63,128,255,0,254,3,248,31,192,127,0,255,1,252,7,240,31,192,127,0,255,3,248,15,224,63,128,255,0,254,3,248,15,192,127,0,255,1,252,7,240,31,192,127,0,255,3,248,15,224,63,128,255,0,254,3,248,15,192,127,0,255,1,252,7,240,31,192,127,0,254,3,248,15,224,63,128,255,0,254,3,248,15,192,127,0,255,1,252,7,240,31,192,127,0,254,3,248,15,224,63,128,255,0,254,3,248,15,192,127,0,255,1,252,7,240,31,192,127,0,33,172,52,84,114,150,41,17,34,239,240,238,74,26,55,85,67,196,145,38,8,73,176,94,73,162,9,231,193,4,17,97,66,36,72,39,36,144,38,34,11,218,28,204,19,10,80,137,236,102,3,18,6,221,136,6,49,183,115,47,179,83,174,228,77,155,231,129,10,12,11,137,20,212,57,201,4,38,199,130,254,3,248,15,224,63,128,255,0,254,3,248,15,192,127,0,255,1,252,7,240,31,192,127,0,255,3,248,15,224,63,128,255,0,254,3,248,31,192,127,0,255,1,252,7,240,31,192,127,0,255,3,248,15,224,63,128,255,0,254,3,248,15,192,127,0,255,1,252,7,240,31,192,127,0,254,3,248,15,224,63,128,255,0,254,3,248,31,192,127,0,255,1,252,7,240,31,192,127,0,255,3,248,15,224,63,128,255,0,254,3,248,15,192,127,0,255,1,252,7,240,31,192,127,0,255,3,248,15,224,63,128,255,0,254,3,248,15,192,127,0,255,1,252,7,240,31,192,127,0,254,3,248,15,224,63,128,255,0,254,3,248,15,192,127,0,255,1,252,7,240,31,192,127,0,254,3,248,15,224,63,128,255,0,254,3,248,15,192,127,0,255,1,252,7,240,31,192,127,0,75,4,13,116,22,37,16,202,167,196,66,82,2,234,49,60,67,64,20,96,32,4,222,17,26,37,102,212,50,70,88,130,4,97,128,6,51,34,18,67,61,143,24,22,1,236,97,145,215,16,163,15,65,8,90,180,15,204,0,146,168,7,135,82,165,85,156,138,74,34,149,37,42,128,66,192,210,48,160,122,254,3,248,15,224,63,128,255,0,254,3,248,15,192,127,0,255,1,252,7,240,31,192,127,0,255,3,248,15,224,63,128,255,0,254,3,248,31,192,127,0,255,1,252,7,240,31,192,127,0,255,3,248,15,224,63,128,255,0,254,3,248,15,192,127,0,255,1,252,7,240,31,192,127,0,254,3,248,15,224,63,128,255,0,254,3,248,31,192,127,0,255,1,252,7,240,31,192,127,0,255,3,248,15,224,63,128,255,0,254,3,248,15,192,127,0,255,1,252,7,240,31,192,127,0,255,3,248,15,224,63,128,255,0,254,3,248,15,192,127,0,255,1,252,7,240,31,192,127,0,254,3,248,15,224,63,128,255,0,254,3,248,15,192,127,0,255,1,252,7,240,31,192,127,0,254,3,248,15,224,63,128,255,0,254,3,248,15,192,127,0,255,1,252,7,240,31,192,127,0,212,156,36,18,172,13,22,8,117,71,42,244,124,57,9,48,2,54,77,117,242,18,163,19,133,136,40,122,16,145,132,204,12,191,248,10,2,42,180,72,85,143,84,88,10,182,33,88,208,211,65,110,240,42,2,88,12,90,200,178,84,192,168,0,8,184,183,57,51,108,140,0,98,154,114,92,69,75,104,17,254,3,248,15,224,63,128,255,0,254,3,248,15,192,127,0,255,1,252,7,240,31,192,127,0,255,3,248,15,224,63,128,255,0,254,3,248,31,192,127,0,255,1,252,7,240,31,192,127,0,255,3,248,15,224,63,128,255,0,254,3,248,15,192,127,0,255,1,252,7,240,31,192,127,0,254,3,248,15,224,63,128,255,0,254,3,248,31,192,127,0,255,1,252,7,240,31,192,127,0,255,3,248,15,224,63,128,255,0,254,3,248,15,192,127,0,255,1,252,7,240,31,192,127,0,255,3,248,15,224,63,128,255,0,254,3,248,15,192,127,0,255,1,252,7,240,31,192,127,0,254,3,248,15,224,63,128,255,0,254,3,248,15,192,127,0,255,1,252,7,240,31,192,127,0,254,3,248,15,224,63,128,255,0,254,3,248,15,192,127,0,255,1,252,7,240,31,192,127,0,8,80,160,241,24,228,0,138,8,33,155,50,128,104,37,164,12,6,148,88,169,216,197,28,179,77,31,102,69,10,49,226,164,80,144,178,68,4,20,199,1,232,226,145,10,211,0,64,33,179,50,236,232,20,146,144,21,113,129,226,143,230,2,56,99,50,72,128,92,1,91,0,162,32,128,87,94,128,220,174,254,3,248,15,224,63,128,255,0,254,3,248,15,192,127,0,255,1,252,7,240,31,192,127,0,255,3,248,15,224,63,128,255,0,254,3,248,31,192,127,0,255,1,252,7,240,31,192,127,0,255,3,248,15,224,63,128,255,0,254,3,248,15,192,127,0,255,1,252,7,240,31,192,127,0,254,3,248,15,224,63,128,255,0,254,3,248,31,192,127,0,255,1,252,7,240,31,192,127,0,255,3,248,15,224,63,128,255,0,254,3,248,15,192,127,0,255,1,252,7,240,31,192,127,0,255,3,248,15,224,63,128,255,0,254,3,248,15,192,127,0,255,1,252,7,240,31,192,127,0,254,3,248,15,224,63,128,255,0,254,3,248,15,192,127,0,255,1,252,7,240,31,192,127,0,254,3,248,15,224,63,128,255,0,254,3,248,15,192,127,0,255,1,252,7,240,31,192,127,0,23,202,37,73,10,242,181,19,17,0,132,73,2,200,144,41,176,19,110,14,121,144,100,38,144,188,113,51,9,5,144,206,230,130,184,25,5,65,130,114,56,137,0,19,39,17,49,0,127,7,136,7,143,40,102,94,3,233,4,48,150,104,56,158,100,106,250,129,236,2,17,133,251,51,65,64,10,254,118,196