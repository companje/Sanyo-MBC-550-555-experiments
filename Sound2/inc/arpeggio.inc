sound: db 176,4,254,3,248,15,224,63,128,255,0,254,3,248,15,192,127,0,255,1,252,7,240,31,192,127,0,255,3,248,15,224,63,128,255,0,254,3,248,31,192,127,0,255,1,252,7,240,31,192,127,0,255,3,248,15,224,63,128,255,0,254,3,248,15,192,127,0,255,1,252,7,240,31,192,127,0,254,3,248,15,224,63,128,255,0,254,3,248,31,192,127,0,255,1,252,7,240,31,192,127,0,126,224,7,126,224,7,126,224,7,126,224,7,254,192,15,252,192,15,252,192,15,252,192,15,252,129,31,248,129,31,248,129,31,248,129,31,248,1,63,240,3,63,240,3,63,240,3,63,240,3,126,224,7,126,224,7,126,224,7,126,224,7,254,192,15,252,192,15,252,192,15,252,192,15,252,129,31,248,129,31,248,129,31,248,129,31,248,1,63,240,3,63,240,3,63,240,3,63,240,3,30,60,120,240,224,193,131,15,31,62,124,248,240,193,131,7,15,30,124,248,240,225,195,135,15,31,60,120,240,224,193,131,15,31,62,124,248,224,193,131,7,15,30,124,248,240,225,195,135,15,31,60,120,240,224,193,131,15,31,62,124,248,240,193,131,7,15,30,60,248,240,225,195,135,15,30,60,120,240,224,193,131,15,31,62,124,248,224,193,131,7,15,30,60,248,240,225,195,135,15,254,3,248,15,224,63,128,255,0,254,3,248,15,192,127,0,255,1,252,7,240,31,192,127,0,255,3,248,15,224,63,128,255,0,254,3,248,31,192,127,0,255,1,252,7,240,31,192,127,0,255,3,248,15,224,63,128,255,0,254,3,248,15,192,127,0,255,1,252,7,240,31,192,127,0,254,3,248,15,224,63,128,255,0,254,3,248,31,192,127,0,255,1,252,7,240,31,192,127,0,126,224,7,126,224,7,126,224,7,126,224,7,254,192,15,252,192,15,252,192,15,252,192,15,252,129,31,248,129,31,248,129,31,248,129,31,248,1,63,240,3,63,240,3,63,240,3,63,240,3,126,224,7,126,224,7,126,224,7,126,224,7,254,192,15,252,192,15,252,192,15,252,192,15,252,129,31,248,129,31,248,129,31,248,129,31,248,1,63,240,3,63,240,3,63,240,3,63,240,3,30,60,120,240,224,193,131,15,31,62,124,248,240,193,131,7,15,30,124,248,240,225,195,135,15,31,60,120,240,224,193,131,15,31,62,124,248,224,193,131,7,15,30,124,248,240,225,195,135,15,31,60,120,240,224,193,131,15,31,62,124,248,240,193,131,7,15,30,60,248,240,225,195,135,15,30,60,120,240,224,193,131,15,31,62,124,248,224,193,131,7,15,30,60,248,240,225,195,135,15,254,3,248,15,224,63,128,255,0,254,3,248,15,192,127,0,255,1,252,7,240,31,192,127,0,255,3,248,15,224,63,128,255,0,254,3,248,31,192,127,0,255,1,252,7,240,31,192,127,0,255,3,248,15,224,63,128,255,0,254,3,248,15,192,127,0,255,1,252,7,240,31,192,127,0,254,3,248,15,224,63,128,255,0,254,3,248,31,192,127,0,255,1,252,7,240,31,192,127,0,126,224,7,126,224,7,126,224,7,126,224,7,254,192,15,252,192,15,252,192,15,252,192,15,252,129,31,248,129,31,248,129,31,248,129,31,248,1,63,240,3,63,240,3,63,240,3,63,240,3,126,224,7,126,224,7,126,224,7,126,224,7,254,192,15,252,192,15,252,192,15,252,192,15,252,129,31,248,129,31,248,129,31,248,129,31,248,1,63,240,3,63,240,3,63,240,3,63,240,3,30,60,120,240,224,193,131,15,31,62,124,248,240,193,131,7,15,30,124,248,240,225,195,135,15,31,60,120,240,224,193,131,15,31,62,124,248,224,193,131,7,15,30,124,248,240,225,195,135,15,31,60,120,240,224,193,131,15,31,62,124,248,240,193,131,7,15,30,60,248,240,225,195,135,15,30,60,120,240,224,193,131,15,31,62,124,248,224,193,131,7,15,30,60,248,240,225,195,135,15,254,3,248,15,224,63,128,255,0,254,3,248,15,192,127,0,255,1,252,7,240,31,192,127,0,255,3,248,15,224,63,128,255,0,254,3,248,31,192,127,0,255,1,252,7,240,31,192,127,0,255,3,248,15,224,63,128,255,0,254,3,248,15,192,127,0,255,1,252,7,240,31,192,127,0,254,3,248,15,224,63,128,255,0,254,3,248,31,192,127,0,255,1,252,7,240,31,192,127,0,126,224,7,126,224,7,126,224,7,126,224,7,254,192,15,252,192,15,252,192,15,252,192,15,252,129,31,248,129,31,248,129,31,248,129,31,248,1,63,240,3,63,240,3,63,240,3,63,240,3,126,224,7,126,224,7,126,224,7,126,224,7,254,192,15,252,192,15,252,192,15,252,192,15,252,129,31,248,129,31,248,129,31,248,129,31,248,1,63,240,3,63,240,3,63,240,3,63,240,3,30,60,120,240,224,193,131,15,31,62,124,248,240,193,131,7,15,30,124,248,240,225,195,135,15,31,60,120,240,224,193,131,15,31,62,124,248,224,193,131,7,15,30,124,248,240,225,195,135,15,31,60,120,240,224,193,131,15,31,62,124,248,240,193,131,7,15,30,60,248,240,225,195,135,15,30,60,120,240,224,193,131,15,31,62,124,248,224,193,131,7,15,30,60,248,240,225,195,135,15