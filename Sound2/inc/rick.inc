sound: db 170,170,170,170,170,170,170,170,170,170,170,170,170,170,170,170,170,170,170,170,170,170,170,170,170,170,170,170,170,170,170,170,170,170,170,170,170,170,170,170,170,170,170,170,170,170,170,170,170,170,170,170,170,170,170,170,170,170,170,170,170,170,170,170,170,170,170,170,170,170,170,170,170,170,170,170,170,170,170,170,170,170,170,170,170,170,170,170,170,170,170,170,170,170,170,170,170,170,170,170,170,170,170,170,170,170,170,170,170,170,170,170,170,170,170,170,170,170,170,170,170,170,170,170,170,170,170,170,170,170,170,170,170,170,170,170,170,170,170,170,170,170,170,170,170,170,170,170,170,170,170,170,170,170,170,10,172,34,32,128,168,10,8,138,168,234,234,170,163,170,0,234,138,162,162,160,170,168,170,32,40,2,136,42,10,170,234,255,255,171,255,255,191,234,170,170,170,170,170,170,170,170,170,170,170,170,170,170,170,170,170,170,171,170,168,254,191,42,130,162,146,6,30,220,25,248,127,0,224,255,3,0,255,31,0,248,255,7,32,255,111,0,128,255,187,128,238,255,19,2,152,255,103,0,52,255,191,0,224,251,31,0,160,190,254,0,2,250,251,255,24,0,184,255,5,0,160,223,127,0,8,216,239,191,1,2,217,255,252,1,0,192,255,223,0,0,146,255,67,8,4,255,184,254,255,1,192,255,255,3,0,128,59,160,255,43,0,192,255,255,127,0,9,248,235,127,223,238,7,8,243,255,159,0,0,255,135,238,3,48,71,7,224,255,63,0,176,63,240,248,255,3,128,234,242,224,135,15,0,253,7,0,254,63,0,192,191,5,160,255,255,3,68,255,17,0,223,255,46,128,253,63,2,192,253,79,0,192,255,255,1,0,252,255,143,3,0,249,255,121,0,0,255,127,7,0,230,127,5,6,246,127,0,224,136,251,249,19,0,64,254,159,159,0,2,254,255,15,0,0,252,255,0,0,224,215,129,199,63,0,154,254,255,199,3,160,2,255,255,7,0,248,255,255,7,64,1,31,204,232,15,255,0,48,241,255,15,0,64,240,255,255,0,16,245,240,253,255,3,128,224,135,223,255,255,2,144,249,229,175,255,15,8,0,224,254,95,1,14,255,0,192,127,139,255,13,0,8,252,125,191,109,16,192,213,245,239,255,1,0,96,255,255,15,22,4,32,254,255,5,0,240,255,31,1,0,254,255,23,0,0,208,247,255,7,0,128,31,47,232,255,133,47,240,15,252,0,248,243,115,127,0,0,240,255,95,0,120,226,39,0,231,255,7,0,0,254,127,241,3,224,255,63,0,0,238,255,7,89,251,253,5,0,243,255,95,16,0,248,254,255,145,5,230,23,120,0,0,252,255,51,128,119,4,20,253,253,119,224,3,31,248,31,0,252,215,0,160,255,127,1,131,127,10,128,248,127,7,224,252,31,1,128,253,255,0,0,255,255,39,0,254,191,0,0,224,255,31,32,0,127,255,55,10,240,255,255,0,0,252,255,63,0,128,246,191,55,0,2,249,223,95,0,0,240,255,1,0,224,151,254,247,75,64,0,237,255,255,0,224,191,189,76,31,8,0,128,255,31,0,20,252,246,255,75,7,128,1,234,255,7,52,128,192,255,67,5,160,193,66,253,255,7,16,0,224,255,15,0,193,1,86,255,239,75,63,20,0,96,255,255,252,160,7,191,192,255,0,136,255,63,0,240,255,15,64,248,255,11,0,253,223,1,0,255,191,3,128,252,31,7,192,255,127,0,0,255,255,1,0,248,255,31,0,128,254,255,10,0,212,255,255,9,0,240,191,95,0,8,252,95,63,16,128,224,191,255,0,32,250,255,1,0,136,162,190,127,63,0,0,248,255,7,0,1,254,237,191,241,4,0,63,255,215,64,5,0,159,254,255,224,7,0,224,255,255,1,0,252,255,119,96,241,7,24,160,231,255,63,128,255,255,192,224,119,11,80,207,1,158,223,255,0,0,232,240,129,15,240,7,192,255,47,0,254,223,3,192,255,127,0,240,255,207,0,252,255,25,0,164,255,167,0,16,255,67,0,252,255,7,0,248,255,31,0,192,255,127,18,0,240,255,255,1,0,224,255,191,2,0,252,111,6,84,6,254,255,81,3,16,232,255,31,0,128,172,230,255,122,2,56,232,255,14,0,128,255,255,15,240,147,125,208,251,135,6,0,238,127,254,1,2,0,255,192,255,249,1,2,254,255,63,0,108,252,240,0,255,63,96,2,166,255,3,40,248,63,0,254,251,232,227,95,49,242,1,127,65,240,7,4,240,255,31,1,224,241,255,6,129,255,31,0,128,252,255,15,0,0,255,255,66,1,254,225,7,192,5,252,95,13,0,224,255,7,0,160,255,255,7,0,16,251,255,175,13,0,64,235,255,92,11,0,194,255,63,4,0,128,254,255,15,1,0,240,255,255,15,0,0,208,205,255,250,51,0,0,255,255,19,0,200,252,211,0,232,255,23,2,0,254,63,21,0,252,249,132,15,252,255,7,0,0,254,255,87,0,4,236,239,23,32,230,254,15,224,115,255,127,96,128,127,240,63,0,240,194,13,126,208,125,0,254,255,24,0,251,255,8,0,255,255,35,0,252,255,39,1,160,255,127,0,0,232,255,63,32,128,255,255,9,0,232,255,223,0,0,214,253,19,8,20,252,255,182,0,48,233,127,147,8,128,238,255,223,68,0,128,192,255,255,128,0,252,241,191,3,9,80,93,253,255,67,138,1,248,23,255,7,2,0,250,255,255,0,160,185,255,95,2,160,1,188,0,253,175,92,0,0,127,252,223,255,87,7,0,128,238,255,255,2,0,4,248,175,63,240,255,1,0,0,254,255,223,10,8,58,240,7,244,7,126,88,19,2,216,255,63,0,0,224,255,31,0,224,255,251,0,0,224,255,255,2,128,250,255,27,2,0,247,251,63,2,0,64,255,255,95,3,0,188,186,255,5,41,64,250,255,158,0,192,97,252,119,254,14,0,0,244,255,255,7,0,2,250,127,238,33,0,188,192,175,255,159,180,4,0,255,253,127,28,32,1,0,2,253,255,5,0,0,224,255,191,199,27,32,9,0,188,255,254,252,0,248,17,67,149,0,255,255,15,175,0,96,197,139,252,255,5,0,0,232,255,31,32,249,255,255,15,96,1,63,232,127,0,132,255,1,0,200,255,31,16,0,255,255,18,2,192,255,255,3,4,224,127,39,0,160,252,255,95,4,0,124,255,255,53,0,0,211,255,241,15,64,47,244,79,4,0,236,255,255,117,0,0,248,255,247,151,3,98,128,250,255,255,3,0,0,254,255,255,64,0,0,252,199,191,15,251,3,128,132,254,255,239,139,2,0,0,255,255,223,17,0,116,253,254,252,3,23,0,0,250,251,255,95,0,116,0,254,31,144,255,81,96,13,192,159,92,153,255,7,4,64,224,255,249,13,125,96,71,47,60,48,243,122,31,112,3,252,255,48,15,64,0,128,255,255,255,1,0,0,250,255,127,255,7,0,0,0,0,248,255,255,255,11,0,0,0,32,253,255,255,255,255,127,0,0,0,128,192,255,255,255,255,255,3,0,0,0,192,255,255,255,255,87,0,0,0,0,160,248,255,255,255,255,255,255,63,0,0,0,0,0,240,255,255,255,255,3,0,0,0,0,0,252,255,243,255,255,255,255,255,1,0,0,8,0,0,128,92,239,255,255,127,133,255,223,15,247,94,0,0,56,133,0,0,252,163,253,255,255,191,2,104,5,64,0,249,1,0,40,191,192,239,255,255,251,127,62,32,24,1,0,0,131,253,239,126,59,251,220,255,255,223,8,168,192,11,255,245,10,187,254,128,5,14,115,130,67,104,64,42,156,222,120,183,192,137,247,126,128,17,46,167,7,222,255,246,6,60,192,80,0,176,129,219,255,128,49,8,255,31,31,248,127,3,96,231,102,127,224,220,239,31,192,9,4,16,57,133,26,187,151,200,33,243,255,81,110,255,30,0,101,127,252,0,252,127,216,129,23,128,193,153,7,48,130,255,40,240,98,27,213,32,255,195,193,129,63,16,3,114,240,255,207,251,0,32,112,57,192,127,254,43,24,174,114,177,1,248,64,191,191,255,3,0,208,15,253,123,255,3,128,132,67,227,255,255,255,167,2,31,0,8,0,0,160,247,255,191,131,250,239,244,79,227,15,0,0,0,0,224,251,191,255,127,255,3,76,7,63,0,108,254,95,72,0,253,0,169,213,63,0,0,248,0,191,255,255,237,255,255,7,192,111,120,1,0,252,47,0,2,252,23,240,255,255,37,2,235,7,244,243,255,3,254,139,31,0,160,17,2,16,144,127,0,131,31,30,28,255,31,56,0,224,31,248,191,15,160,59,157,39,230,1,255,0,138,1,213,22,184,80,229,254,247,255,0,2,192,237,254,203,87,0,0,240,7,252,255,255,31,124,0,0,0,0,14,0,254,223,255,255,131,31,255,51,223,63,0,0,0,0,224,7,254,255,7,255,33,248,7,184,128,255,47,255,31,0,100,128,191,156,204,103,7,0,248,15,240,255,255,255,252,1,248,13,192,63,0,224,255,255,27,0,0,255,3,248,127,7,0,128,252,135,23,248,255,1,254,240,1,0,12,95,0,253,223,0,232,255,141,0,48,255,255,13,0,0,160,255,255,60,66,128,249,63,21,0,0,192,251,255,255,33,0,0,0,192,255,255,255,127,9,0,0,0,48,236,255,255,255,191,4,0,0,0,0,252,255,255,255,255,59,0,0,0,0,0,250,255,255,255,47,2,0,0,0,0,32,253,124,255,255,255,253,0,1,96,0,236,54,1,252,255,255,255,63,0,8,0,24,0,0,232,17,251,255,255,255,63,250,63,0,0,0,0,0,62,3,253,223,255,255,95,252,127,1,0,64,0,20,0,244,247,159,255,255,230,207,241,248,47,128,3,31,192,232,49,252,192,7,63,127,232,231,255,199,7,0,4,0,255,255,227,255,127,0,252,15,192,255,127,255,1,0,252,255,155,255,192,103,2,248,192,2,254,255,255,18,248,192,255,255,243,71,0,32,192,15,0,212,254,255,64,128,255,252,127,191,31,120,0,240,0,0,224,255,249,15,0,128,255,255,255,195,7,0,0,8,0,64,233,31,184,129,72,254,255,143,111,118,129,209,11,0,0,255,255,31,0,16,248,255,255,179,223,0,0,224,1,112,255,247,11,44,224,151,255,175,221,57,134,3,172,31,1,128,31,254,47,0,0,143,99,132,239,31,0,194,255,143,0,0,128,3,246,255,255,255,1,24,16,0,254,127,128,255,255,23,1,128,231,255,63,252,128,0,8,0,192,255,72,218,255,31,0,131,103,1,236,143,20,1,0,0,242,253,62,104,255,255,191,94,3,0,129,255,5,0,18,0,2,96,240,255,251,247,255,255,3,0,72,6,8,2,60,0,0,16,64,178,255,199,255,255,223,179,1,64,220,255,89,32,0,160,129,52,200,255,255,241,255,255,3,56,64,5,232,114,85,128,0,5,216,191,87,65,255,255,199,250,88,0,224,167,5,12,130,64,0,15,95,253,255,176,204,255,25,0,249,179,32,152,29,26,16,81,6,111,22,125,221,239,131,65,245,47,226,244,148,7,152,44,88,38,31,228,223,46,193,179,255,130,65,254,15,144,233,63,46,146,28,252,12,155,42,59,23,129,226,254,3,193,252,47,32,208,159,15,44,127,176,1,190,79,62,72,192,201,190,3,176,253,159,64,147,63,11,4,255,224,0,247,17,127,224,7,197,255,15,12,254,63,128,204,255,4,146,239,19,0,250,70,31,96,113,184,127,19,18,251,55,6,56,254,51,119,192,0,0,253,255,255,131,0,0,0,250,255,255,255,63,0,0,0,0,248,255,255,255,31,0,0,0,192,255,255,255,255,255,15,0,0,0,0,240,255,255,255,255,127,0,0,0,0,0,128,255,255,255,255,255,1,0,0,0,240,213,255,255,255,127,240,31,0,0,0,0,40,232,255,255,255,255,31,252,0,2,1,0,0,0,229,127,0,255,255,255,255,255,7,0,0,0,192,131,255,255,255,255,247,223,62,0,0,0,0,0,248,47,216,252,255,255,255,255,255,255,8,0,0,0,0,0,128,96,176,255,255,255,255,255,255,63,255,255,3,0,0,0,0,0,60,0,254,255,207,255,237,171,103,240,7,240,250,7,192,93,9,64,0,63,128,254,255,5,255,187,65,18,253,7,104,251,15,192,101,127,4,192,127,128,199,255,1,190,75,17,1,254,7,112,253,31,224,251,126,19,224,255,0,130,255,3,124,132,111,2,252,15,0,240,31,160,226,241,93,128,255,3,4,255,3,123,38,172,46,240,31,0,242,127,192,229,219,95,0,254,19,1,254,0,127,0,236,31,160,255,14,131,127,155,14,0,28,240,192,255,1,4,5,60,138,252,255,240,255,0,128,127,1,0,0,126,240,239,255,1,0,0,0,0,240,95,240,255,7,240,255,31,0,0,252,0,224,255,3,8,128,6,28,224,255,240,255,23,192,255,31,0,0,248,3,232,255,31,248,162,255,15,224,255,193,255,7,0,127,0,0,0,80,23,224,255,127,240,199,255,15,160,255,3,221,7,0,63,0,2,0,64,63,192,255,143,252,71,255,159,136,255,71,255,3,128,31,0,0,0,128,31,224,255,17,255,183,255,255,69,255,225,155,7,204,63,0,4,0,224,27,240,255,3,248,31,248,253,1,255,3,250,63,128,63,0,0,2,192,15,224,255,7,240,143,252,211,129,255,3,120,183,128,254,0,30,32,192,63,128,255,127,240,15,248,71,7,252,7,252,193,5,254,0,91,56,128,127,128,63,248,192,79,176,175,19,240,15,248,3,56,248,3,0,119,131,127,128,127,208,7,255,4,250,52,240,15,232,11,112,209,31,128,46,82,127,128,255,153,32,248,69,209,7,250,15,240,15,29,172,190,0,124,192,255,128,124,219,21,209,39,95,0,252,31,0,232,255,36,0,224,255,255,63,0,0,225,254,255,26,3,64,252,255,42,0,128,250,255,255,255,11,0,0,0,240,255,255,255,63,0,0,0,0,128,252,255,255,255,127,0,0,0,0,128,255,255,255,255,127,133,0,0,0,0,192,255,255,255,255,255,0,0,0,128,120,0,252,255,255,255,255,3,0,0,0,208,23,0,190,255,255,255,255,63,0,1,0,0,0,128,128,255,255,223,255,255,207,189,65,0,0,0,1,0,255,247,198,255,255,255,254,249,7,224,3,0,0,0,250,3,138,255,243,255,255,128,31,248,63,0,0,3,192,129,15,248,7,255,15,242,255,195,255,224,0,0,192,63,0,128,129,248,159,63,248,11,255,31,0,160,79,255,196,0,36,128,127,0,0,252,255,255,127,224,3,248,15,0,32,254,95,2,0,60,128,255,171,0,192,255,249,236,255,3,240,15,72,128,255,23,0,64,127,132,255,192,0,224,255,95,39,253,2,232,31,95,128,124,23,5,128,127,0,255,225,3,112,223,127,153,252,7,240,255,62,0,127,192,6,216,255,0,255,225,7,248,131,127,0,237,7,224,31,254,128,59,240,224,224,240,3,248,128,1,248,255,255,56,0,63,0,184,255,227,31,18,62,24,124,1,224,15,0,252,159,255,0,0,10,224,31,63,192,7,224,15,224,247,255,255,255,195,254,0,60,0,40,0,0,255,255,255,31,248,127,245,255,3,0,0,0,0,0,254,255,255,255,255,239,27,96,0,144,3,252,255,255,1,0,192,255,161,255,128,0,0,0,0,254,255,255,255,255,63,0,40,0,0,0,254,253,191,59,0,0,254,255,255,255,5,0,0,166,210,255,255,254,255,127,0,0,0,0,0,0,216,252,159,132,113,24,255,253,248,1,0,248,31,252,135,253,31,248,248,14,144,231,15,0,0,254,139,9,0,0,252,255,255,31,32,0,0,0,0,224,255,255,253,216,255,223,0,0,0,224,31,249,7,128,63,0,240,191,231,255,127,0,0,254,127,0,0,0,240,255,255,63,0,192,127,224,127,192,255,255,0,2,252,255,0,0,0,192,255,255,255,55,255,255,253,63,192,255,255,1,0,0,0,0,0,0,128,255,255,255,63,255,255,255,255,201,255,255,5,0,0,0,0,0,0,0,240,255,255,255,254,255,255,63,254,163,5,61,4,71,78,96,82,0,0,186,255,63,62,0,128,255,255,255,255,1,0,0,192,255,255,255,229,0,0,0,64,255,255,255,255,15,0,0,0,0,252,255,255,255,255,7,0,0,0,0,128,255,255,255,255,255,15,0,0,0,0,128,255,255,255,255,127,1,0,0,0,224,255,255,231,255,255,255,255,1,0,0,0,0,128,239,255,255,255,127,192,46,0,0,192,6,0,254,255,255,255,255,127,144,1,0,0,0,0,224,223,255,255,255,255,255,255,255,3,136,96,0,0,3,0,128,28,0,208,255,255,231,255,3,172,205,3,0,0,255,111,224,53,255,255,255,63,192,255,3,0,128,1,0,253,15,34,255,255,221,248,251,255,63,255,0,164,88,23,1,40,2,0,192,253,0,200,255,255,40,254,247,245,252,11,130,127,48,64,162,249,146,13,242,97,0,252,223,1,244,255,27,246,95,32,217,247,129,128,95,240,225,250,68,31,100,186,8,0,100,255,0,158,236,19,124,139,0,248,252,3,239,9,60,224,255,127,0,12,254,67,3,192,3,232,245,7,240,239,42,96,223,125,192,159,31,0,126,252,129,36,144,79,240,225,225,224,215,47,192,129,251,131,125,6,7,2,240,1,62,63,62,62,192,31,240,0,16,8,255,255,0,225,254,11,252,255,0,0,64,8,32,195,255,255,255,255,193,31,0,0,224,255,5,0,248,127,255,255,127,64,128,7,0,4,252,193,255,234,15,192,249,2,64,242,127,0,142,255,138,252,255,1,40,32,0,64,241,11,248,251,7,152,254,15,32,154,255,3,0,255,3,137,253,3,0,32,0,0,252,7,0,255,63,224,247,127,0,201,255,225,47,160,131,95,64,255,0,128,30,0,0,127,128,233,191,7,224,255,7,254,1,135,255,227,1,126,0,198,224,3,124,240,0,240,127,0,240,17,120,248,191,126,0,255,255,255,127,0,23,0,128,15,128,255,127,240,255,191,0,0,124,0,252,247,0,248,255,255,255,255,127,1,0,28,128,15,250,15,0,252,3,0,240,3,248,255,127,0,232,255,255,255,63,128,7,0,0,0,248,223,6,241,63,248,0,252,7,248,127,1,224,255,192,255,255,7,0,128,0,0,68,15,254,11,254,127,128,108,223,108,250,67,23,224,159,64,255,15,0,108,0,160,23,124,1,244,127,1,232,255,19,18,0,255,255,191,16,128,96,254,255,7,1,0,224,255,139,0,0,232,255,255,255,79,0,0,0,176,255,255,255,255,7,0,0,0,0,80,251,255,255,127,15,0,0,0,0,203,255,255,255,255,15,0,0,0,0,128,127,253,255,255,151,125,0,0,0,0,0,240,223,255,255,127,255,3,0,46,0,4,248,2,254,255,255,239,255,1,16,0,0,0,1,224,31,244,255,255,127,255,31,248,0,0,0,80,0,76,226,63,248,127,241,255,242,7,252,1,0,0,45,0,254,7,254,255,127,208,127,252,17,222,31,208,0,224,3,252,192,255,15,251,0,247,191,127,252,255,62,0,192,1,0,239,255,15,255,1,231,255,2,192,255,3,0,192,7,248,31,253,255,75,0,252,3,4,192,127,251,127,0,36,255,31,248,15,0,0,2,0,0,0,254,255,63,192,63,252,255,255,151,248,3,0,0,0,128,255,255,7,144,63,240,127,240,47,255,0,88,32,0,0,252,3,126,192,175,250,47,252,127,251,15,0,0,248,0,248,255,255,0,255,7,255,255,31,50,15,16,0,224,1,228,131,254,250,47,132,191,48,207,240,3,224,15,48,224,134,255,239,1,248,225,15,0,242,255,7,224,255,63,7,0,224,207,255,249,63,248,0,2,0,192,243,15,240,255,63,31,0,224,255,255,255,60,248,0,0,0,252,207,127,254,191,63,126,0,130,224,247,129,1,248,0,1,0,249,159,255,255,255,255,59,0,132,53,160,65,3,64,144,13,0,248,255,255,255,255,255,219,0,30,60,8,130,27,0,2,13,0,224,191,255,255,223,255,255,0,16,255,2,30,4,0,64,2,0,240,127,248,255,223,255,255,9,0,252,7,31,12,16,12,8,0,253,219,190,255,255,129,255,22,12,248,6,210,1,0,120,12,0,224,255,239,215,231,255,247,1,156,31,12,237,47,64,6,124,0,224,252,223,131,135,231,95,130,48,188,15,31,194,240,252,161,32,225,73,220,223,15,0,111,191,64,240,125,12,8,218,243,165,1,65,219,182,60,44,120,14,144,255,165,129,240,95,0,232,223,15,128,254,111,112,224,253,4,56,30,195,247,129,47,0,125,218,190,58,4,105,223,159,160,127,249,3,240,127,4,5,222,118,208,254,11,244,1,188,239,55,16,98,15,36,252,1,11,42,252,201,156,200,241,15,0,178,255,47,0,7,0,121,255,255,55,1,0,0,128,254,255,255,127,0,0,0,0,250,255,255,255,63,0,0,0,0,128,255,255,255,255,63,0,0,0,0,224,255,255,255,255,255,15,0,0,0,0,252,255,255,255,255,255,0,0,0,0,0,31,255,255,255,255,127,195,3,0,0,0,0,240,255,255,255,255,255,31,0,0,0,0,0,0,32,248,255,255,255,255,15,125,0,0,0,0,0,168,87,224,255,251,255,255,255,251,1,0,0,2,0,4,32,1,254,255,255,255,255,255,15,64,1,62,0,32,8,0,240,255,103,224,255,225,255,241,7,252,15,8,128,4,192,123,208,31,244,15,255,207,159,251,63,64,0,254,0,248,7,0,129,47,253,31,94,0,254,5,31,242,7,192,247,225,1,63,128,63,0,63,248,31,144,244,127,105,219,218,7,228,195,95,2,6,0,63,252,3,254,0,240,241,255,208,7,240,207,215,128,254,1,8,248,31,208,39,96,64,223,246,15,4,3,254,151,62,236,111,0,126,252,7,127,128,243,193,63,224,15,0,252,191,3,252,192,39,248,105,222,54,230,24,126,126,162,28,0,126,240,255,193,15,24,204,81,31,255,103,8,254,127,0,0,0,126,248,255,255,191,1,248,3,2,252,65,0,255,255,1,12,0,254,240,127,224,15,0,64,0,2,254,163,15,255,255,211,0,0,60,53,255,0,248,0,224,1,62,255,63,223,255,255,3,126,0,63,192,111,0,31,0,128,5,252,255,255,31,252,255,123,67,128,60,32,246,2,252,1,80,1,254,3,255,255,252,255,97,223,128,63,192,63,0,240,13,0,40,244,15,248,15,240,255,249,15,158,52,0,255,1,240,3,248,3,142,63,248,7,132,115,3,62,227,126,0,30,34,0,15,255,19,132,127,248,11,0,128,31,255,255,255,7,14,3,0,0,252,1,250,255,255,63,0,128,15,255,224,255,0,6,0,0,2,127,1,248,255,255,63,0,9,202,223,178,183,0,72,3,128,6,255,1,255,255,255,63,0,200,2,20,0,63,0,156,0,0,105,255,255,255,255,253,63,0,3,6,0,0,96,0,192,3,176,67,255,129,255,255,255,255,1,224,195,31,128,63,0,94,0,4,244,239,27,248,127,240,63,248,3,254,79,16,254,1,248,127,0,196,255,27,2,16,247,255,15,0,192,88,230,255,9,0,224,239,255,243,2,0,8,225,255,255,255,17,0,0,128,95,255,255,191,0,0,0,0,4,148,255,255,255,255,127,0,0,0,0,248,255,255,255,255,127,5,0,0,0,0,252,255,255,255,31,0,0,0,0,112,191,251,255,255,255,255,239,4,0,0,0,0,128,238,255,253,255,255,191,126,0,0,0,0,0,72,64,240,255,255,255,255,255,255,7,0,0,0,64,3,246,154,255,23,248,127,235,255,31,0,65,74,72,80,0,252,237,255,219,255,207,240,17,90,8,0,3,212,120,224,249,140,137,11,255,29,243,255,255,1,0,4,64,255,254,255,145,90,0,254,1,128,255,255,55,0,0,248,127,255,255,225,1,0,120,0,72,227,255,67,31,248,249,255,255,127,75,11,0,64,0,0,248,255,255,35,240,255,255,255,47,227,31,0,0,4,0,224,255,239,127,0,202,255,255,255,127,0,64,0,64,10,64,251,67,2,208,94,218,254,215,159,22,80,2,0,64,0,228,255,255,0,54,128,255,255,13,253,7,0,127,1,160,255,159,125,0,66,253,255,172,111,53,192,19,4,32,0,173,245,255,15,0,224,191,255,45,165,4,45,0,96,169,47,255,191,164,194,44,245,255,237,61,127,1,192,64,3,176,255,244,5,176,0,244,183,165,247,53,196,4,21,178,238,151,182,189,0,122,151,176,235,149,240,105,199,74,182,22,232,255,7,188,7,64,206,17,112,191,28,1,224,159,224,236,178,59,45,0,189,53,200,121,219,246,98,111,0,219,147,192,255,1,252,219,0,218,118,113,37,152,194,254,95,0,222,6,176,47,1,180,151,32,61,105,15,228,17,203,210,191,196,223,22,144,103,176,248,247,9,16,250,162,189,127,3,242,16,5,248,252,63,96,254,207,47,0,0,252,192,255,255,255,253,0,0,16,248,1,84,250,255,255,9,0,240,244,191,54,119,1,128,0,176,252,45,200,255,255,223,34,1,240,193,223,128,4,128,104,0,144,254,13,252,255,255,255,6,0,121,194,214,55,1,0,64,38,128,254,255,255,255,255,255,0,0,184,1,16,36,1,0,0,0,28,248,254,255,255,255,111,63,0,128,180,15,8,1,16,128,33,161,126,55,165,253,111,166,173,4,128,37,194,141,15,192,23,11,24,221,63,153,216,191,7,2,48,255,7,64,11,0,192,255,255,255,0,0,0,192,255,255,255,127,0,0,0,0,254,255,255,255,255,0,0,0,0,160,255,255,255,255,255,0,0,0,0,0,224,255,255,255,223,63,0,0,0,0,104,95,255,255,135,192,175,0,0,128,0,128,255,255,255,127,254,255,27,0,0,0,0,239,255,255,223,230,36,220,0,0,96,184,212,43,5,208,255,247,127,235,223,63,0,0,0,0,128,109,249,255,23,63,255,255,255,255,185,255,12,0,0,0,0,0,32,255,255,255,255,223,255,12,0,64,16,0,0,0,240,255,255,255,255,255,255,239,0,6,0,0,64,166,0,131,31,128,239,255,255,255,206,255,18,192,193,95,96,91,255,15,0,129,120,3,0,224,255,204,246,255,1,191,245,111,189,31,248,7,57,96,255,0,204,255,47,244,0,141,193,5,192,63,136,0,254,19,120,107,47,248,235,252,7,42,128,255,7,4,248,47,102,8,252,0,38,96,200,225,6,245,145,129,241,127,160,157,255,3,244,35,189,254,0,224,127,29,192,255,0,224,228,2,122,222,110,166,7,249,95,34,164,253,24,56,240,31,224,97,38,31,255,72,63,128,23,76,15,240,218,255,5,239,7,130,75,64,2,185,95,245,255,0,41,192,163,188,23,233,5,12,208,31,248,255,251,31,252,0,0,3,0,128,0,254,255,255,127,126,144,255,255,225,63,0,0,0,6,192,15,254,255,243,207,63,240,3,248,0,224,31,254,127,0,192,192,255,16,252,1,0,0,63,15,248,255,255,127,155,15,252,32,128,31,0,248,15,248,1,72,1,252,15,248,255,1,4,102,242,131,255,248,255,7,254,0,0,1,240,0,4,62,200,252,0,191,193,199,195,159,73,64,198,151,27,236,239,1,252,240,0,120,185,192,63,16,248,3,32,64,63,0,252,255,252,47,0,15,184,93,234,63,0,128,15,180,128,254,127,254,3,253,14,0,0,240,1,0,255,255,255,7,183,240,127,118,254,15,0,126,0,0,248,255,255,31,224,255,3,0,128,31,0,252,223,255,7,0,25,252,103,247,159,0,64,38,31,128,255,63,251,223,233,183,16,0,252,31,128,255,7,54,240,5,220,127,228,255,15,0,119,33,0,248,127,254,7,255,252,0,0,56,225,23,8,255,23,0,255,191,5,128,254,255,191,0,0,32,220,255,191,2,128,144,255,127,3,0,0,234,255,255,223,0,0,0,128,255,255,255,255,79,0,0,0,8,184,255,255,255,255,191,0,0,0,0,224,255,255,255,255,93,111,0,0,0,0,128,255,255,255,63,55,0,0,0,112,0,2,254,247,255,255,255,9,3,0,0,0,42,242,205,239,255,255,63,8,240,0,0,0,0,4,0,240,255,255,250,255,23,250,1,1,8,0,0,124,0,240,255,255,255,255,255,238,1,0,64,0,128,29,192,0,255,255,251,127,187,121,7,15,240,3,0,124,0,128,255,255,3,126,60,248,127,6,255,127,7,0,48,0,254,234,159,247,255,128,248,63,0,254,127,150,0,96,224,255,59,254,95,0,0,240,1,0,248,255,255,15,240,131,255,255,127,0,58,0,0,32,0,248,255,255,239,191,255,255,255,127,61,193,6,0,0,0,0,254,223,63,128,127,255,255,255,127,255,0,16,4,0,0,223,254,7,0,73,255,247,255,253,47,0,1,252,0,0,253,223,232,5,240,3,255,255,255,0,3,128,15,32,0,254,128,252,1,63,224,95,251,143,113,60,30,224,27,0,56,224,255,59,128,127,248,3,240,255,255,1,248,241,79,0,0,248,225,255,239,15,16,60,1,1,248,1,238,248,255,192,7,0,48,252,63,231,159,12,0,2,248,124,228,195,255,255,255,3,0,224,2,223,65,56,0,46,0,0,252,231,251,255,255,39,3,0,188,128,219,93,8,0,0,0,220,255,39,241,255,255,239,37,0,136,227,255,0,0,32,80,80,129,250,123,255,255,255,111,26,0,128,228,122,15,211,1,176,6,223,193,250,236,255,251,127,9,0,240,63,252,135,95,32,24,8,137,255,127,34,223,239,92,22,132,3,40,92,15,129,31,74,0,224,251,190,143,254,193,39,18,97,249,108,30,160,251,8,64,135,71,242,13,183,203,38,252,15,160,51,124,31,197,3,40,220,71,1,191,142,230,208,189,139,128,113,49,72,246,112,56,12,151,52,178,207,195,231,78,182,193,161,76,34,245,121,232,254,96,119,12,15,6,244,247,135,111,67,125,128,224,251,69,252,252,176,41,4,127,15,152,11,252,3,7,219,14,248,113,241,63,120,126,248,192,95,129,63,40,134,119,129,15,7,121,2,127,168,227,33,124,246,66,143,219,0,31,252,191,7,0,0,64,252,255,255,15,0,0,240,255,255,255,111,0,7,0,0,242,255,255,255,63,0,0,0,0,240,255,255,255,255,15,0,0,0,0,0,255,255,255,255,255,15,0,0,0,224,211,255,255,255,255,255,111,0,0,0,0,0,255,255,255,255,191,0,0,1,0,0,0,192,255,255,255,255,255,31,0,0,0,0,80,0,0,248,255,47,251,55,31,166,235,0,0,0,0,224,247,255,255,255,255,255,235,63,0,0,0,0,0,0,254,39,254,255,255,255,255,255,255,1,16,0,4,0,0,0,0,240,255,255,255,255,191,255,163,223,61,40,0,240,0,30,64,19,128,6,255,255,248,15,255,5,253,128,15,244,31,0,127,129,15,240,7,224,161,255,31,248,23,252,1,254,192,31,228,31,0,127,128,31,240,31,240,128,255,17,252,65,254,1,254,192,15,232,31,192,159,244,31,232,155,252,128,127,65,244,160,254,1,63,224,31,248,7,248,31,252,31,248,3,254,0,255,128,111,192,127,2,62,224,23,248,15,250,2,120,31,224,3,254,0,255,224,31,36,255,33,158,224,63,24,31,252,130,99,80,192,15,254,131,124,128,51,112,223,255,231,255,55,240,127,240,1,0,224,224,255,255,15,126,0,0,0,1,252,135,255,127,200,255,255,3,0,0,128,111,255,7,248,0,2,224,31,255,135,255,23,221,127,127,0,0,0,1,254,255,255,193,226,15,192,127,255,15,255,7,0,0,95,0,0,0,3,252,255,255,135,241,63,192,247,255,31,255,0,9,0,13,0,0,0,12,250,255,255,71,255,239,255,253,255,39,255,0,11,0,1,0,0,0,3,252,223,255,255,191,251,127,253,127,232,159,1,30,224,1,14,0,224,3,252,255,255,179,31,240,95,240,255,162,111,210,79,242,0,58,0,208,5,248,239,255,240,31,252,55,240,255,131,127,120,131,191,0,126,0,162,0,252,93,187,240,31,240,135,226,159,0,127,96,1,127,0,126,96,131,0,252,119,11,240,15,240,139,126,85,160,254,0,128,255,0,124,160,31,0,240,127,0,236,31,240,19,244,233,0,252,23,64,255,3,15,234,31,20,192,255,2,240,63,224,3,126,219,5,248,7,25,254,3,124,192,191,73,128,255,160,192,255,225,31,128,255,11,64,253,31,144,0,236,239,255,0,0,48,246,251,127,0,0,248,255,127,1,0,0,251,255,255,255,15,0,0,128,242,255,255,255,23,0,0,0,0,8,243,255,255,255,15,1,0,0,128,0,255,255,255,255,30,1,0,0,0,0,196,255,255,255,255,118,0,0,0,0,0,32,250,255,255,255,245,15,0,0,0,64,9,12,248,255,255,255,255,19,1,0,0,0,0,128,31,254,255,255,255,255,127,254,1,0,0,0,32,0,244,193,255,255,243,255,255,255,29,0,0,0,224,2,144,0,254,255,223,255,251,247,31,0,96,0,0,2,0,16,64,255,31,255,31,248,255,167,239,2,192,31,0,160,1,144,12,128,255,183,255,39,240,127,192,183,1,104,7,192,255,0,252,15,249,127,217,255,3,248,95,128,159,0,255,7,224,3,0,255,1,248,143,245,231,128,254,71,252,63,0,127,18,253,3,0,3,0,255,7,224,6,1,191,201,254,3,192,61,0,254,19,125,3,32,31,32,255,7,224,7,12,190,64,255,7,130,63,0,254,193,143,0,128,63,192,253,15,240,67,254,13,22,252,19,128,255,0,127,224,15,50,215,113,120,224,47,192,1,113,63,254,63,0,224,255,192,124,242,15,255,197,96,248,239,0,0,224,239,127,254,255,3,0,0,0,16,232,255,255,254,255,254,255,1,0,0,0,127,240,255,1,1,0,128,255,255,255,255,253,7,240,63,0,0,0,0,31,224,255,207,255,231,203,255,239,255,255,163,6,192,63,0,0,0,128,127,248,255,255,255,243,255,255,15,255,143,55,0,0,60,0,0,0,128,127,240,255,255,247,255,255,255,31,252,7,120,128,0,248,0,0,0,128,255,128,223,255,163,191,232,255,38,249,127,56,252,1,240,3,64,144,15,252,7,35,188,224,241,250,255,143,255,71,48,252,15,0,6,192,225,127,254,15,130,41,0,192,1,252,15,255,255,119,253,127,0,0,0,0,63,244,31,0,79,0,192,143,255,255,255,255,0,252,191,1,0,0,0,254,254,255,198,63,0,194,255,255,15,255,127,2,248,3,0,0,0,0,248,255,255,203,255,0,250,255,255,15,254,255,1,224,3,0,0,0,0,252,247,255,223,255,194,255,255,255,255,244,127,2,192,3,0,0,0,0,63,248,255,255,255,3,255,255,127,248,195,46,92,8,7,46,180,233,1,4,248,255,127,124,0,0,228,255,255,131,0,0,0,128,255,255,255,71,0,0,0,224,255,255,255,255,31,0,0,0,0,252,255,255,255,255,63,0,0,0,0,254,254,255,255,255,255,15,0,0,0,0,242,255,255,255,255,7,0,0,0,0,0,255,255,255,255,255,255,255,7,0,0,0,0,128,255,255,255,255,255,3,0,0,0,0,0,0,224,255,255,255,255,255,31,0,0,0,0,0,0,240,255,255,255,255,255,255,255,63,0,0,4,0,0,0,0,240,19,0,248,255,255,255,255,40,0,30,1,0,0,223,207,63,16,247,255,255,5,192,65,0,0,0,0,32,255,15,64,252,255,255,255,253,217,255,39,0,136,229,1,16,6,0,0,254,15,0,248,255,255,239,247,33,252,255,1,0,62,0,122,24,30,0,255,7,0,192,199,243,139,255,3,248,255,15,0,252,240,54,240,63,0,254,255,7,0,31,126,2,124,0,232,255,255,0,255,195,15,240,63,0,224,252,31,0,48,252,1,252,0,56,208,127,0,67,143,63,224,255,0,2,254,127,0,128,255,7,224,2,124,192,255,112,6,60,15,198,255,32,1,184,31,63,192,63,252,8,0,64,0,255,225,127,232,143,224,59,0,0,240,255,60,0,254,255,255,255,0,0,0,128,31,240,255,255,255,255,11,248,1,0,0,254,63,0,192,251,255,255,255,3,0,0,0,192,29,0,254,255,255,1,62,0,32,252,255,1,24,248,255,253,255,63,192,3,0,0,97,246,129,255,243,223,248,7,0,120,254,63,128,0,252,254,127,96,1,6,0,0,0,128,1,248,15,252,248,255,63,0,254,255,129,31,0,14,254,255,7,0,0,0,224,71,192,19,255,127,24,252,252,3,127,0,252,241,31,192,129,0,28,192,15,0,6,112,254,7,248,192,143,255,255,63,0,188,255,255,255,15,0,0,0,0,128,255,227,127,252,255,240,15,0,64,248,127,0,0,255,255,255,255,3,30,14,0,0,192,31,254,3,60,16,192,7,0,0,255,255,7,224,255,255,255,255,0,128,1,0,0,28,128,135,31,255,7,254,128,15,254,255,127,224,243,255,241,255,63,0,0,0,0,0,12,6,255,255,223,243,223,240,241,255,255,1,28,252,113,255,255,7,64,0,0,192,195,23,64,255,23,0,254,63,35,0,251,255,255,1,0,0,233,254,255,7,0,128,255,127,0,0,145,253,255,255,255,15,0,0,0,248,255,255,255,11,0,0,0,0,192,253,255,255,255,191,8,0,0,0,128,255,255,255,255,206,8,0,0,0,0,0,254,255,255,255,255,2,0,0,0,0,98,192,255,255,255,255,139,10,0,0,0,0,0,240,249,127,255,127,119,1,0,0,0,0,0,0,254,255,255,255,255,127,119,66,1,0,0,0,0,120,216,127,255,255,255,255,7,248,0,0,0,0,24,0,0,254,225,255,248,143,63,113,132,3,129,7,0,24,96,226,31,248,103,64,248,253,255,1,254,255,6,0,0,128,63,240,255,207,255,15,224,63,0,248,255,63,0,192,227,31,247,255,189,15,128,241,3,0,248,252,255,7,128,6,254,255,255,255,7,0,0,56,0,128,255,255,255,103,254,255,255,255,31,48,1,0,0,0,128,255,175,123,0,255,251,255,255,9,127,68,0,15,128,1,128,254,7,72,255,15,255,193,255,224,3,57,0,30,96,192,31,224,15,126,248,15,248,255,31,252,1,126,192,1,254,0,249,254,16,62,224,239,61,195,31,128,159,255,192,7,252,247,3,224,3,120,232,1,255,0,135,255,11,14,0,192,63,239,159,255,35,7,192,1,192,255,4,224,255,255,252,2,224,1,255,63,0,0,128,1,64,199,63,32,244,255,255,7,120,224,7,252,27,60,31,0,2,128,199,255,193,255,255,255,63,0,0,0,240,9,8,0,0,248,0,198,255,255,255,255,255,23,0,0,192,0,28,192,15,0,0,128,135,255,199,255,255,255,243,7,96,192,255,49,0,0,0,126,0,143,63,255,247,255,254,3,63,1,112,129,55,252,1,0,28,240,79,255,224,135,255,255,241,0,3,240,7,35,48,128,24,255,0,14,124,255,224,63,254,131,31,72,240,131,119,220,18,48,0,248,131,7,240,224,127,248,227,15,28,240,255,195,0,224,47,252,128,159,255,195,4,123,112,113,7,214,90,94,148,131,29,28,143,248,5,25,65,255,255,127,117,68,17,64,68,5,16,85,85,85,85,85,85,85,85,85,1