sound: db 88,2,254,0,127,128,127,192,63,192,31,224,15,240,15,248,7,252,3,254,1,254,0,127,128,63,192,31,224,31,240,15,248,7,252,3,254,1,255,128,127,128,63,192,31,224,15,240,7,248,7,252,3,254,1,255,0,127,128,63,192,63,224,31,240,15,240,7,248,7,252,3,252,1,254,1,255,0,255,128,127,128,127,192,63,192,63,192,31,224,31,224,31,240,15,240,15,240,15,240,7,248,7,248,7,248,7,248,7,248,7,252,3,252,3,252,3,252,3,252,3,252,3,252,3,252,1,254,1,254,1,254,1,254,1,254,0,255,0,255,0,255,128,127,128,127,128,63,192,63,192,31,224,31,240,15,240,15,248,7,252,3,252,1,254,0,127,128,127,192,63,224,15,240,7,248,3,252,1,255,128,127,192,31,224,15,248,7,252,1,255,128,63,224,31,240,7,252,3,254,128,63,192,31,240,7,252,1,254,128,63,224,15,240,7,252,1,255,128,63,224,15,240,7,252,1,255,128,63,224,31,240,7,252,3,254,0,127,192,63,224,15,240,7,248,3,252,1,254,0,127,128,63,192,31,224,31,240,15,240,7,248,7,248,7,252,3,252,3,252,3,252,3,252,3,252,3,252,3,252,3,252,7,248,7,248,7,240,15,240,31,224,31,192,63,192,127,128,255,0,255,0,254,1,252,3,248,7,240,15,224,31,224,63,192,127,128,255,0,255,0,254,1,252,3,252,7,248,7,248,15,240,15,240,31,224,31,224,31,224,31,224,31,224,31,224,31,224,15,240,15,240,7,248,7,248,3,252,1,254,0,127,128,63,192,31,240,15,248,3,252,1,127,192,63,224,15,248,3,254,128,63,224,15,248,3,254,128,63,224,15,252,1,127,192,31,240,3,254,128,63,240,7,252,1,63,224,15,248,1,127,192,31,248,3,254,128,31,240,7,252,1,127,224,15,248,3,254,128,63,224,15,248,3,254,128,63,192,31,240,7,252,3,254,0,127,192,63,224,31,240,15,248,7,252,3,252,3,254,1,254,1,254,1,254,1,254,1,254,1,254,3,252,3,248,7,248,15,240,31,192,63,128,127,0,255,1,252,7,248,15,224,63,128,255,0,254,3,248,15,224,63,128,255,0,254,7,240,31,192,127,0,255,1,252,7,240,31,192,127,0,255,1,252,3,248,15,224,31,192,127,128,255,0,255,1,254,1,252,3,252,3,248,7,248,7,248,7,248,7,252,3,252,3,254,1,255,128,127,192,63,224,15,240,7,252,1,255,128,63,224,15,248,3,126,192,31,240,7,252,128,63,240,7,252,128,63,240,7,254,128,31,240,3,126,192,15,252,129,63,240,7