sound: db 170,31,248,3,240,255,15,0,240,127,253,255,1,0,128,255,191,242,255,255,255,23,0,0,0,0,0,0,255,255,255,255,255,11,0,0,0,0,240,255,255,255,255,255,255,31,0,0,0,0,0,0,0,0,254,255,255,255,255,255,255,255,0,0,0,0,0,0,0,0,224,255,255,255,255,255,255,255,255,255,7,0,0,0,0,0,0,0,0,0,192,255,255,255,255,255,255,255,255,255,255,15,0,0,0,0,0,0,0,0,0,0,255,255,255,255,255,255,255,255,255,255,255,255,0,0,0,0,0,0,0,0,0,0,0,255,255,255,255,255,255,255,255,255,255,255,255,255,255,0,0,0,0,0,0,0,0,0,0,224,255,255,255,255,255,255,255,255,255,255,255,255,7,0,0,0,0,0,0,0,0,248,255,255,255,255,255,255,15,0,0,0,0,0,0,0,0,0,0,192,255,255,255,255,255,255,255,7,0,0,0,0,0,0,0,255,255,255,255,255,3,0,0,0,0,0,0,0,0,254,255,255,255,255,1,0,240,255,255,255,255,255,31,0,0,0,0,0,0,128,255,255,255,255,255,255,91,5,16,0,0,0,0,0,170,210,181,253,255,255,255,255,255,255,255,255,255,127,87,37,0,0,0,0,0,208,255,255,255,255,239,87,0,0,0,0,0,0,128,208,245,255,255,255,255,255,255,255,255,255,79,135,20,164,0,0,0,0,0,0,0,0,130,144,99,124,253,215,255,173,254,234,235,255,95,255,247,171,170,114,69,165,210,2,0,20,2,161,69,41,85,85,85,101,169,106,253,174,90,84,169,170,214,74,181,90,105,117,149,109,145,85,173,165,170,165,214,82,41,117,171,213,166,170,164,26,170,210,170,214,86,43,69,125,165,148,90,173,214,74,181,202,170,150,90,169,144,214,182,154,148,64,175,42,170,174,106,170,164,90,171,172,106,170,132,170,218,106,100,175,82,75,42,173,106,170,170,84,170,174,52,170,202,138,170,186,42,41,170,102,169,170,170,234,170,170,170,170,170,154,170,218,170,170,170,202,170,170,170,170,42,171,170,170,170,170,170,170,170,170,170,170,170,170,170,170,170,170,170,170,170,170,170,170,170,170,170,170,170,170,170,242,140,50,254,1,64,255,247,31,128,255,0,192,255,255,1,0,64,255,255,215,255,15,0,1,120,98,255,255,223,17,0,160,222,255,235,148,64,1,0,180,250,191,95,5,64,160,148,250,95,139,20,1,64,138,246,254,247,138,20,162,80,84,117,237,107,85,133,72,37,146,214,111,73,90,53,171,105,168,181,109,165,90,181,108,73,146,208,172,125,113,127,85,9,165,212,172,106,235,85,10,10,179,128,172,117,151,165,86,161,196,82,149,106,175,166,110,85,149,82,69,245,234,55,147,74,73,171,91,69,129,168,118,1,74,253,181,86,69,151,74,161,164,190,174,130,136,84,41,149,229,174,165,170,186,167,20,85,85,119,85,214,154,170,146,168,126,187,86,77,85,80,218,170,254,182,66,82,82,101,45,173,186,45,128,32,223,23,165,255,94,42,168,74,91,173,149,86,85,42,169,42,169,218,247,93,41,1,138,74,89,173,122,87,85,72,213,183,84,82,43,147,36,85,239,74,202,237,175,138,80,85,191,170,90,93,85,0,200,253,251,118,138,42,33,228,174,173,90,170,176,208,90,43,77,91,239,214,186,44,181,84,213,170,82,21,149,64,85,43,146,172,98,41,85,86,85,86,47,213,137,90,40,10,149,95,75,202,82,73,85,223,81,165,150,73,106,172,210,149,84,52,181,22,85,84,214,110,77,77,133,84,229,206,233,90,78,53,77,50,179,202,146,35,32,85,83,65,149,82,74,171,170,86,141,86,139,168,50,69,181,82,42,185,86,18,165,69,173,85,85,85,117,221,41,85,167,90,85,189,168,214,106,149,90,45,117,85,101,213,85,173,165,130,133,213,82,107,117,170,149,166,170,164,26,170,214,174,212,86,42,69,45,168,180,82,171,148,90,165,202,170,149,86,171,181,150,166,22,149,66,234,90,170,175,74,42,165,82,171,173,74,42,148,170,82,104,101,175,82,91,103,173,106,170,170,84,170,164,84,171,74,200,170,154,82,45,175,84,173,170,154,82,139,182,74,169,170,218,170,74,89,165,170,74,169,74,187,86,106,61,149,106,173,186,42,45,171,170,174,170,170,42,170,170,170,170,170,170,170,170,170,170,170,170,170,170,170,42,169,63,248,3,240,255,15,0,240,255,255,255,1,0,32,255,191,244,255,255,255,23,0,0,0,0,0,0,254,255,255,255,255,3,0,0,0,0,240,255,255,255,255,255,255,31,0,0,0,0,0,0,0,0,254,255,255,255,255,255,255,255,0,0,0,0,0,0,0,0,224,255,255,255,255,255,255,255,255,255,7,0,0,0,0,0,0,0,0,0,192,255,255,255,255,255,255,255,255,255,255,7,0,0,0,0,0,0,0,0,0,0,255,255,255,255,255,255,255,255,255,255,255,255,0,0,0,0,0,0,0,0,0,0,0,254,255,255,255,255,255,255,255,255,255,255,255,255,255,0,0,0,0,0,0,0,0,0,0,224,255,255,255,255,255,255,255,255,255,255,255,255,7,0,0,0,0,0,0,0,0,240,255,255,255,255,255,255,15,0,0,0,0,0,0,0,0,0,0,192,255,255,255,255,255,255,255,7,0,0,0,0,0,0,128,255,255,255,255,255,3,0,0,0,0,0,0,0,0,255,255,255,255,255,1,0,248,255,255,255,255,255,31,0,0,0,0,0,0,128,255,255,255,255,255,255,91,5,16,0,0,0,0,128,130,213,181,253,255,255,255,255,255,255,255,255,255,255,87,10,0,0,0,0,0,128,255,255,255,255,123,87,0,0,0,0,0,0,0,80,245,253,255,255,255,255,255,255,255,255,95,135,20,132,4,0,0,0,0,0,0,0,128,144,161,254,213,119,127,213,126,239,239,255,127,253,119,255,173,58,68,21,82,2,129,82,2,149,68,165,68,213,85,53,85,45,85,215,75,85,149,189,82,43,149,90,45,117,85,117,213,85,165,165,130,133,214,82,43,117,170,181,174,170,164,186,170,150,170,148,214,42,205,169,170,165,82,170,181,210,171,154,42,181,86,170,165,150,170,54,165,10,234,86,234,175,94,106,173,86,170,169,72,66,165,170,210,72,101,171,86,91,110,173,106,170,154,85,170,164,84,171,75,77,170,154,90,45,167,86,165,170,154,90,137,210,74,173,170,74,170,74,105,149,170,74,165,106,170,66,171,45,211,170,140,170,170,45,171,170,170,170,170,170,170,170,170,170,170,170,170,170,170,170,170,170,170,170,170,170,170,242,140,50,255,1,64,255,245,31,128,255,0,192,255,255,1,0,80,247,254,223,255,31,0,1,248,102,255,255,223,1,0,0,253,255,223,5,80,0,0,236,255,255,85,4,0,168,181,246,223,155,20,0,64,186,246,254,167,154,20,162,80,84,125,237,107,85,133,74,37,154,86,127,73,90,21,169,40,168,150,36,245,106,149,44,13,210,72,180,188,121,191,66,33,148,94,213,42,175,94,25,41,18,144,174,119,214,215,90,149,64,90,85,105,175,162,42,21,85,74,37,213,171,50,147,74,73,171,91,77,169,168,118,9,74,237,189,84,237,170,74,160,168,171,172,4,145,85,43,181,169,42,173,146,117,69,69,85,149,238,181,170,170,170,148,218,84,247,85,73,165,170,186,170,253,182,68,82,86,169,42,173,178,45,0,36,223,23,165,251,94,42,168,74,91,165,212,82,85,41,165,170,169,202,182,109,37,17,136,171,105,181,170,10,68,109,211,151,68,91,173,10,164,80,117,107,233,180,183,136,170,93,85,165,106,109,81,81,160,221,127,82,137,170,49,212,174,149,82,171,176,210,218,41,77,91,239,214,186,44,181,84,181,74,85,37,133,64,173,106,178,44,69,73,213,86,191,86,106,181,170,214,104,90,189,149,202,218,84,90,85,154,243,170,148,217,74,173,213,165,213,108,169,22,156,148,198,106,77,77,142,84,167,174,234,90,110,39,77,58,179,202,146,163,170,85,83,97,212,82,110,169,170,106,133,82,197,237,170,164,213,90,43,137,90,170,149,166,181,166,149,82,53,85,165,85,85,107,86,85,149,90,171,85,74,165,117,85,53,209,85,165,165,170,166,214,82,41,53,170,181,174,170,164,186,170,150,170,180,182,42,169,170,170,173,22,42,165,146,170,146,74,165,150,234,161,174,170,180,173,138,202,150,122,175,213,74,173,84,42,169,80,82,165,162,214,80,109,170,84,83,106,173,98,170,210,85,170,172,84,171,91,205,170,154,82,45,165,86,165,234,210,90,141,82,71,173,170,74,171,106,105,85,171,106,149,42,233,66,169,61,87,171,213,218,170,37,89,169,182,234,170,170,171,170,164,170,170,170,170,210,170,168,170,186,170,171,170,170,169,31,248,3,240,255,15,0,240,255,255,255,1,0,0,255,191,244,255,255,255,63,0,0,0,0,0,0,254,255,255,255,255,3,0,0,0,0,160,255,255,255,255,255,255,63,0,0,0,0,0,0,0,0,252,255,255,255,255,255,255,255,0,0,0,0,0,0,0,0,224,255,255,255,255,255,255,255,255,255,7,0,0,0,0,0,0,0,0,0,192,255,255,255,255,255,255,255,255,255,255,7,0,0,0,0,0,0,0,0,0,128,255,255,255,255,255,255,255,255,255,255,255,255,0,0,0,0,0,0,0,0,0,0,0,255,255,255,255,255,255,255,255,255,255,255,255,255,255,1,0,0,0,0,0,0,0,0,0,224,255,255,255,255,255,255,255,255,255,255,255,255,15,0,0,0,0,0,0,0,0,240,255,255,255,255,255,255,15,0,0,0,0,0,0,0,0,0,0,192,255,255,255,255,255,255,255,7,0,0,0,0,0,0,128,255,255,255,255,255,3,0,0,0,0,0,0,0,0,255,255,255,255,255,1,0,248,255,255,255,255,255,31,0,0,0,0,0,0,64,255,255,127,248,3,224,255,7,0,240,255,255,255,0,0,0,128,255,255,255,255,255,31,0,0,0,0,0,224,255,255,255,255,255,3,0,0,0,0,192,255,255,255,255,255,255,63,0,0,0,0,0,0,0,0,252,255,255,255,255,255,255,255,0,0,0,0,0,0,0,0,224,255,255,255,255,255,255,255,255,255,7,0,0,0,0,0,0,0,0,0,224,255,255,255,255,255,255,255,255,255,255,3,0,0,0,0,0,0,0,0,0,192,255,255,255,255,255,255,255,255,255,255,255,255,0,0,0,0,0,0,0,0,0,0,0,255,255,255,255,255,255,255,255,255,255,255,255,255,255,0,0,0,0,0,0,0,0,0,0,224,255,255,255,255,255,255,255,255,255,255,255,255,15,0,0,0,0,0,0,0,0,240,255,255,255,255,255,255,15,0,0,0,0,0,0,0,0,0,0,224,255,255,255,255,255,255,255,3,0,0,0,0,0,0,128,255,255,255,255,255,3,0,0,0,0,0,0,0,0,255,255,255,255,255,0,0,248,255,255,255,255,255,15,0,0,0,0,0,0,168,250,142,186,255,5,64,255,245,7,128,255,0,192,255,255,1,0,80,255,255,255,255,31,0,2,250,102,254,255,191,1,0,0,189,255,215,37,21,0,0,232,215,127,183,8,0,8,165,247,255,154,5,0,128,178,253,254,175,146,165,34,84,85,237,235,123,85,167,64,37,146,214,111,73,90,20,169,40,168,146,180,213,106,213,174,44,210,72,180,190,233,183,10,161,22,74,84,181,189,106,85,37,27,64,182,190,219,86,170,21,64,171,85,109,245,210,170,0,84,75,165,85,173,50,83,40,101,181,107,101,133,168,118,33,74,237,189,84,237,186,74,160,168,171,237,21,145,117,74,165,171,106,41,86,117,69,101,165,170,238,173,170,160,22,165,80,221,118,165,90,171,170,182,108,253,231,85,146,52,170,106,171,117,73,1,4,183,21,41,251,215,10,40,90,83,173,149,86,85,40,169,170,169,202,182,109,37,21,73,169,168,181,170,170,64,45,219,151,102,105,181,75,146,202,119,45,237,182,23,1,170,234,85,85,174,173,9,64,164,95,127,83,69,165,16,82,182,85,85,21,48,218,42,169,108,91,239,214,186,188,181,84,149,170,85,37,133,64,173,106,182,105,69,75,209,150,171,166,74,173,186,148,72,86,175,181,210,210,149,82,172,154,163,42,181,209,92,9,149,169,137,120,42,53,156,172,166,88,77,207,142,172,170,172,234,214,78,39,201,50,178,202,146,35,32,213,83,97,212,82,110,169,170,106,149,82,197,213,170,166,84,107,185,157,74,171,210,162,148,170,170,170,178,84,181,108,85,45,170,85,85,75,173,82,171,180,170,138,174,202,170,165,162,170,170,234,142,146,254,1,64,255,255,47,0,0,224,255,255,127,1,0,0,160,255,255,127,31,1,0,128,246,255,255,255,3,0,64,253,255,119,9,17,0,0,90,247,127,191,10,0,64,169,245,255,58,41,8,128,80,253,255,175,21,45,64,21,212,239,251,91,149,170,80,41,178,214,111,73,90,20,170,41,168,150,37,181,106,149,46,12,210,72,182,174,249,183,10,161,22,74,84,181,189,106,69,165,27,64,182,190,219,86,170,85,64,171,80,109,245,210,174,128,84,75,165,85,173,50,91,13,252,1,248,255,15,0,240,127,255,255,1,0,0,255,159,244,255,255,255,63,0,0,0,0,0,64,254,255,255,255,255,3,0,0,0,0,224,255,255,255,255,255,255,63,0,0,0,0,0,0,0,0,252,255,255,255,255,255,255,255,0,0,0,0,0,0,0,0,192,255,255,255,255,255,255,255,255,255,55,0,0,0,0,0,0,0,0,0,192,255,255,255,255,255,255,255,255,255,255,7,0,0,0,0,0,0,0,0,0,128,255,255,255,255,255,255,255,255,255,255,255,255,0,0,0,0,0,0,0,0,0,0,0,255,255,255,255,255,255,255,255,255,255,255,255,255,255,1,0,0,0,0,0,0,0,0,0,224,255,255,255,255,255,255,255,255,255,255,255,255,15,0,0,0,0,0,0,0,0,240,255,255,255,255,255,255,15,0,0,0,0,0,0,0,0,0,0,192,255,255,255,255,255,255,255,7,0,0,0,0,0,0,128,255,255,255,255,255,3,0,0,0,0,0,0,0,0,255,255,255,255,255,0,0,248,255,255,255,255,255,15,0,0,0,0,0,0,64,255,255,255,255,255,255,75,4,0,0,0,0,0,0,170,215,181,253,255,255,255,255,253,255,255,255,255,255,6,74,0,0,0,0,0,160,255,255,255,255,247,175,0,0,0,0,0,0,0,161,235,255,255,255,255,255,255,255,255,255,223,142,172,138,0,0,0,0,0,0,0,0,128,144,99,124,213,87,127,213,122,239,239,239,250,253,119,255,221,170,166,84,74,1,0,10,129,208,162,148,170,170,170,186,86,149,110,87,45,171,84,85,107,165,90,173,180,178,90,151,73,166,85,85,209,214,82,75,181,85,149,85,85,213,84,90,169,210,166,212,86,42,205,169,170,165,22,42,165,150,170,150,82,173,180,74,171,173,42,165,170,138,222,53,84,127,149,84,75,165,114,75,149,84,40,85,181,208,202,90,165,150,78,202,213,86,85,173,106,109,173,74,85,221,202,150,84,105,37,85,173,220,150,86,213,84,85,173,74,74,171,106,81,85,105,105,213,42,89,74,165,20,85,181,85,85,181,20,85,85,85,85,85,85,85,85,85,85,85,85,85,85,85,85,85,85,85,85,85,85,85,250,142,186,254,0,96,255,255,15,128,255,0,192,255,255,1,0,80,247,254,255,255,31,0,0,248,102,254,255,191,1,0,64,189,255,215,41,129,2,0,120,247,127,175,10,0,64,41,245,191,118,41,2,128,20,237,255,239,21,41,64,21,149,234,251,91,165,170,80,41,178,213,110,201,218,180,170,104,168,180,36,181,106,149,172,44,210,72,180,190,232,191,42,161,82,106,84,181,181,42,5,5,89,64,215,58,235,82,171,82,96,169,74,181,87,83,181,162,74,41,165,118,245,154,75,45,37,245,173,37,85,245,58,36,104,181,181,86,85,151,74,161,168,170,174,4,145,85,107,165,171,106,41,86,85,69,101,169,170,238,169,172,181,85,37,81,253,118,169,154,170,196,117,85,217,109,149,164,164,202,90,90,117,91,0,69,181,55,106,223,149,82,64,85,87,41,181,84,146,10,171,34,169,218,183,93,37,17,73,171,105,181,170,170,64,45,219,215,102,233,149,75,146,170,119,37,229,246,87,69,160,170,95,85,181,174,42,0,228,238,125,43,69,149,16,114,151,86,61,85,16,90,169,173,166,107,247,90,159,190,148,106,212,170,210,149,133,64,53,42,178,44,69,73,209,86,171,38,74,173,186,149,72,86,175,191,146,144,181,82,170,190,167,74,45,147,212,90,169,107,169,89,106,37,60,169,172,93,154,154,10,173,202,141,219,180,92,110,137,54,162,214,181,99,85,213,87,66,165,82,106,170,170,74,133,82,203,236,170,174,84,107,185,141,74,171,210,162,148,170,170,170,186,238,148,170,211,165,170,218,86,41,181,74,173,150,186,138,182,200,170,212,86,213,82,74,105,181,84,149,80,85,85,84,91,173,90,183,86,86,43,69,173,170,165,82,170,165,146,170,150,90,165,180,74,171,173,42,165,170,138,222,181,84,95,149,84,74,165,118,91,149,4,42,85,165,144,202,94,173,182,206,74,213,84,85,169,74,105,169,90,213,154,234,180,85,75,42,85,169,168,146,86,139,182,74,169,170,74,170,106,105,85,171,106,149,170,234,42,169,170,74,169,74,74,171,182,170,181,170,170,154,170,170,186,186,170,42,171,170,170,170,170,218,170,170,170,42,181