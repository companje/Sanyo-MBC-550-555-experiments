sound: db 200,0,15,8,149,196,26,4,6,145,165,49,161,135,4,174,47,176,56,164,120,132,15,224,192,27,160,8,176,98,80,239,20,45,131,35,128,128,233,63,198,46,56,135,134,156,192,93,1,161,50,62,1,155,150,162,2,12,173,47,22,58,148,127,193,154,154,176,90,208,0,45,156,74,18,128,205,96,134,19,226,8,192,39,112,217,194,71,34,190,4,98,0,131,98,16,169,16,8,130,133,80,64,34,8,234,181,200,9,229,76,9,1,102,64,48,151,131,140,202,35,30,144,50,1,99,198,52,136,32,20,32,34,117,8,80,101,79,75,105,73,66,56,133,75,70,144,86,21,82,30,18,196,144,13,62,97,135,128,84,31,80,75,40,11,43,198,23,192,134,34,98,137,73,177,68,30,85,0,64,179,8,8,95,68,198,6,120,2,107,13,241,186,200,4,221,78,160,153,23,60,131