sound: db 232,3,31,192,127,0,255,1,248,15,224,63,128,255,0,254,3,248,15,224,63,0,255,1,252,7,240,31,192,127,0,255,1,248,15,224,63,128,255,0,254,3,248,15,224,63,0,255,1,252,7,240,31,192,127,0,255,1,248,15,224,63,128,255,0,254,3,248,15,224,63,0,255,1,252,7,240,31,192,127,0,255,1,248,15,224,63,128,255,0,254,3,248,15,224,63,0,255,1,252,7,240,31,192,127,0,255,1,248,15,224,63,128,255,0,254,3,248,15,224,63,0,255,1,252,7,240,31,192,127,0,255,1,248,15,224,63,128,255,0,254,3,248,15,224,127,0,255,1,252,7,240,31,192,127,0,255,1,248,15,224,63,128,255,0,254,3,248,15,224,63,0,255,1,252,7,240,31,192,127,0,255,1,248,15,224,63,128,255,0,254,3,248,15,224,63,0,255,1,252,7,240,31,192,127,0,255,1,248,15,224,63,128,255,0,254,3,248,15,224,63,0,255,1,252,7,240,31,192,127,0,255,1,248,15,224,63,128,255,0,254,3,248,15,224,63,0,255,1,252,7,240,31,192,127,0,255,1,248,15,224,63,128,255,0,254,3,248,15,224,63,0,255,1,252,7,240,31,192,127,0,255,1,248,15,224,63,128,255,0,254,3,248,15,224,63,0,255,1,252,7,240,31,192,127,0,255,1,248,15,224,63,128,255,0,254,3,248,15,224,63,0,255,1,252,7,240,31,192,127,0,255,1,248,15,224,63,128,255,0,254,3,248,15,224,63,0,255,1,252,7,240,31,192,127,0,255,1,248,15,224,63,128,255,0,254,3,248,15,224,63,0,255,1,252,7,240,31,192,127,0,255,1,248,15,224,63,128,255,0,254,3,248,15,224,63,0,255,1,252,7,240,31,192,127,0,255,1,248,15,224,63,128,255,0,254,3,248,15,224,63,0,255,1,252,7,240,31,192,127,0,255,1,248,15,224,63,128,255,0,254,3,248,15,224,63,0,255,1,252,7,240,31,192,127,0,255,1,248,15,224,63,128,255,0,254,3,248,15,224,63,0,255,1,252,7,240,31,192,127,0,255,1,248,15,224,63,128,255,0,254,3,248,15,224,63,0,255,1,252,7,240,31,192,127,0,255,1,248,15,224,63,128,255,0,254,3,248,15,224,63,0,255,1,252,7,240,31,192,127,0,255,1,248,15,224,63,128,255,0,254,3,248,15,224,127,0,255,1,252,7,240,31,192,127,0,255,1,248,15,224,63,128,255,0,254,3,248,15,224,63,0,255,1,252,7,240,31,192,127,0,255,1,252,15,224,63,128,255,0,254,3,248,15,224,63,0,255,1,252,7,240,31,192,127,0,255,1,248,15,224,63,128,255,0,254,3,248,15,224,63,0,255,1,252,7,240,31,192,127,0,255,1,248,15,224,63,128,255,0,254,3,248,15,224,63,0,255,1,252,7,240,31,192,127,0,255,1,248,15,224,63,128,255,0,254,3,248,15,224,63,0,255,1,252,7,240,31,192,127,0,255,1,248,15,224,63,128,255,0,254,3,248,15,224,63,0,255,1,252,7,240,31,192,127,0,255,1,248,15,224,63,128,255,0,254,3,248,15,224,63,0,255,1,252,7,240,31,192,127,0,255,1,248,15,224,63,128,255,0,254,3,248,15,224,63,0,255,1,252,7,240,31,192,127,0,255,1,248,15,224,63,128,255,0,254,3,248,15,224,63,0,255,1,252,7,240,31,192,127,0,255,1,248,15,224,63,128,255,0,254,3,248,15,224,63,0,255,1,252,7,240,31,192,127,0,255,1,248,15,224,63,128,255,0,254,3,248,15,224,63,0,255,1,252,7,240,31,192,127,0,255,1,248,15,224,63,128,255,0,254,3,248,15,224,63,0,255,1,252,7,240,31,192,127,0,255,1,248,15,224,63,128,255,0,254,3,248,15,224,63,0,255,1,252,7,240,31,192,127,0,255,1,248,15,224,63,128,255,0,254,3,248,15,224,63,0,255,1,252,7,240,31,192,127,0,255,1,248,15,224,63,128,255,0,254,3,248,15,224,63,0,255,1,252,7,240,31,192,127,0,255,1,248,15,224,63,128,255,0,254,3,248,15,224,63,0,255,1,252,7,240,31,192,127,0,255,1,248,15,224,63,128,255,0,254,3,248,15,224,63,0,255,1,252,7,240,31,192,127,0,255,1,248,15,224,63,128,255,0,254,3,248,15,224,63,0,255,1,252,7,240