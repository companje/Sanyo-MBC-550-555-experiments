sound: db 220,5,107,218,179,68,95,1,225,235,255,176,209,34,180,122,195,248,11,255,191,127,189,213,93,70,211,111,125,8,227,99,231,69,151,14,74,41,247,42,231,143,104,111,238,247,209,54,245,165,207,220,43,69,19,254,75,248,184,57,239,218,222,247,205,163,195,31,221,30,201,30,78,110,117,194,240,241,243,140,13,185,190,48,34,29,114,183,237,171,250,13,178,250,255,16,230,236,125,141,51,197,0,0,0,0,0,0,0,0,0,0,0,0,0,0,0,0,0,0,0,0,0,0,0,0,0,0,0,0,0,0,0,0,0,0,0,0,0,0,0,0,0,0,0,0,0,0,0,0,0,0,0,0,0,0,0,0,0,0,0,0,0,0,0,0,0,0,0,0,0,0,0,0,0,0,0,0,0,0,0,0,0,0,0,0,0,0,0,0,0,0,0,0,0,0,0,0,0,0,0,0,0,0,0,0,0,0,0,0,0,0,0,0,0,0,0,0,0,0,0,0,0,0,0,0,0,0,0,0,0,0,0,0,0,0,0,0,0,0,0,0,0,0,0,0,0,0,0,0,0,0,107,218,179,68,95,1,225,235,255,176,209,34,180,122,195,248,11,255,191,127,189,213,93,70,211,111,125,8,227,99,231,69,151,14,74,41,247,42,231,143,104,111,238,247,209,54,245,165,207,220,43,69,19,254,75,248,184,57,239,218,222,247,205,163,195,31,221,30,201,30,78,110,117,194,240,241,243,140,13,185,190,48,34,29,114,183,237,171,250,13,178,250,255,16,230,236,125,141,51,197,0,0,0,0,0,0,0,0,0,0,0,0,0,0,0,0,0,0,0,0,0,0,0,0,0,0,0,0,0,0,0,0,0,0,0,0,0,0,0,0,0,0,0,0,0,0,0,0,0,0,0,0,0,0,0,0,0,0,0,0,0,0,0,0,0,0,0,0,0,0,0,0,0,0,0,0,0,0,0,0,0,0,0,0,0,0,0,0,0,0,0,0,0,0,0,0,0,0,0,0,0,0,0,0,0,0,0,0,0,0,0,0,0,0,0,0,0,0,0,0,0,0,0,0,0,0,0,0,0,0,0,0,0,0,0,0,0,0,0,0,0,0,0,0,0,0,0,0,0,0,107,218,179,68,95,1,225,235,255,176,209,34,180,122,195,248,11,255,191,127,189,213,93,70,211,111,125,8,227,99,231,69,151,14,74,41,247,42,231,143,104,111,238,247,209,54,245,165,207,220,43,69,19,254,75,248,184,57,239,218,222,247,205,163,195,31,221,30,201,30,78,110,117,194,240,241,243,140,13,185,190,48,34,29,114,183,237,171,250,13,178,250,255,16,230,236,125,141,51,197,0,0,0,0,0,0,0,0,0,0,0,0,0,0,0,0,0,0,0,0,0,0,0,0,0,0,0,0,0,0,0,0,0,0,0,0,0,0,0,0,0,0,0,0,0,0,0,0,0,0,0,0,0,0,0,0,0,0,0,0,0,0,0,0,0,0,0,0,0,0,0,0,0,0,0,0,0,0,0,0,0,0,0,0,0,0,0,0,0,0,0,0,0,0,0,0,0,0,0,0,0,0,0,0,0,0,0,0,0,0,0,0,0,0,0,0,0,0,0,0,0,0,0,0,0,0,0,0,0,0,0,0,0,0,0,0,0,0,0,0,0,0,0,0,0,0,0,0,0,0,107,218,179,68,95,1,225,235,255,176,209,34,180,122,195,248,11,255,191,127,189,213,93,70,211,111,125,8,227,99,231,69,151,14,74,41,247,42,231,143,104,111,238,247,209,54,245,165,207,220,43,69,19,254,75,248,184,57,239,218,222,247,205,163,195,31,221,30,201,30,78,110,117,194,240,241,243,140,13,185,190,48,34,29,114,183,237,171,250,13,178,250,255,16,230,236,125,141,51,197,0,0,0,0,0,0,0,0,0,0,0,0,0,0,0,0,0,0,0,0,0,0,0,0,0,0,0,0,0,0,0,0,0,0,0,0,0,0,0,0,0,0,0,0,0,0,0,0,0,0,0,0,0,0,0,0,0,0,0,0,0,0,0,0,0,0,0,0,0,0,0,0,0,0,0,0,0,0,0,0,0,0,0,0,0,0,0,0,0,0,0,0,0,0,0,0,0,0,0,0,0,0,0,0,0,0,0,0,0,0,0,0,0,0,0,0,0,0,0,0,0,0,0,0,0,0,0,0,0,0,0,0,0,0,0,0,0,0,0,0,0,0,0,0,0,0,0,0,0,0,107,218,179,68,95,1,225,235,255,176,209,34,180,122,195,248,11,255,191,127,189,213,93,70,211,111,125,8,227,99,231,69,151,14,74,41,247,42,231,143,104,111,238,247,209,54,245,165,207,220,43,69,19,254,75,248,184,57,239,218,222,247,205,163,195,31,221,30,201,30,78,110,117,194,240,241,243,140,13,185,190,48,34,29,114,183,237,171,250,13,178,250,255,16,230,236,125,141,51,197,0,0,0,0,0,0,0,0,0,0,0,0,0,0,0,0,0,0,0,0,0,0,0,0,0,0,0,0,0,0,0,0,0,0,0,0,0,0,0,0,0,0,0,0,0,0,0,0,0,0,0,0,0,0,0,0,0,0,0,0,0,0,0,0,0,0,0,0,0,0,0,0,0,0,0,0,0,0,0,0,0,0,0,0,0,0,0,0,0,0,0,0,0,0,0,0,0,0,0,0,0,0,0,0,0,0,0,0,0,0,0,0,0,0,0,0,0,0,0,0,0,0,0,0,0,0,0,0,0,0,0,0,0,0,0,0,0,0,0,0,0,0,0,0,0,0,0,0,0,0,107,218,179,68,95,1,225,235,255,176,209,34,180,122,195,248,11,255,191,127,189,213,93,70,211,111,125,8,227,99,231,69,151,14,74,41,247,42,231,143,104,111,238,247,209,54,245,165,207,220,43,69,19,254,75,248,184,57,239,218,222,247,205,163,195,31,221,30,201,30,78,110,117,194,240,241,243,140,13,185,190,48,34,29,114,183,237,171,250,13,178,250,255,16,230,236,125,141,51,197,0,0,0,0,0,0,0,0,0,0,0,0,0,0,0,0,0,0,0,0,0,0,0,0,0,0,0,0,0,0,0,0,0,0,0,0,0,0,0,0,0,0,0,0,0,0,0,0,0,0,0,0,0,0,0,0,0,0,0,0,0,0,0,0,0,0,0,0,0,0,0,0,0,0,0,0,0,0,0,0,0,0,0,0,0,0,0,0,0,0,0,0,0,0,0,0,0,0,0,0,0,0,0,0,0,0,0,0,0,0,0,0,0,0,0,0,0,0,0,0,0,0,0,0,0,0,0,0,0,0,0,0,0,0,0,0,0,0,0,0,0,0,0,0,0,0,0,0,0,0