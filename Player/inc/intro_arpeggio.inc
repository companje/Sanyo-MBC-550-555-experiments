sound: db 0,15,254,255,31,0,0,254,255,63,0,0,252,255,127,0,0,248,255,127,0,0,240,255,255,0,0,224,255,255,1,0,224,255,255,3,0,192,255,255,7,0,128,255,255,7,0,0,255,255,15,0,0,254,255,31,0,0,254,255,63,0,0,252,255,127,0,0,248,255,255,0,0,240,255,255,0,0,224,255,255,1,0,192,255,255,3,0,192,255,255,7,0,128,255,255,15,0,0,255,255,15,0,0,254,255,31,0,0,252,255,63,0,0,252,255,127,0,0,248,255,255,254,255,0,128,255,63,0,192,255,31,0,240,255,15,0,248,255,3,0,254,255,1,0,255,127,0,128,255,63,0,224,255,15,0,240,255,7,0,252,255,3,0,254,255,0,128,255,127,0,192,255,31,0,224,255,15,0,248,255,3,0,252,255,1,0,255,255,0,128,255,63,0,224,255,31,0,240,255,7,0,248,255,3,0,254,255,0,0,255,127,0,192,255,63,0,224,255,15,0,240,255,7,0,252,255,1,0,254,255,0,128,255,127,0,192,255,31,0,240,255,254,31,0,254,31,0,254,31,0,254,31,0,252,63,0,252,63,0,252,63,0,252,127,0,248,127,0,248,127,0,248,127,0,248,255,0,240,255,0,240,255,0,240,255,0,224,255,1,224,255,1,224,255,1,224,255,1,192,255,3,192,255,3,192,255,3,192,255,7,128,255,7,128,255,7,128,255,7,0,255,15,0,255,15,0,255,15,0,255,15,0,254,31,0,254,31,0,254,31,0,254,63,0,252,63,0,252,63,0,252,63,0,252,127,0,248,127,0,248,127,254,255,0,128,255,63,0,192,255,31,0,240,255,15,0,248,255,3,0,254,255,1,0,255,127,0,128,255,63,0,224,255,15,0,240,255,7,0,252,255,3,0,254,255,0,128,255,127,0,192,255,31,0,224,255,15,0,248,255,3,0,252,255,1,0,255,255,0,128,255,63,0,224,255,31,0,240,255,7,0,248,255,3,0,254,255,0,0,255,127,0,192,255,63,0,224,255,15,0,240,255,7,0,252,255,1,0,254,255,0,128,255,127,0,192,255,31,0,240,255,254,255,31,0,0,254,255,63,0,0,252,255,127,0,0,248,255,127,0,0,240,255,255,0,0,224,255,255,1,0,224,255,255,3,0,192,255,255,7,0,128,255,255,7,0,0,255,255,15,0,0,254,255,31,0,0,254,255,63,0,0,252,255,127,0,0,248,255,255,0,0,240,255,255,0,0,224,255,255,1,0,192,255,255,3,0,192,255,255,7,0,128,255,255,15,0,0,255,255,15,0,0,254,255,31,0,0,252,255,63,0,0,252,255,127,0,0,248,255,255,254,255,0,128,255,63,0,192,255,31,0,240,255,15,0,248,255,3,0,254,255,1,0,255,127,0,128,255,63,0,224,255,15,0,240,255,7,0,252,255,3,0,254,255,0,128,255,127,0,192,255,31,0,224,255,15,0,248,255,3,0,252,255,1,0,255,255,0,128,255,63,0,224,255,31,0,240,255,7,0,248,255,3,0,254,255,0,0,255,127,0,192,255,63,0,224,255,15,0,240,255,7,0,252,255,1,0,254,255,0,128,255,127,0,192,255,31,0,240,255,254,31,0,254,31,0,254,31,0,254,31,0,252,63,0,252,63,0,252,63,0,252,127,0,248,127,0,248,127,0,248,127,0,248,255,0,240,255,0,240,255,0,240,255,0,224,255,1,224,255,1,224,255,1,224,255,1,192,255,3,192,255,3,192,255,3,192,255,7,128,255,7,128,255,7,128,255,7,0,255,15,0,255,15,0,255,15,0,255,15,0,254,31,0,254,31,0,254,31,0,254,63,0,252,63,0,252,63,0,252,63,0,252,127,0,248,127,0,248,127,254,255,0,128,255,63,0,192,255,31,0,240,255,15,0,248,255,3,0,254,255,1,0,255,127,0,128,255,63,0,224,255,15,0,240,255,7,0,252,255,3,0,254,255,0,128,255,127,0,192,255,31,0,224,255,15,0,248,255,3,0,252,255,1,0,255,255,0,128,255,63,0,224,255,31,0,240,255,7,0,248,255,3,0,254,255,0,0,255,127,0,192,255,63,0,224,255,15,0,240,255,7,0,252,255,1,0,254,255,0,128,255,127,0,192,255,31,0,240,255,254,255,31,0,0,254,255,63,0,0,252,255,127,0,0,248,255,127,0,0,240,255,255,0,0,224,255,255,1,0,224,255,255,3,0,192,255,255,7,0,128,255,255,7,0,0,255,255,15,0,0,254,255,31,0,0,254,255,63,0,0,252,255,127,0,0,248,255,255,0,0,240,255,255,0,0,224,255,255,1,0,192,255,255,3,0,192,255,255,7,0,128,255,255,15,0,0,255,255,15,0,0,254,255,31,0,0,252,255,63,0,0,252,255,127,0,0,248,255,255,254,255,1,0,254,255,1,0,254,255,1,0,252,255,3,0,252,255,3,0,252,255,7,0,248,255,7,0,248,255,7,0,240,255,15,0,240,255,15,0,240,255,31,0,224,255,31,0,224,255,31,0,192,255,63,0,192,255,63,0,192,255,127,0,128,255,127,0,128,255,127,0,0,255,255,0,0,255,255,0,0,255,255,1,0,254,255,1,0,254,255,1,0,252,255,3,0,252,255,3,0,252,255,7,0,248,255,7,0,248,255,7,0,240,255,15,0,240,255,15,254,63,0,240,255,1,128,255,31,0,252,255,0,224,255,7,0,254,63,0,240,255,3,128,255,31,0,252,255,0,192,255,7,0,254,127,0,240,255,3,128,255,31,0,248,255,0,192,255,15,0,254,127,0,240,255,3,0,255,31,0,248,255,0,192,255,15,0,254,127,0,224,255,3,0,255,31,0,248,255,1,192,255,15,0,252,127,0,224,255,3,0,255,63,0,248,255,1,128,255,15,0,252,127,0,224,255,7,0,255,63,0,248,255,1,128,255,15,0,252,254,255,1,0,254,255,1,0,254,255,1,0,252,255,3,0,252,255,3,0,252,255,7,0,248,255,7,0,248,255,7,0,240,255,15,0,240,255,15,0,240,255,31,0,224,255,31,0,224,255,31,0,192,255,63,0,192,255,63,0,192,255,127,0,128,255,127,0,128,255,127,0,0,255,255,0,0,255,255,0,0,255,255,1,0,254,255,1,0,254,255,1,0,252,255,3,0,252,255,3,0,252,255,7,0,248,255,7,0,248,255,7,0,240,255,15,0,240,255,15,254,255,31,0,0,254,255,63,0,0,252,255,127,0,0,248,255,127,0,0,240,255,255,0,0,224,255,255,1,0,224,255,255,3,0,192,255,255,7,0,128,255,255,7,0,0,255,255,15,0,0,254,255,31,0,0,254,255,63,0,0,252,255,127,0,0,248,255,255,0,0,240,255,255,0,0,224,255,255,1,0,192,255,255,3,0,192,255,255,7,0,128,255,255,15,0,0,255,255,15,0,0,254,255,31,0,0,252,255,63,0,0,252,255,127,0,0,248,255,255,254,255,1,0,254,255,1,0,254,255,1,0,252,255,3,0,252,255,3,0,252,255,7,0,248,255,7,0,248,255,7,0,240,255,15,0,240,255,15,0,240,255,31,0,224,255,31,0,224,255,31,0,192,255,63,0,192,255,63,0,192,255,127,0,128,255,127,0,128,255,127,0,0,255,255,0,0,255,255,0,0,255,255,1,0,254,255,1,0,254,255,1,0,252,255,3,0,252,255,3,0,252,255,7,0,248,255,7,0,248,255,7,0,240,255,15,0,240,255,15,254,63,0,240,255,1,128,255,31,0,252,255,0,224,255,7,0,254,63,0,240,255,3,128,255,31,0,252,255,0,192,255,7,0,254,127,0,240,255,3,128,255,31,0,248,255,0,192,255,15,0,254,127,0,240,255,3,0,255,31,0,248,255,0,192,255,15,0,254,127,0,224,255,3,0,255,31,0,248,255,1,192,255,15,0,252,127,0,224,255,3,0,255,63,0,248,255,1,128,255,15,0,252,127,0,224,255,7,0,255,63,0,248,255,1,128,255,15,0,252,254,255,1,0,254,255,1,0,254,255,1,0,252,255,3,0,252,255,3,0,252,255,7,0,248,255,7,0,248,255,7,0,240,255,15,0,240,255,15,0,240,255,31,0,224,255,31,0,224,255,31,0,192,255,63,0,192,255,63,0,192,255,127,0,128,255,127,0,128,255,127,0,0,255,255,0,0,255,255,0,0,255,255,1,0,254,255,1,0,254,255,1,0,252,255,3,0,252,255,3,0,252,255,7,0,248,255,7,0,248,255,7,0,240,255,15,0,240,255,15,254,255,7,0,224,255,127,0,0,254,255,7,0,192,255,255,0,0,252,255,15,0,192,255,255,0,0,248,255,31,0,128,255,255,1,0,248,255,63,0,0,255,255,3,0,240,255,63,0,0,255,255,7,0,224,255,127,0,0,254,255,7,0,192,255,255,0,0,252,255,15,0,192,255,255,1,0,248,255,31,0,128,255,255,1,0,248,255,63,0,0,255,255,3,0,240,255,63,0,0,255,255,7,0,224,255,127,0,0,254,255,7,0,192,255,255,0,0,252,255,254,63,0,240,255,1,128,255,31,0,252,255,0,224,255,7,0,254,63,0,240,255,3,128,255,31,0,252,255,0,192,255,7,0,254,127,0,240,255,3,128,255,31,0,248,255,0,192,255,15,0,254,127,0,240,255,3,0,255,31,0,248,255,0,192,255,15,0,254,127,0,224,255,3,0,255,31,0,248,255,1,192,255,15,0,252,127,0,224,255,3,0,255,63,0,248,255,1,128,255,15,0,252,127,0,224,255,7,0,255,63,0,248,255,1,128,255,15,0,252,254,15,128,255,7,192,255,3,224,255,1,240,255,0,248,63,0,252,31,0,254,15,0,255,7,128,255,3,192,255,1,240,255,0,248,127,0,252,63,0,254,31,0,255,15,128,255,3,192,255,1,224,255,0,240,127,0,248,63,0,252,31,0,255,15,128,255,7,192,255,3,224,255,1,240,255,0,248,63,0,252,31,0,254,15,0,255,7,128,255,3,192,255,1,240,255,0,248,127,0,252,63,0,254,31,0,255,15,128,255,3,192,255,1,224,255,0,240,127,0,254,63,0,240,255,1,128,255,31,0,252,255,0,224,255,7,0,254,63,0,240,255,3,128,255,31,0,252,255,0,192,255,7,0,254,127,0,240,255,3,128,255,31,0,248,255,0,192,255,15,0,254,127,0,240,255,3,0,255,31,0,248,255,0,192,255,15,0,254,127,0,224,255,3,0,255,31,0,248,255,1,192,255,15,0,252,127,0,224,255,3,0,255,63,0,248,255,1,128,255,15,0,252,127,0,224,255,7,0,255,63,0,248,255,1,128,255,15,0,252,254,255,7,0,224,255,127,0,0,254,255,7,0,192,255,255,0,0,252,255,15,0,192,255,255,0,0,248,255,31,0,128,255,255,1,0,248,255,63,0,0,255,255,3,0,240,255,63,0,0,255,255,7,0,224,255,127,0,0,254,255,7,0,192,255,255,0,0,252,255,15,0,192,255,255,1,0,248,255,31,0,128,255,255,1,0,248,255,63,0,0,255,255,3,0,240,255,63,0,0,255,255,7,0,224,255,127,0,0,254,255,7,0,192,255,255,0,0,252,255,254,63,0,240,255,1,128,255,31,0,252,255,0,224,255,7,0,254,63,0,240,255,3,128,255,31,0,252,255,0,192,255,7,0,254,127,0,240,255,3,128,255,31,0,248,255,0,192,255,15,0,254,127,0,240,255,3,0,255,31,0,248,255,0,192,255,15,0,254,127,0,224,255,3,0,255,31,0,248,255,1,192,255,15,0,252,127,0,224,255,3,0,255,63,0,248,255,1,128,255,15,0,252,127,0,224,255,7,0,255,63,0,248,255,1,128,255,15,0,252,254,15,128,255,7,192,255,3,224,255,1,240,255,0,248,63,0,252,31,0,254,15,0,255,7,128,255,3,192,255,1,240,255,0,248,127,0,252,63,0,254,31,0,255,15,128,255,3,192,255,1,224,255,0,240,127,0,248,63,0,252,31,0,255,15,128,255,7,192,255,3,224,255,1,240,255,0,248,63,0,252,31,0,254,15,0,255,7,128,255,3,192,255,1,240,255,0,248,127,0,252,63,0,254,31,0,255,15,128,255,3,192,255,1,224,255,0,240,127,0,254,63,0,240,255,1,128,255,31,0,252,255,0,224,255,7,0,254,63,0,240,255,3,128,255,31,0,252,255,0,192,255,7,0,254,127,0,240,255,3,128,255,31,0,248,255,0,192,255,15,0,254,127,0,240,255,3,0,255,31,0,248,255,0,192,255,15,0,254,127,0,224,255,3,0,255,31,0,248,255,1,192,255,15,0,252,127,0,224,255,3,0,255,63,0,248,255,1,128,255,15,0,252,127,0,224,255,7,0,255,63,0,248,255,1,128,255,15,0,252,254,255,7,0,224,255,127,0,0,254,255,7,0,192,255,255,0,0,252,255,15,0,192,255,255,0,0,248,255,31,0,128,255,255,1,0,248,255,63,0,0,255,255,3,0,240,255,63,0,0,255,255,7,0,224,255,127,0,0,254,255,7,0,192,255,255,0,0,252,255,15,0,192,255,255,1,0,248,255,31,0,128,255,255,1,0,248,255,63,0,0,255,255,3,0,240,255,63,0,0,255,255,7,0,224,255,127,0,0,254,255,7,0,192,255,255,0,0,252,255,254,255,0,128,255,63,0,192,255,31,0,240,255,15,0,248,255,3,0,254,255,1,0,255,127,0,128,255,63,0,224,255,15,0,240,255,7,0,252,255,3,0,254,255,0,128,255,127,0,192,255,31,0,224,255,15,0,248,255,3,0,252,255,1,0,255,255,0,128,255,63,0,224,255,31,0,240,255,7,0,248,255,3,0,254,255,0,0,255,127,0,192,255,63,0,224,255,15,0,240,255,7,0,252,255,1,0,254,255,0,128,255,127,0,192,255,31,0,240,255,254,31,0,254,31,0,254,31,0,254,31,0,252,63,0,252,63,0,252,63,0,252,127,0,248,127,0,248,127,0,248,127,0,248,255,0,240,255,0,240,255,0,240,255,0,224,255,1,224,255,1,224,255,1,224,255,1,192,255,3,192,255,3,192,255,3,192,255,7,128,255,7,128,255,7,128,255,7,0,255,15,0,255,15,0,255,15,0,255,15,0,254,31,0,254,31,0,254,31,0,254,63,0,252,63,0,252,63,0,252,63,0,252,127,0,248,127,0,248,127,254,255,0,128,255,63,0,192,255,31,0,240,255,15,0,248,255,3,0,254,255,1,0,255,127,0,128,255,63,0,224,255,15,0,240,255,7,0,252,255,3,0,254,255,0,128,255,127,0,192,255,31,0,224,255,15,0,248,255,3,0,252,255,1,0,255,255,0,128,255,63,0,224,255,31,0,240,255,7,0,248,255,3,0,254,255,0,0,255,127,0,192,255,63,0,224,255,15,0,240,255,7,0,252,255,1,0,254,255,0,128,255,127,0,192,255,31,0,240,255,254,255,7,0,224,255,127,0,0,254,255,7,0,192,255,255,0,0,252,255,15,0,192,255,255,0,0,248,255,31,0,128,255,255,1,0,248,255,63,0,0,255,255,3,0,240,255,63,0,0,255,255,7,0,224,255,127,0,0,254,255,7,0,192,255,255,0,0,252,255,15,0,192,255,255,1,0,248,255,31,0,128,255,255,1,0,248,255,63,0,0,255,255,3,0,240,255,63,0,0,255,255,7,0,224,255,127,0,0,254,255,7,0,192,255,255,0,0,252,255,254,255,0,128,255,63,0,192,255,31,0,240,255,15,0,248,255,3,0,254,255,1,0,255,127,0,128,255,63,0,224,255,15,0,240,255,7,0,252,255,3,0,254,255,0,128,255,127,0,192,255,31,0,224,255,15,0,248,255,3,0,252,255,1,0,255,255,0,128,255,63,0,224,255,31,0,240,255,7,0,248,255,3,0,254,255,0,0,255,127,0,192,255,63,0,224,255,15,0,240,255,7,0,252,255,1,0,254,255,0,128,255,127,0,192,255,31,0,240,255,254,31,0,254,31,0,254,31,0,254,31,0,252,63,0,252,63,0,252,63,0,252,127,0,248,127,0,248,127,0,248,127,0,248,255,0,240,255,0,240,255,0,240,255,0,224,255,1,224,255,1,224,255,1,224,255,1,192,255,3,192,255,3,192,255,3,192,255,7,128,255,7,128,255,7,128,255,7,0,255,15,0,255,15,0,255,15,0,255,15,0,254,31,0,254,31,0,254,31,0,254,63,0,252,63,0,252,63,0,252,63,0,252,127,0,248,127,0,248,127,254,255,0,128,255,63,0,192,255,31,0,240,255,15,0,248,255,3,0,254,255,1,0,255,127,0,128,255,63,0,224,255,15,0,240,255,7,0,252,255,3,0,254,255,0,128,255,127,0,192,255,31,0,224,255,15,0,248,255,3,0,252,255,1,0,255,255,0,128,255,63,0,224,255,31,0,240,255,7,0,248,255,3,0,254,255,0,0,255,127,0,192,255,63,0,224,255,15,0,240,255,7,0,252,255,1,0,254,255,0,128,255,127,0,192,255,31,0,240,255