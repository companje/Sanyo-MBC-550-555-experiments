sound: db 85,181,170,170,170,170,42,186,234,174,200,178,41,107,75,38,219,156,108,219,50,99,38,6,206,204,60,248,249,241,99,131,139,51,87,206,156,28,30,51,227,228,216,153,99,198,248,56,56,62,62,38,231,192,225,124,28,31,199,199,241,248,240,225,227,195,193,193,177,227,120,112,240,112,120,124,120,12,15,15,15,199,195,195,124,248,240,192,7,135,15,240,225,240,3,60,14,222,128,199,195,195,225,51,248,56,252,14,31,15,207,195,195,129,127,16,62,198,143,177,115,240,29,31,3,226,223,248,24,124,124,124,112,114,241,51,96,240,252,95,32,230,255,3,192,237,127,0,176,255,55,0,240,255,7,0,254,255,1,0,255,255,0,192,255,63,0,240,255,7,0,248,255,1,0,254,255,0,128,255,63,0,224,255,15,0,252,255,1,0,254,255,0,64,255,31,0,224,255,7,0,246,255,4,128,255,127,0,192,255,15,0,224,255,13,0,254,255,1,0,252,127,0,0,254,127,0,224,255,29,0,224,255,207,0,152,255,7,0,251,255,4,128,252,207,12,128,223,153,1,98,238,140,152,57,55,7,0,156,51,98,102,238,103,136,113,142,243,24,199,57,206,113,140,115,24,199,56,206,49,30,231,56,199,57,158,99,140,231,56,199,51,206,241,28,103,220,199,24,206,49,7,103,156,177,51,206,152,49,103,204,184,99,230,220,49,99,204,184,49,230,156,25,103,204,156,51,70,142,57,103,198,153,51,227,140,145,115,206,200,49,230,204,56,99,102,156,49,115,206,25,57,230,156,24,99,206,140,49,102,198,25,51,227,140,129,113,206,225,56,199,113,28,227,112,142,113,56,199,121,28,227,56,142,115,28,198,49,14,199,56,142,227,28,199,113,156,195,49,142,227,56,206,97,28,199,113,14,199,56,14,103,60,14,51,62,142,25,55,142,28,55,142,28,23,199,143,19,199,143,19,199,143,19,199,140,27,199,140,25,103,142,25,99,142,153,99,206,153,99,198,153,115,198,153,115,206,25,115,198,152,51,199,140,131,227,198,195,113,224,227,112,224,241,56,240,120,28,120,56,14,56,28,135,60,14,71,28,135,99,142,199,49,135,227,24,199,113,140,227,56,206,113,60,231,56,158,99,60,142,113,28,199,56,142,99,28,199,49,142,227,56,134,243,28,199,113,140,227,56,142,225,60,135,225,28,135,113,30,195,112,158,195,56,143,99,156,199,113,204,135,49,238,199,24,126,103,28,158,35,14,207,1,135,231,129,195,227,224,225,113,240,240,120,112,112,60,120,24,30,56,12,111,56,134,119,28,195,51,142,193,57,207,225,28,199,112,142,99,56,230,99,24,243,35,12,241,63,12,240,31,0,240,31,0,240,255,1,240,255,1,240,255,3,240,255,1,240,255,0,240,127,0,248,63,0,224,127,0,240,127,0,252,127,0,254,63,0,252,15,0,252,31,0,252,31,0,240,127,0,251,127,0,252,63,0,252,255,0,240,255,1,224,255,7,0,255,7,144,255,7,128,63,99,128,251,49,14,248,15,227,128,127,96,14,248,7,252,128,127,224,15,248,7,254,0,127,224,15,248,3,254,128,63,240,15,254,128,63,224,15,248,3,254,128,63,224,15,248,3,126,128,63,224,7,248,3,126,128,63,224,7,248,7,126,0,255,144,3,224,159,57,2,254,153,35,196,220,51,98,204,61,35,198,220,51,98,204,57,35,198,220,59,98,206,157,49,103,204,25,115,198,156,49,39,236,9,123,194,222,176,7,244,5,127,192,63,240,7,252,3,127,192,31,240,3,252,1,63,192,31,248,3,252,129,63,224,15,252,1,254,192,31,240,7,252,0,127,224,15,240,7,254,0,63,224,15,240,3,254,128,31,240,7,252,128,127,192,7,254,3,60,224,31,224,1,127,192,15,248,129,63,224,7,255,67,4,248,103,0,240,255,31,192,15,252,1,31,248,131,31,240,199,13,40,122,198,12,184,51,3,220,185,129,1,55,102,196,140,57,49,226,142,156,49,99,102,252,129,15,63,252,129,15,127,224,135,31,240,193,15,124,240,3,63,248,128,31,124,224,7,31,248,225,7,124,240,3,31,60,184,3,14,252,192,7,15,240,131,7,248,193,129,255,240,192,125,120,240,60,60,120,30,30,60,15,15,142,135,7,199,193,131,243,224,193,120,240,96,60,120,56,30,60,28,15,30,142,135,15,199,195,135,227,225,193,241,240,224,120,120,120,60,60,60,30,30,30,15,15,143,135,135,199,195,195,227,225,225,241,240,112,120,120,56,60,60,28,30,30,14,7,15,199,131,7,239,193,3,252,225,3,254,240,1,127,248,128,63,124,192,31,126,192,7,63,224,131,31,224,131,15,243,193,3,119,196,3,15,204,131,15,158,131,15,252,193,79,248,193,143,248,131,15,15,7,15,62,28,30,124,56,60,248,0,60,248,56,124,240,224,224,193,131,135,7,15,30,60,120,240,240,240,193,31,128,15,62,28,62,252,0,252,224,3,248,3,31,240,15,248,192,127,224,7,254,0,127,224,15,248,3,62,192,63,224,7,252,3,254,192,63,240,127,220,24,112,79,152,17,254,132,29,241,71,204,177,119,192,216,121,96,128,248,113,12,248,57,14,156,31,14,12,190,15,6,135,247,3,129,249,251,0,200,249,35,96,252,127,32,70,252,59,35,204,189,51,66,204,63,35,192,254,63,2,196,255,51,0,252,255,3,224,248,63,0,6,254,7,115,224,115,240,17,248,240,124,120,24,124,60,60,60,60,62,31,14,143,63,7,143,145,7,199,129,227,192,193,241,99,192,224,121,124,24,56,126,62,28,30,14,30,63,14,24,60,255,31,3,224,254,63,6,14,62,30,30,99,198,156,59,15,10,51,230,204,221,145,19,115,70,204,140,25,49,99,238,204,143,185,51,118,198,204,216,25,115,98,238,192,9,185,3,127,204,30,252,48,115,224,195,201,131,15,14,14,60,56,120,240,193,193,131,7,15,15,62,120,120,240,193,195,131,7,254,13,62,128,15,124,56,120,240,225,193,131,15,31,62,124,240,240,193,131,135,15,30,60,124,240,224,225,131,7,15,30,124,248,240,225,195,135,15,31,62,124,248,240,224,193,131,7,15,30,60,120,240,224,195,135,15,31,60,120,240,225,195,7,15,30,124,248,224,193,131,7,15,30,60,120,240,225,131,7,31,60,248,240,193,131,15,31,62,248,224,129,15,62,248,224,131,15,62,124,240,193,7,31,124,240,193,7,31,248,224,3,31,124,224,131,7,62,240,195,131,31,240,63,224,135,192,15,252,28,240,3,254,128,248,3,254,15,124,192,255,248,3,240,135,127,0,254,231,3,192,255,49,28,136,255,193,112,240,31,14,3,255,120,0,158,199,15,192,15,254,0,14,224,7,56,0,127,226,1,124,140,143,224,241,60,28,134,199,225,1,124,128,31,224,7,252,0,63,224,15,248,3,127,192,31,248,3,254,192,31,240,7,254,0,127,224,7,224,7,254,3,254,192,63,224,15,252,3,126,192,31,224,15,248,1,127,128,63,240,129,157,7,62,248,240,225,7,252,113,238,128,31,248,192,193,3,31,252,176,227,15,60,240,199,132,15,63,252,240,193,7,15,248,225,199,135,63,240,224,129,31,126,248,224,131,15,30,124,240,3,254,136,31,192,7,31,124,224,225,224,131,15,126,104,29,248,3,252,161,85,106,213,3,189,64,173,23,194,7,62,7,63,28,126,240,248,192,15,252,3,31,124,224,15,224,7,15,252,1,247,7,240,7,244,31,0,63,248,1,62,248,192,63,240,15,240,15,144,47,208,15,240,5,94,232,133,118,11,252,128,31,224,23,248,1,63,224,7,124,192,31,248,129,31,248,193,31,248,75,161,58,29,224,15,252,192,7,126,224,225,7,31,252,192,31,4,126,128,255,1,63,224,225,3,126,224,240,3,63,248,224,7,31,124,240,131,15,124,240,193,15,62,252,192,15,60,126,224,15,248,63,224,15,248,31,240,7,248,7,248,3,252,7,252,1,254,1,254,129,31,128,127,240,3,192,31,199,15,0,126,60,248,192,243,131,135,7,62,31,248,112,240,131,131,15,63,60,240,224,225,3,15,30,126,240,224,193,135,7,7,15,63,60,248,224,193,135,15,62,248,240,225,131,15,31,62,248,224,131,15,31,124,240,193,7,15,62,248,224,131,15,62,248,224,131,15,126,240,3,31,124,240,192,7,254,208,57,244,202,79,29,188,112,161,15,61,248,129,95,252,3,13,232,51,221,140,179,84,13,155,126,164,31,254,128,15,248,128,15,252,192,47,248,193,39,62,232,147,63,228,131,31,244,193,31,254,225,7,31,244,131,15,252,192,15,126,224,7,126,224,7,63,240,3,63,248,129,31,248,193,15,252,192,15,254,224,7,126,240,7,63,240,3,63,248,129,31,248,129,15,252,192,15,252,224,7,126,224,7,63,240,3,31,248,129,31,252,192,15,124,224,7,126,240,3,63,248,129,31,252,192,15,126,224,7,63,240,131,31,248,193,15,124,224,7,63,248,131,15,252,193,7,254,224,3,63,240,129,31,248,192,15,124,224,7,62,240,131,15,248,193,7,254,224,3,127,240,129,63,248,192,15,124,224,7,62,240,3,31,248,129,15,252,192,7,126,224,3,63,240,131,31,248,129,31,252,192,15,124,224,7,62,240,3,31,248,129,31,252,192,15,126,224,7,62,240,3,63,248,129,31,248,192,15,124,224,7,62,240,3,31,248,129,15,252,192,7,126,224,3,63,240,129,31,248,193,15,252,224,7,126,240,3,63,248,129,31,252,192,7,126,224,3,63,240,129,31,248,193,15,252,224,7,126,240,3,63,248,129,31,252,192,15,254,224,7,126,224,3,63,240,129,31,248,193,15,252,224,15,124,240,7,62,240,3,63,248,3,31,252,129,15,252,192,7,254,224,3,127,240,131,63,240,193,63,248,224,31,124,240,15,62,240,7,63,248,3,31,252,131,15,254,193,7,255,192,131,127,96,131,31,48,241,15,152,252,7,200,255,3,224,255,1,240,255,0,240,255,0,252,127,0,252,15,0,252,7,0,254,3,0,254,3,4,254,1,0,254,128,3,127,192,193,63,192,193,31,240,193,7,31,124,224,211,7,48,63,27,176,153,153,204,204,76,100,102,102,54,51,51,155,153,153,201,204,204,108,102,102,38,51,51,147,153,153,201,204,204,228,102,118,240,3,63,248,129,31,252,192,15,126,224,15,62,224,7,31,240,131,15,248,131,15,252,193,7,252,224,3,126,240,1,63,248,129,63,248,128,31,124,192,15,62,224,7,63,240,131,31,248,129,15,252,192,15,126,224,7,127,224,131,63,224,193,31,240,224,31,96,240,15,0,252,7,0,254,3,0,255,1,128,255,0,224,255,0,240,127,0,240,127,0,240,127,0,240,127,0,224,255,1,224,255,1,224,255,1,224,255,1,224,255,7,0,255,15,0,252,127,0,248,255,0,224,255,1,192,255,7,128,255,15,144,1,240,255,1,224,255,3,192,255,3,192,255,1,248,31,0,255,31,0,252,127,0,240,255,3,128,254,31,0,252,95,0,252,15,128,255,5,192,255,7,192,255,15,192,238,103,32,63,50,147,53,217,157,36,200,111,2,228,159,17,226,239,9,49,231,140,152,115,103,204,153,51,102,206,25,113,199,206,56,99,198,156,57,115,198,204,96,103,102,50,51,51,153,153,221,204,204,78,102,38,55,19,131,131,139,193,193,193,225,225,224,240,112,120,120,120,60,60,60,30,30,30,15,15,15,135,135,135,195,195,195,225,225,225,240,240,112,120,120,56,60,60,28,30,30,30,15,15,15,135,135,135,199,195,195,195,225,225,225,241,240,240,120,120,120,56,60,60,60,28,30,30,30,15,15,15,143,135,135,199,195,195,195,225,225,225,225,240,240,240,248,120,120,120,60,60,60,28,60,30,30,30,31,15,15,15,135,143,135,135,199,199,195,195,195,225,225,225,224,241,240,240,240,120,120,120,56,60,60,28,30,30,14,30,15,15,143,135,135,135,135,195,195,195,225,225,225,225,241,240,240,240,120,120,56,60,60,30,30,30,15,15,15,15,135,135,135,135,135,135,135,135,15,15,15,31,120,120,120,240,224,224,193,7,143,15,15,15,15,31,30,30,62,60,60,124,120,120,240,240,240,225,225,193,195,195,131,135,135,135,143,7,15,15,15,15,142,15,62,128,15,207,3,31,62,30,62,124,24,60,248,56,248,224,241,224,195,225,193,63,8,124,120,120,240,227,224,131,255,129,15,248,3,255,192,15,240,3,254,128,63,192,31,248,15,254,0,126,192,15,240,15,60,224,127,112,0,252,56,56,124,60,56,124,60,56,60,60,0,255,7,135,199,135,129,195,231,1,224,243,99,224,240,120,120,112,120,124,60,60,60,62,30,28,62,31,14,143,143,7,131,239,195,129,225,225,225,96,240,248,120,48,120,126,24,8,62,31,15,15,143,15,15,7,7,159,63,109,240,120,120,248,248,120,112,248,254,52,64,192,239,31,1,22,159,46,30,24,62,155,108,58,120,124,250,124,48,120,112,249,56,56,120,120,56,124,120,120,48,120,120,120,120,120,56,56,248,188,47,200,131,143,143,131,135,135,131,135,199,199,192,193,251,240,160,125,120,176,8,60,120,8,62,62,126,152,25,248,224,227,240,240,240,240,112,120,120,56,60,60,28,30,30,15,15,143,135,135,195,195,195,225,225,225,240,240,112,120,120,56,60,60,30,30,14,15,143,135,135,199,195,195,195,225,225,225,241,240,240,120,120,120,56,60,60,28,30,30,14,15,15,15,15,135,135,135,135,195,195,195,225,225,225,225,224,240,240,240,240,112,248,120,120,120,124,56,60,60,28,30,30,14,15,143,135,135,135,135,199,195,195,195,195,225,225,241,240,248,120,120,120,56,60,60,60,28,30,30,30,15,15,143,135,135,135,199,195,195,195,225,225,225,225,240,240,112,112,120,56,56,60,62,28,30,30,14,15,143,166,195,195,227,227,225,225,225,195,195,195,195,195,195,195,195,195,195,195,195,195,131,135,135,135,15,15,15,143,143,135,15,15,15,135,135,143,7,135,15,15,15,135,199,131,135,143,131,195,195,195,195,195,131,195,135,135,135,199,131,135,135,135,227,7,199,131,15,7,199,131,224,7,135,7,135,15,142,15,62,12,31,248,31,60,30,60,120,56,120,60,28,62,240,63,248,31,248,1,124,0,126,48,126,128,127,128,127,248,225,240,243,128,255,131,15,240,127,0,248,7,240,7,224,7,195,7,194,143,192,199,225,193,225,225,224,225,241,224,255,192,199,7,195,7,142,15,248,15,126,128,31,248,3,252,1,248,249,224,31,224,7,248,193,7,248,3,252,224,3,127,128,63,2,224,31,224,127,128,127,0,255,0,252,3,248,7,240,15,224,63,192,127,128,255,0,254,1,252,7,248,15,240,31,192,127,128,255,0,254,1,252,7,240,15,224,31,128,127,0,255,1,254,3,252,15,224,63,192,63,128,255,0,254,7,248,15,158,15,0,15,135,135,131,31,12,62,10,254,224,224,3,60,15,135,135,225,56,30,142,195,227,58,206,225,240,14,62,248,195,241,48,30,240,129,15,120,12,143,240,0,15,127,152,7,63,248,131,15,124,248,195,57,14,243,56,135,7,60,252,225,13,135,60,236,241,142,7,60,240,128,227,28,199,57,206,113,156,227,28,199,29,15,56,252,240,134,227,142,7,28,62,120,224,241,193,7,15,31,60,120,248,224,131,193,7,63,0,62,240,3,240,3,127,192,31,248,1,252,129,127,192,15,252,7,126,192,63,240,3,254,128,31,240,1,248,193,15,128,15,126,0,248,240,3,3,255,31,28,248,255,224,192,63,0,0,254,1,0,252,7,0,254,127,0,224,255,3,128,255,31,0,240,63,0,128,255,128,0,254,3,15,248,15,60,224,31,112,128,255,0,0,254,7,0,252,31,0,240,127,0,192,255,3,0,255,15,0,252,127,0,240,255,0,192,255,3,128,255,15,0,252,63,0,240,255,0,248,255,3,0,253,171,2,126,85,5,170,170,82,85,245,170,170,222,213,29,17,59,177,226,162,15,108,242,193,7,62,248,224,147,93,116,145,205,39,155,237,50,145,110,54,139,68,178,209,38,26,236,102,131,77,54,216,68,131,93,124,145,201,23,155,104,176,139,15,58,248,97,3,31,118,240,65,7,63,124,240,195,14,62,232,224,131,14,126,216,224,135,13,124,208,193,15,31,252,240,193,15,31,248,224,131,15,62,248,225,131,31,62,240,225,3,31,124,240,193,7,63,124,240,195,7,62,124,224,131,15,126,248,224,135,15,124,248,193,7,31,252,240,193,15,31,248,240,131,15,62,248,224,131,31,62,240,225,7,31,124,240,193,7,62,252,224,131,15,62,248,192,131,31,60,248,193,3,31,120,240,131,7,62,120,224,6,15,110,228,228,70,110,110,228,230,70,14,108,236,196,70,110,102,230,99,7,63,248,192,1,28,30,204,240,193,15,30,216,248,129,137,31,15,188,153,128,31,120,240,3,62,224,7,126,224,3,63,4,252,224,7,126,224,3,63,240,3,63,240,3,63,240,129,31,248,129,31,248,129,15,252,192,15,252,192,7,126,192,15,252,192,15,248,131,63,248,129,31,240,1,63,240,3,31,248,129,31,248,129,31,248,1,31,248,193,15,252,129,31,62,56,126,128,255,224,235,15,240,195,3,252,128,31,254,128,31,252,224,3,59,192,7,30,232,63,120,240,131,31,194,135,190,50,152,254,130,15,254,240,7,224,207,6,118,144,15,126,160,230,7,243,193,131,15,31,238,15,30,240,131,63,224,3,63,224,131,31,248,128,15,252,193,15,252,192,7,126,224,3,30,234,14,135,240,195,135,241,184,199,51,232,227,57,135,161,231,120,140,135,194,227,232,243,56,30,135,227,225,120,28,30,142,135,231,224,28,140,142,142,199,195,241,120,28,142,199,227,241,124,156,7,127,224,15,247,129,63,184,15,159,195,227,120,24,15,227,67,124,120,15,254,225,63,248,135,207,240,15,30,224,7,124,128,15,248,1,31,224,3,126,192,7,248,129,63,240,7,127,224,15,254,193,31,248,131,63,240,7,127,224,15,254,192,31,248,129,63,240,3,127,224,15,254,193,31,248,131,63,240,7,127,224,15,254,129,31,248,3,63,240,7,62,224,15,248,224,31,240,193,63,192,135,127,128,191,255,0,252,255,3,248,255,7,224,255,15,128,255,31,0,255,31,0,254,127,0,252,255,0,240,255,1,224,255,3,192,255,7,128,255,31,0,254,63,0,252,127,0,248,255,0,224,255,1,192,255,3,192,255,7,192,255,3,128,255,7,0,255,31,0,252,127,0,240,255,3,192,255,15,0,254,63,0,227,63,128,255,3,128,255,31,0,252,255,0,224,255,15,128,249,63,136,200,123,152,191,1,224,251,13,34,147,207,38,178,91,166,192,38,155,108,54,217,100,147,77,38,155,108,178,217,100,147,205,36,147,205,18,155,108,181,139,198,171,124,248,210,133,15,125,248,208,135,31,252,240,193,15,31,252,240,129,15,31,248,224,131,15,62,248,224,131,31,62,248,225,131,31,62,240,225,3,31,62,240,225,3,31,62,240,225,3,31,62,240,225,3,31,62,240,193,3,31,60,240,193,3,30,188,224,193,11,30,188,224,193,11,30,248,240,129,15,31,248,240,129,15,29,248,208,161,15,61,250,212,35,79,63,240,225,3,31,126,240,225,7,31,124,240,195,7,63,248,224,131,15,62,248,192,135,31,124,80,169,71,47,180,224,133,146,54,92,210,148,151,182,244,224,133,63,124,224,165,13,124,225,133,15,109,240,195,19,190,176,148,167,37,109,105,105,95,90,210,150,55,100,105,9,95,252,128,23,126,72,139,23,172,225,151,182,240,91,3,126,253,128,23,127,192,22,111,72,192,111,95,64,250,15,64,254,15,64,251,11,144,190,37,101,111,9,218,210,150,53,32,253,11,192,254,6,192,127,1,160,255,0,128,255,0,249,255,1,127,224,3,190,101,79,0,208,63,128,61,12,224,127,0,248,127,0,248,127,0,240,255,0,224,255,1,240,255,1,224,255,1,192,255,3,192,255,7,128,255,7,0,255,15,0,255,31,0,254,63,0,248,127,0,240,255,1,224,255,3,128,255,7,0,255,31,0,252,63,0,248,255,2,224,127,1,248,255,0,224,255,7,0,254,127,0,240,255,7,0,254,127,0,128,255,127,0,0,255,127,0,192,255,31,0,252,127,0,240,127,0,254,31,0,254,63,0,248,31,0,252,127,0,224,255,7,0,254,255,132,109,9,64,255,63,0,224,255,1,105,223,3,128,255,15,0,192,255,15,0,224,255,15,0,248,255,31,0,224,255,15,0,244,255,95,72,74,182,150,0,72,215,90,107,165,84,106,173,87,2,168,253,75,8,228,95,247,22,105,201,158,32,45,216,146,45,73,219,183,109,65,31,228,15,248,3,254,128,31,240,3,126,192,31,248,1,127,192,15,248,3,126,224,15,248,131,63,192,31,252,1,127,208,7,252,193,31,224,15,255,0,63,248,3,252,224,31,224,129,127,128,7,254,1,30,248,7,248,192,63,224,3,255,0,15,248,3,124,224,31,224,129,127,128,7,252,3,62,240,15,248,128,63,192,3,254,1,31,248,7,120,224,31,224,129,127,128,7,254,1,24,244,15,64,210,63,0,73,255,0,36,253,3,144,237,79,128,182,63,1,218,254,37,73,219,150,36,109,219,146,164,109,75,146,182,13,72,246,39,0,249,159,0,224,255,3,128,255,7,0,254,31,0,248,127,0,224,255,0,128,255,19,0,254,75,2,252,47,9,240,191,44,192,255,176,0,255,131,3,248,15,15,240,63,60,192,31,252,0,127,240,1,252,224,7,248,129,31,240,3,127,192,15,252,0,31,248,3,126,224,15,248,129,63,240,7,126,192,15,252,1,63,240,7,252,192,31,248,3,63,224,7,254,192,31,248,3,127,224,15,252,129,63,240,7,126,192,15,252,128,31,248,1,63,240,3,127,224,7,252,192,31,248,1,63,224,7,254,192,31,248,3,127,224,15,252,129,63,240,7,254,192,31,248,3,127,224,15,252,129,63,240,7,254,128,15,248,3,62,224,31,240,1,127,192,7,252,3,30,224,31,112,128,127,0,192,255,199,0,254,113,6,240,157,7,248,199,57,192,127,156,1,62,195,1,254,113,14,240,15,62,192,127,224,0,254,3,30,224,31,224,1,254,129,31,240,15,248,1,255,192,31,224,31,196,1,254,97,60,228,27,198,195,158,97,60,252,24,230,193,143,225,30,252,56,252,225,143,195,31,254,56,252,225,135,195,31,126,60,252,225,227,195,31,254,31,252,224,254,193,31,238,19,252,224,63,224,7,252,7,126,192,127,224,15,248,7,254,128,63,224,15,248,3,254,128,63,224,15,252,3,126,192,31,240,3,254,1,31,240,15,240,129,127,128,15,248,7,248,128,127,192,15,252,3,124,192,63,192,7,252,3,124,224,63,192,3,254,1,30,240,31,96,128,255,0,3,252,15,0,192,127,0,0,254,7,0,224,127,0,0,255,7,0,252,127,0,240,255,7,128,255,31,0,248,255,0,240,255,7,0,255,63,0,248,255,1,192,255,15,0,252,255,0,192,255,15,0,252,255,1,128,255,63,0,240,255,3,0,254,127,0,192,255,31,0,252,255,3,0,255,95,0,224,255,5,0,255,191,2,128,255,182,64,168,165,214,22,138,240,95,8,128,253,143,0,254,255,5,160,255,31,0,252,255,0,208,255,15,0,244,127,0,128,255,11,0,248,127,1,64,255,90,134,244,205,166,77,178,100,91,165,84,42,149,106,181,90,173,82,169,84,42,181,90,169,84,43,85,170,181,90,149,74,181,74,169,86,40,149,90,173,86,42,149,90,165,82,171,212,106,149,90,173,82,169,85,42,181,74,181,94,161,214,43,212,250,5,218,189,64,249,22,40,255,2,245,90,177,94,1,214,43,64,123,5,104,63,128,239,0,248,31,0,255,3,224,127,0,252,15,128,255,1,240,63,0,254,7,192,255,0,248,31,0,255,3,224,127,0,252,15,128,255,1,240,31,0,254,3,192,127,0,252,31,128,255,3,240,127,0,254,15,192,255,1,248,63,0,255,7,224,255,0,252,15,128,255,1,240,63,0,254,7,192,255,0,248,31,0,255,3,240,127,0,254,15,192,255,1,248,63,0,255,3,224,127,0,252,15,192,255,1,248,63,0,255,7,224,255,0,254,31,128,255,1,248,63,0,255,7,224,127,0,254,15,192,255,1,248,31,0,255,3,224,63,0,252,35,128,127,4,248,207,0,255,24,224,159,3,252,57,192,63,71,248,99,136,115,142,112,199,17,239,28,225,204,35,142,56,194,153,71,28,242,128,99,14,56,236,129,199,31,120,248,195,135,63,252,240,195,15,62,252,224,135,31,124,248,195,14,63,140,241,199,16,254,24,194,31,67,248,103,8,255,8,225,159,65,252,3,128,127,0,240,15,0,254,3,192,127,0,252,15,0,255,1,224,63,0,254,7,192,255,0,240,63,0,254,1,224,127,0,252,31,128,255,3,240,63,0,254,15,192,255,1,248,63,0,255,7,192,255,0,248,63,0,255,7,224,255,0,252,31,128,255,3,240,127,0,254,15,128,255,1,240,63,0,254,15,128,255,3,208,191,0,255,5,224,63,0,252,31,128,127,225,0,254,128,127,192,15,252,3,254,0,31,240,15,240,31,62,240,135,241,249,25,30,255,129,63,224,15,252,1,127,192,15,248,3,254,128,63,224,15,248,3,254,128,63,224,15,248,1,127,128,63,240,15,192,255,255,0,63,248,7,252,129,63,224,15,252,1,126,192,31,224,7,252,3,248,128,127,128,15,252,3,120,224,63,192,1,254,3,0,224,255,0,0,252,63,0,192,255,7,0,252,255,3,224,255,127,0,254,255,3,0,240,31,0,128,255,255,1,248,255,31,0,192,255,0,0,252,223,15,224,255,255,0,254,254,7,0,192,127,0,0,252,111,3,144,253,127,1,1,252,247,23,192,110,127,1,0,244,63,0,128,254,63,1,224,255,27,0,252,255,9,192,54,219,0,124,243,31,192,55,255,1,118,241,31,224,129,111,102,179,85,173,154,217,108,54,155,201,166,155,205,54,153,13,38,131,225,114,120,60,153,14,179,217,100,178,217,38,147,205,102,155,76,54,155,108,178,217,100,178,201,102,147,201,38,155,76,54,217,108,50,153,100,131,217,124,184,207,199,243,120,60,143,143,231,240,56,14,15,227,224,97,28,30,198,193,195,58,124,104,131,135,125,248,240,6,15,218,240,97,29,30,188,225,195,50,60,24,134,135,227,248,56,28,15,135,227,241,120,60,30,207,195,225,121,60,60,143,135,227,241,112,60,30,14,199,195,225,120,56,28,15,135,227,225,113,60,28,54,15,147,228,233,178,45,218,36,73,150,108,217,36,73,182,73,195,103,249,240,124,30,62,159,134,195,103,211,96,153,60,216,134,15,110,195,195,227,241,224,176,13,60,158,15,30,62,30,60,124,240,5,143,192,135,15,31,15,31,62,248,128,15,14,15,62,60,124,248,240,240,225,225,195,131,135,15,31,62,124,248,240,224,193,131,7,15,30,60,124,248,193,15,216,15,252,224,231,193,7,62,28,124,240,193,224,131,143,15,30,60,248,0,254,129,63,224,15,252,7,252,3,240,23,252,15,248,3,252,128,127,128,31,248,7,248,1,127,0,63,240,7,248,129,63,128,31,248,3,255,128,127,62,0,126,254,1,192,255,127,0,252,255,31,192,255,127,0,252,239,63,96,208,255,9,128,36,223,178,96,218,46,75,146,101,217,54,77,147,100,91,30,5,224,251,44,0,203,231,97,48,60,159,7,65,242,124,9,182,207,247,65,0,240,63,30,6,3,232,247,25,32,30,108,159,101,210,54,56,252,31,130,7,193,242,63,120,62,15,65,219,228,109,218,166,159,64,242,219,36,8,219,230,251,0,248,63,64,246,39,240,31,128,255,109,160,255,128,249,58,44,158,199,225,120,24,239,199,25,115,140,57,199,241,248,28,99,199,225,56,58,198,137,113,204,49,227,192,229,216,49,115,142,227,113,28,143,227,97,140,135,227,112,28,243,227,120,60,14,206,57,60,103,60,60,142,227,1,248,14,62,128,15,240,3,252,0,62,192,7,248,1,254,128,31,240,7,252,128,63,224,7,254,3,126,96,126,224,7,224,7,15,6,62,248,120,240,131,231,135,15,62,120,248,240,225,131,15,14,31,124,240,225,224,131,15,31,30,62,248,224,195,195,7,31,124,120,124,240,193,7,223,7,31,248,224,127,240,3,63,240,7,62,240,3,127,240,3,63,240,3,127,240,3,31,60,132,199,231,241,16,60,28,134,7,227,225,121,60,12,134,199,243,96,48,60,30,143,135,193,240,249,54,9,38,249,247,9,48,200,255,159,0,96,248,255,61,0,128,255,127,0,0,254,255,7,0,240,255,255,0,64,255,255,1,0,252,255,15,0,0,255,63,0,0,252,63,124,0,240,15,254,1,240,7,254,3,252,1,254,3,254,0,255,128,127,0,63,224,255,128,15,248,103,216,7,236,19,254,1,254,0,255,0,63,192,127,192,15,240,15,252,3,254,1,254,0,127,128,127,192,63,192,31,224,31,240,15,240,7,248,7,252,3,252,1,254,1,255,0,127,128,127,192,63,192,31,224,31,224,15,248,7,248,3,254,1,254,0,255,128,127,192,63,192,31,224,31,192,15,248,15,224,3,254,7,240,1,255,1,60,192,127,128,31,224,63,192,31,224,31,224,15,240,15,248,7,240,7,254,3,240,135,255,3,224,255,255,1,224,255,255,1,224,255,255,0,240,255,127,0,248,255,127,0,252,255,63,0,255,195,63,128,255,192,63,192,63,192,255,0,0,240,255,1,0,248,255,0,0,255,63,0,192,255,31,0,240,255,15,0,252,255,3,0,255,255,1,128,255,127,0,0,255,63,0,128,255,127,0,128,255,127,0,192,255,15,0,184,255,230,128,241,207,15,8,126,252,192,224,199,15,12,62,126,224,240,224,135,7,7,63,60,120,240,227,129,7,31,30,56,240,225,249,131,15,223,31,248,112,254,128,135,231,3,120,56,62,192,135,227,3,60,56,30,192,131,227,65,60,56,30,140,131,243,193,60,248,31,204,131,255,193,60,248,31,252,131,255,129,63,240,31,248,1,255,128,31,240,15,248,1,255,128,31,240,15,248,129,127,128,31,248,7,248,129,127,128,31,248,7,248,193,127,128,31,252,7,248,193,127,128,31,252,7,248,195,127,128,63,252,3,252,227,63,192,191,255,1,252,255,31,0,255,255,1,248,255,15,0,255,255,0,240,255,15,0,255,255,1,240,255,31,128,255,255,1,248,255,15,0,247,255,0,120,252,31,0,240,255,0,192,255,15,0,248,127,1,112,248,127,240,112,248,240,112,240,225,241,225,193,239,195,129,111,251,0,14,252,8,14,60,206,113,28,246,112,14,115,56,135,59,156,195,57,158,225,28,206,241,14,255,112,135,127,248,131,63,252,129,15,252,192,7,126,224,3,63,240,129,31,246,192,31,122,192,15,120,224,15,60,224,7,62,240,3,30,240,3,31,248,129,15,248,224,7,252,176,7,124,152,7,126,204,15,62,204,15,62,198,7,31,227,7,31,227,131,15,241,131,143,241,129,143,248,193,205,252,192,79,124,224,6,126,98,7,63,241,3,31,177,129,159,216,129,207,252,192,103,108,224,39,118,240,51,59,240,25,31,248,140,29,252,198,14,126,102,7,63,163,3,159,209,129,205,232,192,102,244,96,51,114,176,25,57,216,140,28,108,6,14,54,3,7,155,193,131,205,224,193,126,240,96,63,120,176,31,60,248,15,30,188,7,15,158,131,3,207,193,129,231,224,192,115,112,224,57,56,240,29,60,248,140,28,124,70,14,60,3,7,190,163,3,223,209,3,207,200,129,111,232,192,119,116,224,51,122,224,27,58,240,29,29,248,140,30,248,198,14,124,71,7,62,35,7,191,145,147,155,217,137,205,232,196,102,228,98,55,114,176,59,56,216,29,28,232,14,30,116,7,31,58,131,15,157,193,141,204,196,70,102,98,35,51,179,145,153,217,200,204,76,100,102,102,54,51,51,155,153,153,205,204,204,70,102,102,35,51,177,153,153,216,200,204,236,100,102,118,112,51,59,184,153,29,248,200,15,252,196,7,15,195,135,135,195,131,135,195,193,195,225,225,225,240,240,56,120,56,60,60,60,28,30,30,30,30,31,15,143,143,135,135,199,195,195,195,195,195,195,193,193,217,216,200,252,236,108,124,124,52,62,56,56,59,56,152,29,28,156,14,30,204,15,14,206,135,7,199,195,131,195,193,193,193,225,225,225,224,225,225,240,240,113,240,240,153,217,248,152,142,113,28,143,163,49,57,30,199,227,120,28,199,96,14,231,113,28,142,137,135,241,56,142,195,193,121,156,227,56,142,227,56,198,99,28,227,112,140,241,56,198,121,28,227,28,142,115,28,199,49,142,199,24,199,113,156,199,113,198,227,56,198,195,30,241,32,31,126,128,7,254,192,7,62,136,3,127,224,3,63,224,135,15,240,193,15,120,224,15,56,240,7,56,248,7,0,251,3,128,252,25,0,254,14,193,249,14,132,121,14,0,253,15,0,255,63,0,254,63,0,255,62,0,255,15,0,255,47,192,255,31,192,239,31,192,255,63,0,227,127,160,128,111,252,144,1,242,252,25,18,242,79,14,240,60,15,226,12,159,131,33,199,199,241,131,227,241,229,195,225,120,225,97,184,28,45,60,31,14,14,159,15,7,199,7,199,195,199,227,225,227,240,224,241,112,120,56,56,60,28,28,30,30,14,14,15,7,7,135,131,131,131,131,145,193,217,201,225,224,224,224,96,124,126,112,60,60,50,62,30,31,62,30,31,15,135,143,15,6,15,238,224,7,119,179,27,153,153,137,31,200,131,15,102,34,51,51,145,139,157,216,193,95,236,192,47,126,224,31,60,248,15,30,236,7,15,228,3,63,240,129,31,248,192,7,124,240,129,63,248,192,31,124,224,11,124,240,13,62,248,6,31,108,2,15,118,131,15,190,193,7,159,224,131,79,228,131,79,242,193,39,243,225,163,249,224,241,120,240,248,120,120,124,60,60,60,30,30,30,15,14,15,15,135,135,135,131,195,195,195,225,225,225,240,240,112,120,120,120,60,60,60,30,30,30,15,15,15,15,15,135,135,135,135,135,135,135,135,135,135,135,135,135,135,135,195,195,131,195,195,131,195,195,195,195,195,195,195,195,195,195,195,195,195,195,195,195,195,195,195,195,195,195,195,195,195,195,195,227,195,195,227,193,195,225,225,195,225,225,193,225,225,225,225,225,225,240,225,225,240,240,224,240,240,240,240,240,240,248,240,112,248,112,112,120,120,112,120,120,120,120,120,120,124,120,56,124,120,56,124,120,0,254,240,0,254,224,0,255,224,128,255,241,128,255,243,128,255,251,0,255,239,1,247,199,3,231,7,3,254,7,0,254,3,0,252,3,224,253,15,128,255,15,0,255,7,0,255,7,130,255,3,130,255,7,0,255,15,0,255,31,0,191,15,2,255,7,0,255,63,0,248,255,1,128,255,15,192,63,255,0,254,131,6,240,63,0,128,255,1,0,254,31,0,252,31,0,192,255,3,240,255,15,0,255,31,0,240,127,0,0,248,63,0,32,254,15,0,252,255,0,240,255,31,0,252,255,0,0,255,63,0,192,255,31,0,240,255,7,0,248,255,1,0,254,127,0,128,255,63,0,224,255,31,0,240,255,31,0,248,255,15,0,252,255,1,0,254,255,0,0,255,63,0,248,255,1,0,254,127,0,0,255,255,0,0,255,255,3,0,248,255,15,0,128,255,255,3,0,200,255,31,0,0,255,31,3,2,159,15,14,158,31,15,0,158,255,15,4,142,31,15,135,255,15,7,132,255,31,6,14,159,15,15,15,31,15,2,207,159,7,130,135,191,135,6,142,135,7,131,143,15,2,192,255,207,3,128,225,255,163,37,33,165,173,5,45,237,47,169,45,97,105,109,171,225,33,249,104,57,40,52,252,54,144,44,252,187,36,32,237,54,137,0,239,163,39,131,194,182,109,19,154,36,217,76,62,12,60,30,30,14,31,14,31,31,15,31,15,15,159,12,46,155,108,146,76,54,56,108,58,60,62,120,56,120,120,120,56,120,120,120,120,248,120,120,248,248,112,240,240,240,240,240,112,248,112,248,248,120,248,248,240,240,240,240,240,240,120,120,240,240,104,57,56,108,186,108,44,105,41,45,108,45,91,216,108,48,9,62,60,63,153,28,46,31,30,31,158,12,78,46,13,155,200,108,182,77,50,159,45,139,11,15,143,143,134,37,15,135,22,15,15,134,30,15,7,15,15,15,135,7,47,15,135,39,158,135,167,189,54,135,230,102,188,28,15,241,146,78,146,182,207,195,224,120,28,14,199,227,241,24,222,193,115,120,15,242,65,250,104,94,240,105,242,96,120,62,140,162,225,225,51,240,144,254,192,3,248,3,126,192,159,224,3,254,3,31,192,47,224,3,254,3,253,129,63,224,31,224,3,255,3,0,224,63,0,142,255,3,224,255,31,0,63,203,67,240,0,248,63,4,192,255,0,0,254,15,0,174,255,192,254,0,255,159,0,224,255,3,0,255,255,2,0,254,255,3,128,232,255,0,0,255,255,1,192,255,47,0,248,255,15,0,255,255,0,0,255,255,0,160,255,143,7,192,255,128,135,193,15,248,7,213,131,250,80,31,143,143,227,113,156,195,138,135,135,63,140,231,113,28,142,195,115,248,48,15,199,1,142,7,60,30,248,224,57,158,99,120,112,120,240,193,227,12,231,120,240,112,240,225,195,225,195,199,193,7,60,252,112,60,120,120,112,120,120,120,120,120,120,120,120,120,240,120,120,120,112,120,120,120,112,56,120,120,120,60,120,120,56,60,120,124,56,60,60,60,60,30,60,60,60,30,60,60,60,30,60,60,28,30,28,60,28,30,30,60,28,30,60,60,60,30,60,60,60,62,60,124,60,60,60,120,120,30,60,120,224,31,62,248,224,3,63,248,224,3,63,248,224,131,31,248,224,131,15,252,224,131,15,124,224,131,15,126,240,131,15,62,240,193,7,62,248,193,15,62,248,193,7,31,124,224,135,15,124,240,129,31,62,112,6,143,252,240,49,120,124,112,14,15,31,248,225,195,7,126,248,248,137,31,31,103,227,226,204,124,56,152,3,15,14,240,240,135,11,60,254,225,134,143,127,184,225,225,27,126,120,56,135,31,30,206,225,193,135,113,56,252,97,28,14,119,24,135,227,29,198,225,248,135,113,56,246,97,28,206,60,24,7,143,7,204,199,241,140,227,56,142,227,56,199,113,28,231,56,142,113,28,199,57,142,115,28,199,113,28,231,56,142,99,28,199,56,198,113,140,115,156,199,28,103,54,227,57,154,27,207,225,252,56,142,231,99,48,24,143,193,96,116,30,155,139,225,112,60,142,195,241,56,30,199,227,56,28,199,241,28,142,195,121,24,7,243,145,12,230,135,179,128,143,207,103,178,249,13,14,230,99,49,24,142,198,227,49,28,14,135,195,225,60,30,135,195,113,56,14,199,195,224,60,62,131,193,224,38,62,155,143,249,240,193,136,221,3,131,255,1,240,124,31,192,255,192,248,95,64,248,63,0,252,57,48,254,12,248,255,0,248,255,1,254,191,1,255,31,0,255,7,128,255,7,192,255,3,224,31,3,240,15,0,248,7,0,255,7,128,255,3,192,255,1,224,255,0,224,127,0,248,63,0,252,31,0,254,15,0,254,3,192,255,3,192,255,3,192,255,1,224,127,0,248,31,0,252,31,0,252,31,0,254,15,0,255,1,192,255,0,240,127,0,248,63,0,252,31,0,254,15,0,255,7,192,255,3,224,255,1,240,255,0,248,127,0,248,127,0,240,255,3,192,255,3,192,255,3,192,255,3,192,255,7,128,255,7,0,255,255,15,0,254,31,0,254,63,0,252,127,0,224,255,1,0,248,255,1,224,255,97,96,248,113,240,249,64,240,249,32,240,243,97,240,251,193,224,241,225,225,199,67,224,240,225,193,225,113,56,252,225,224,243,3,135,143,7,135,183,161,240,249,3,7,31,62,30,170,198,7,13,237,235,112,147,171,42,85,85,171,170,18,85,52,137,110,50,149,109,178,201,54,201,36,155,100,147,109,178,77,182,73,54,217,38,219,36,155,100,155,108,147,77,178,201,54,217,178,201,54,217,100,159,108,162,95,52,208,47,26,232,23,15,228,135,7,252,131,131,246,193,225,255,64,240,127,0,248,63,0,252,31,0,254,15,0,255,7,128,255,3,224,255,1,240,127,0,252,63,0,254,31,0,255,15,0,255,15,0,255,7,0,255,7,192,255,7,192,255,7,0,255,3,0,252,127,0,128,255,3,0,254,15,0,254,63,0,254,127,0,248,255,1,224,255,1,128,255,7,0,248,223,4,96,255,9,0,252,63,32,208,255,0,248,116,155,236,1,248,127,27,192,254,71,0,248,223,0,18,250,31,64,36,255,15,0,240,127,1,128,252,31,0,153,255,39,0,224,255,2,128,251,63,0,216,118,95,1,162,218,95,160,106,223,46,16,237,119,155,108,22,137,38,155,93,54,205,110,187,78,165,92,164,218,44,82,105,18,173,18,169,86,137,86,171,84,171,83,171,213,165,87,232,210,47,124,161,23,188,208,171,94,168,84,175,84,171,87,168,208,15,92,248,7,46,252,3,22,254,64,139,127,160,197,63,80,224,95,40,240,47,20,248,23,40,252,11,20,254,5,10,255,2,133,127,128,194,63,0,241,15,128,250,7,64,253,67,168,254,43,84,255,129,106,191,64,165,95,160,210,47,16,232,23,8,244,3,4,254,129,2,255,64,161,127,32,209,127,128,200,63,64,224,31,32,240,15,16,248,7,24,253,3,141,254,129,68,255,65,170,253,32,149,126,160,74,63,208,228,31,104,242,15,52,250,7,26,252,3,29,254,129,14,255,64,131,127,160,131,127,144,193,63,200,224,31,108,240,7,4,252,3,2,254,0,1,127,128,128,127,0,192,63,0,224,15,8,240,7,4,252,3,6,254,1,3,255,192,129,127,224,192,63,112,224,31,56,240,7,28,248,3,15,252,129,7,254,192,3,127,224,129,31,240,192,15,124,224,7,62,240,3,30,248,1,15,252,128,7,126,128,3,127,128,195,15,128,225,7,0,241,7,0,254,7,0,254,3,0,255,3,128,255,3,1,255,131,15,240,3,31,224,7,127,224,0,252,255,0,235,255,3,248,255,15,224,127,0,0,255,1,2,254,3,0,255,1,60,248,15,192,240,31,128,195,127,0,255,63,0,255,255,0,240,63,0,224,255,3,0,255,15,224,255,15,0,255,255,0,248,63,0,240,255,3,192,255,0,128,255,7,192,255,251,1,240,63,128,63,192,63,0,255,1,127,0,254,3,248,7,248,31,192,63,192,63,128,255,0,252,3,248,7,224,63,192,127,0,255,3,126,0,255,3,240,15,224,255,0,248,31,192,63,128,255,1,28,128,255,1,248,7,240,63,0,128,255,7,224,127,0,255,7,0,192,255,0,254,7,224,31,254,7,192,255,195,31,0,252,255,127,0,224,255,255,0,128,255,7,252,1,240,255,225,7,128,255,7,0,224,255,0,252,15,224,127,0,224,255,15,0,127,128,255,1,255,7,0,240,255,7,0,11,128,255,191,253,255,0,0,254,255,3,0,128,190,254,255,187,44,0,128,254,255,47,0,0,251,255,255,3,0,144,34,255,111,75,2,73,218,246,255,182,9,0,237,219,146,182,191,36,0,128,182,255,19,128,148,182,191,5,64,218,182,22,146,182,191,165,0,90,107,183,148,146,164,111,107,41,18,218,75,250,147,174,36,41,173,236,47,128,45,73,251,2,108,203,178,37,104,219,128,182,36,219,38,203,182,202,166,75,104,169,164,47,43,2,254,254,254,32,172,15,248,31,160,47,128,255,2,254,238,55,0,222,148,250,55,248,147,182,15,202,159,32,11,88,55,232,158,214,134,176,190,164,125,162,72,146,110,130,109,161,153,164,73,182,218,38,176,108,187,38,162,164,146,237,146,164,37,105,90,146,173,150,38,178,44,217,110,178,237,102,203,178,108,154,36,50,219,100,147,76,106,219,182,37,73,162,36,105,75,146,36,73,146,182,37,73,218,182,152,36,157,46,105,207,146,196,154,41,35,204,188,73,154,205,153,217,218,236,52,102,102,45,51,51,243,155,201,152,39,98,102,139,179,35,179,153,137,204,103,54,176,155,204,108,126,50,19,249,7,36,164,31,128,176,255,0,255,255,0,248,255,6,160,255,11,192,254,63,0,253,127,2,244,47,2,240,191,64,74,191,1,248,191,130,160,255,130,210,191,3,161,190,129,162,126,17,32,255,151,0,248,118,1,137,246,27,161,232,183,51,201,198,236,204,0,236,182,109,130,108,187,105,130,221,158,68,230,153,187,1,10,187,231,1,56,248,73,11,250,248,225,161,109,191,97,75,218,224,207,152,51,103,204,25,115,98,200,113,199,140,25,51,126,252,184,115,198,129,7,206,140,31,248,131,7,142,15,31,60,226,135,135,15,15,31,15,126,120,120,240,224,225,225,195,195,195,195,135,135,135,135,135,227,225,193,241,240,56,60,62,60,120,192,135,15,62,248,224,131,15,15,207,224,225,193,135,15,62,120,240,225,131,15,31,62,248,240,225,131,199,135,15,15,31,62,248,120,240,131,63,128,31,252,129,127,192,15,254,0,63,224,7,254,1,31,240,31,248,0,254,225,15,0,128,255,255,1,252,128,31,248,15,0,192,255,15,0,254,127,0,248,31,0,240,63,0,128,255,0,20,254,3,128,255,127,0,128,255,15,0,240,255,3,0,255,63,0,240,255,3,0,254,255,0,224,255,31,0,240,255,3,128,254,63,0,164,255,15,0,250,127,0,48,252,63,0,248,255,12,10,223,224,208,254,7,66,254,30,4,196,255,61,92,44,176,207,125,52,192,201,62,248,3,15,252,159,31,128,255,62,130,14,124,73,62,248,101,120,240,248,224,131,227,225,243,240,129,195,135,135,15,15,31,30,30,62,60,60,120,248,240,224,224,227,225,193,239,224,193,227,131,135,159,7,14,255,7,0,255,31,0,248,255,0,224,255,3,128,255,15,0,252,63,0,224,255,3,192,255,15,0,254,127,0,192,255,3,0,255,63,0,240,255,15,0,252,255,0,224,255,3,224,255,3,192,255,15,0,254,127,0,224,255,7,0,252,255,15,0,128,255,255,0,224,255,7,128,255,15,0,252,63,0,240,255,0,248,255,0,240,255,3,192,255,47,0,204,131,227,63,2,224,255,9,0,255,199,48,158,99,192,113,28,14,143,227,112,56,30,135,199,113,28,62,142,227,224,113,28,135,199,241,60,56,142,227,192,113,156,3,207,241,28,56,142,115,224,57,222,1,207,240,15,56,135,63,224,29,254,1,127,240,7,252,131,31,224,15,254,128,63,240,3,254,193,15,240,7,127,192,31,248,3,126,192,15,248,3,127,192,15,248,3,127,192,31,248,3,254,128,63,224,15,248,3,252,1,254,128,63,192,31,240,3,252,1,63,224,31,248,1,127,224,15,248,3,127,192,31,240,3,254,128,63,224,31,240,1,254,1,63,192,63,192,3,252,3,126,192,127,192,3,252,7,16,224,63,0,128,255,31,0,196,255,0,0,254,15,0,240,127,0,0,254,227,7,224,255,127,0,63,252,3,56,224,31,240,0,127,240,7,248,129,127,192,3,252,131,63,224,31,252,0,127,240,7,248,129,63,224,3,254,0,15,248,135,110,200,19,190,41,45,180,165,244,210,86,122,75,107,161,165,180,148,150,210,66,45,101,171,151,242,133,94,224,7,250,129,47,248,3,190,224,15,248,129,63,224,7,254,192,31,240,3,63,224,7,248,128,63,232,7,252,64,31,240,7,127,128,31,232,3,254,128,31,240,7,252,192,31,240,7,254,192,31,240,3,126,192,15,248,3,127,224,15,248,129,63,224,7,254,128,31,240,3,126,192,15,248,3,63,224,15,252,128,63,240,3,254,192,15,248,3,63,224,15,252,128,63,240,3,254,192,15,252,3,63,248,15,252,224,63,240,129,255,192,7,255,3,31,84,15,252,95,116,240,127,195,1,251,5,31,232,19,124,192,15,240,0,63,224,3,126,128,15,248,1,62,224,7,124,128,15,240,1,63,224,7,252,128,15,248,1,62,224,7,252,128,31,240,1,127,192,7,252,128,31,248,3,62,224,7,252,192,31,240,3,127,224,7,254,128,31,248,3,127,224,15,252,129,63,248,3,252,224,15,240,131,63,192,7,190,0,31,252,62,124,240,249,224,193,231,131,7,143,15,30,60,60,120,120,240,224,225,193,135,199,7,31,30,31,124,56,124,240,241,240,129,231,195,15,158,15,62,248,31,248,64,126,224,3,253,129,15,240,7,62,192,31,248,0,63,224,3,252,192,15,248,3,63,224,7,252,128,31,240,3,127,192,7,252,128,31,240,3,126,192,15,248,1,63,224,3,252,192,15,240,131,31,192,7,62,28,30,124,240,248,240,193,195,195,7,15,15,30,124,56,120,240,225,225,195,135,135,15,30,60,60,120,240,240,224,195,195,135,15,15,30,62,124,120,240,224,225,195,131,135,15,31,30,60,124,120,240,224,225,195,131,135,15,15,30,60,124,120,240,240,225,193,195,135,15,15,31,62,60,120,248,240,224,225,195,131,135,15,15,30,62,60,120,248,240,224,225,195,131,135,15,15,31,30,60,124,120,240,240,224,225,195,131,135,15,14,30,62,60,120,248,240,224,225,195,195,195,7,15,15,31,30,60,124,120,240,240,225,193,195,135,7,15,15,30,60,60,120,240,240,224,195,195,135,15,30,30,62,248,112,240,193,195,193,7,31,134,31,124,0,62,240,1,248,192,199,224,7,31,7,31,60,30,124,248,248,240,224,225,193,131,135,7,15,31,62,60,124,248,240,240,225,195,195,135,15,15,31,62,60,120,120,240,224,225,195,195,135,15,15,31,30,60,124,120,240,240,240,193,195,195,135,15,15,31,62,28,124,120,112,240,225,225,193,135,135,7,31,30,30,124,120,120,240,225,225,193,135,135,15,31,62,60,120,248,240,225,193,195,135,15,15,31,60,120,120,240,225,227,193,7,62,3,31,248,12,126,224,31,248,193,111,224,7,31,7,31,124,56,124,240,225,225,195,135,15,15,30,60,124,248,240,224,225,195,131,7,15,31,14,46,62,36,139,182,77,31,14,31,60,120,120,240,225,226,195,131,15,159,108,186,120,112,224,193,100,219,108,7,139,108,54,93,54,155,236,178,217,100,147,205,38,155,108,54,201,102,155,76,54,201,100,179,73,54,155,69,178,217,44,146,205,102,176,28,108,131,229,224,27,12,7,215,97,56,184,13,135,193,109,58,12,108,243,233,102,155,13,54,219,120,176,217,199,131,77,62,62,108,240,240,225,131,7,15,62,124,248,240,193,131,7,31,62,124,240,225,193,131,31,30,62,248,225,224,131,31,4,63,248,11,240,193,255,129,31,60,31,248,193,243,128,31,252,1,254,193,15,240,15,252,0,254,128,63,224,7,240,3,255,3,63,128,31,248,24,248,224,241,193,131,135,7,15,30,62,60,120,240,240,225,193,195,135,7,15,30,30,60,56,248,240,240,193,195,131,15,15,31,28,62,120,124,248,240,224,195,195,7,31,15,62,12,124,240,255,128,255,224,255,128,15,224,31,224,63,248,51,240,51,248,1,240,3,252,1,252,131,255,192,243,193,251,224,227,225,125,240,225,225,51,240,193,195,3,248,193,195,1,248,224,3,28,124,224,7,30,62,240,3,15,31,240,131,143,31,248,129,135,15,252,192,227,7,124,192,255,3,126,224,63,14,62,224,31,15,30,224,15,15,0,248,255,15,0,248,255,3,0,254,255,7,0,255,255,7,128,255,255,1,192,255,255,0,240,255,127,0,240,255,31,0,240,255,15,0,248,255,15,0,240,255,7,0,192,255,7,0,192,255,63,0,192,255,127,0,128,255,255,0,192,255,255,0,192,255,63,0,224,255,35,0,254,255,1,0,252,255,0,0,248,255,3,0,240,255,7,0,240,255,15,0,252,255,1,0,252,31,6,28,124,126,0,240,241,193,131,135,15,31,30,60,120,224,129,7,31,71,156,48,220,112,228,56,119,120,120,224,177,199,143,7,15,63,230,240,224,225,97,124,120,112,56,60,60,120,14,31,30,252,224,131,7,127,240,224,193,19,124,120,240,1,31,30,248,193,135,15,254,224,225,3,63,248,240,192,31,124,60,240,7,158,15,252,129,239,3,255,192,255,129,63,224,127,224,15,240,31,240,7,252,7,252,1,254,1,127,128,127,128,63,224,63,224,15,240,15,240,7,252,3,252,3,254,1,254,0,127,128,127,192,63,192,31,240,31,224,15,248,7,240,3,254,3,248,129,255,0,254,192,127,0,127,224,31,128,63,248,7,224,15,254,3,240,15,255,0,252,159,127,0,254,243,31,128,255,255,7,192,255,255,0,240,255,127,0,240,255,31,0,252,255,15,0,252,255,3,128,255,255,3,128,255,127,0,240,255,63,0,248,255,7,0,254,255,1,0,255,126,0,192,255,63,0,224,255,15,1,240,253,28,14,222,227,243,48,60,158,135,195,195,120,60,28,143,227,224,215,135,99,24,30,143,227,225,120,60,14,135,231,241,56,14,199,195,115,60,120,135,15,248,225,30,144,15,94,240,28,63,60,240,11,15,124,192,7,15,252,192,131,31,248,193,7,63,240,3,31,252,192,15,124,240,3,63,248,193,7,126,224,255,3,254,1,252,7,248,7,224,15,240,31,192,63,192,127,128,255,0,255,1,252,3,252,15,240,15,224,63,192,63,0,255,1,254,7,224,63,224,63,0,254,7,255,0,248,127,252,3,224,255,249,31,0,255,195,255,0,240,223,255,7,128,255,254,63,0,200,255,255,1,0,252,255,15,0,224,255,127,0,0,254,255,1,0,248,255,31,0,192,255,127,0,0,255,255,3,0,252,255,15,0,240,255,127,0,192,255,255,0,128,255,127,0,0,254,255,0,0,248,255,7,0,224,255,63,0,0,255,255,0,192,120,254,99,0,198,243,31,67,56,158,255,24,192,241,220,227,8,135,31,30,63,56,252,248,112,224,224,195,227,24,135,63,158,113,16,246,240,199,3,129,135,15,15,14,30,62,62,24,124,120,248,112,240,225,225,227,193,135,131,255,7,31,7,252,31,252,7,224,127,224,63,0,255,129,255,1,248,7,254,7,224,31,240,31,0,127,224,255,0,240,3,255,7,0,14,254,63,0,0,252,255,1,0,240,255,15,0,192,255,127,0,0,255,255,3,0,248,255,15,0,224,255,63,0,0,255,255,0,0,254,255,1,0,252,255,7,0,240,255,31,0,128,255,127,0,0,254,255,3,0,248,255,15,0,224,255,127,0,0,255,255,1,0,252,255,15,0,224,255,255,0,0,255,255,7,0,248,255,127,0,128,255,255,3,0,252,255,63,0,192,255,255,7,0,254,31,254,1,240,127,224,31,128,255,1,255,0,252,7,252,3,240,63,240,7,224,255,227,1,128,255,255,0,0,224,255,3,32,0,254,15,192,7,240,63,192,31,192,255,128,127,0,255,1,254,0,252,7,252,3,248,15,248,7,224,31,240,31,192,63,224,63,128,127,192,255,0,254,0,255,1,252,1,254,3,248,3,248,15,240,15,224,63,192,31,192,127,128,127,0,254,3,254,1,248,15,248,7,240,63,240,15,224,63,248,15,192,63,240,31,128,127,224,127,0,127,192,127,0,255,0,255,1,252,7,248,31,192,63,128,255,0,254,3,248,7,240,31,192,63,192,255,0,127,0,254,15,224,7,224,255,0,60,0,254,31,0,0,240,255,3,0,128,255,255,3,0,254,255,127,0,240,255,255,15,0,254,31,255,1,224,255,129,63,0,252,63,224,1,192,255,15,0,0,248,255,1,0,0,254,31,0,28,224,255,3,192,63,240,127,0,252,1,254,7,192,7,248,255,0,0,192,255,255,3,0,254,255,255,0,224,255,255,15,0,254,255,127,0,128,255,255,7,0,248,255,255,0,192,255,255,3,0,0,255,31,0,0,252,255,3,0,224,255,255,0,128,255,255,7,0,248,255,63,0,0,254,255,1,0,240,255,7,0,0,255,31,0,0,248,255,0,0,192,255,1,126,0,254,192,255,1,0,0,255,15,0,0,254,255,0,0,248,255,31,0,224,255,255,0,0,63